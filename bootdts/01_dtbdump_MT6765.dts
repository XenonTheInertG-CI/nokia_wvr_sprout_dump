/dts-v1/;

/ {
	#address-cells = <0x2>;
	#size-cells = <0x2>;
	compatible = "mediatek,MT6765";
	interrupt-parent = <0x1>;
	model = "MT6765";

	__symbols__ {
		DPIDLE = "/cpus/idle-states/dpidle";
		MCDI_CLUSTER = "/cpus/idle-states/mcdi-cluster";
		MCDI_CPU = "/cpus/idle-states/mcdi-cpu";
		SODI = "/cpus/idle-states/sodi";
		SODI3 = "/cpus/idle-states/sodi3";
		STANDBY = "/cpus/idle-states/standby";
		SUSPEND = "/cpus/idle-states/suspend";
		accdet = "/accdet";
		apdma = "/dma-controller@11000580";
		apmixed = "/apmixed@1000c000";
		audclk = "/audclk@11220000";
		audgpio = "/mt_soc_dl1_pcm@11220000";
		audio = "/audio@11220000";
		auxadc = "/auxadc@11001000";
		btcvsd_snd = "/mtk-btcvsd-snd@18050000";
		camera_af_hw_node = "/camera_af_hw_node";
		camsys = "/camsys@1a000000";
		camsys1 = "/camsysisp@1a000000";
		cci = "/cci";
		cci_opp = "/opp_table2";
		ccifdriver = "/ccifdriver@10209000";
		cdfinger = "/cdfinger";
		charger = "/charger";
		chosen = "/chosen";
		cldmadriver = "/cldmadriver@10014000";
		clk13m = "/clocks/clk13m";
		clk26m = "/clocks/clk26m";
		clk32k = "/clocks/clk32k";
		clock_buffer_ctrl = "/pwrap@1000d000/main_pmic/clock_buffer_ctrl";
		cluster0_opp = "/opp_table0";
		cluster1_opp = "/opp_table1";
		cm_mgr = "/cm_mgr@10200000";
		consys = "/consys@18002000";
		consys_mem = "/reserved-memory/consys-reserve-memory";
		cpu0 = "/cpus/cpu@000";
		cpu1 = "/cpus/cpu@001";
		cpu2 = "/cpus/cpu@002";
		cpu3 = "/cpus/cpu@003";
		cpu4 = "/cpus/cpu@100";
		cpu5 = "/cpus/cpu@101";
		cpu6 = "/cpus/cpu@102";
		cpu7 = "/cpus/cpu@103";
		cpu_dbgapb = "/cpu_dbgapb@0d410000";
		cpu_freq_segment = "/efuse@11c50000/segment@1c";
		dcm = "/dcm@10001000";
		disp_color0 = "/disp_color0@1400f000";
		disp_mutex0 = "/disp_mutex0@14001000";
		dispsys_config = "/dispsys_config@14000000";
		dsi_te = "/dsi_te";
		dvfsrc = "/dvfsrc@10012000";
		dvfsrc_freq_opp0 = "/dvfsrc@10012000/opp0";
		dvfsrc_freq_opp1 = "/dvfsrc@10012000/opp1";
		dvfsrc_freq_opp2 = "/dvfsrc@10012000/opp2";
		dynamic_options = "/dynamic_options";
		efuse = "/efuse@11c50000";
		efuse_ly = "/efuse@11c50000/ly@210";
		efuse_segment = "/efuse@11c50000/segment@78";
		eint = "/eint@1000b000";
		ext_32k = "/pwrap@1000d000/main_pmic/mtk_rtc/ext_32k";
		extcon_usb = "/extcon_usb";
		fg_init = "/pwrap@1000d000/main_pmic/mtk_rtc/fg_init";
		fg_soc = "/pwrap@1000d000/main_pmic/mtk_rtc/fg_soc";
		finger_fp = "/fingerprint";
		flashlight_core = "/flashlight_core";
		flashlights_mt6370 = "/flashlights_mt6370";
		flashlights_ocp8132a = "/flashlights_ocp8132a";
		gce = "/gce@10238000";
		gce_mbox = "/gce_mbox@10238000";
		gce_mbox_svp = "/gce_mbox_svp@10238000";
		ged = "/ged";
		gic = "/interrupt-controller@0c000000";
		gpio = "/gpio@10005000";
		gpio_usage_mapping = "/gpio";
		gpufreq = "/gpufreq";
		hwrng = "/hwrng";
		i2c0 = "/i2c0@11007000";
		i2c1 = "/i2c1@11008000";
		i2c2 = "/i2c2@11009000";
		i2c3 = "/i2c3@1100f000";
		i2c4 = "/i2c4@11011000";
		i2c5 = "/i2c5@11016000";
		i2c6 = "/i2c6@1100d000";
		i2c7 = "/i2c7";
		i2c8 = "/i2c8";
		i2c9 = "/i2c9";
		i2c_common = "/i2c_common";
		imgsys = "/imgsys_clk@15020000";
		infracfg_ao = "/infracfg_ao@10001000";
		io_cfg_bl = "/io_cfg_bl@10002600";
		io_cfg_lb = "/io_cfg_lb@10002400";
		io_cfg_lm = "/io_cfg_lm@10002200";
		io_cfg_lt = "/io_cfg_lt@10002000";
		io_cfg_rb = "/io_cfg_rb@10002a00";
		io_cfg_rr = "/io_cfg_rr@10002800";
		io_cfg_rt = "/io_cfg_rt@10002c00";
		irq_nfc = "/irq_nfc";
		irtx_pwm = "/irtx_pwm";
		kd_camera_hw1 = "/kd_camera_hw1@1a040000";
		key_google = "/key_google";
		keypad = "/kp@10010000";
		lcm = "/lcm_gpio";
		lk_charger = "/lk_charger";
		main_pmic = "/pwrap@1000d000/main_pmic";
		md1_sim1_hot_plug_eint = "/md1_sim1_hot_plug_eint";
		md1_sim2_hot_plug_eint = "/md1_sim2_hot_plug_eint";
		md_auxadc = "/md_auxadc";
		mddriver = "/mddriver@10014000";
		mdp_ccorr = "/mdp_ccorr0@14005000";
		mdp_rdma0 = "/mdp_rdma0@14004000";
		mdp_rsz0 = "/mdp_rsz0@14006000";
		mdp_rsz1 = "/mdp_rsz1@14007000";
		mdp_tdshp0 = "/mdp_tdshp0@1400a000";
		mdp_wdma0 = "/mdp_wdma0@14008000";
		mdp_wrot0 = "/mdp_wrot0@14009000";
		mfg_cfg = "/mfg_cfg@13ffe000";
		mfg_doma = "/mfg_doma@13000000";
		mipi_rx_ana_csi0a = "/mipi_rx_ana_csi0a@11c10000";
		mipi_rx_ana_csi0b = "/mipi_rx_ana_csi0b@11c11000";
		mipi_rx_ana_csi1a = "/mipi_rx_ana_csi1a@11c12000";
		mipi_rx_ana_csi1b = "/mipi_rx_ana_csi1b@11c13000";
		mipi_rx_ana_csi2a = "/mipi_rx_ana_csi2a@11c14000";
		mipi_rx_ana_csi2b = "/mipi_rx_ana_csi2b@11c15000";
		mmsys_config = "/mmsys_config@14000000";
		mrdump_ext_rst = "/mrdump_ext_rst";
		msdc0 = "/msdc@11230000";
		msdc0_pins_default = "/pinctrl@1000b000/msdc0@default";
		msdc0_pins_hs200 = "/pinctrl@1000b000/msdc0@hs200";
		msdc0_pins_hs400 = "/pinctrl@1000b000/msdc0@hs400";
		msdc0_register_setting_default = "/pinctrl@1000b000/msdc0@register_default";
		msdc1 = "/msdc@11240000";
		msdc1_ins = "/msdc1_ins@0";
		msdc1_pins_ddr50 = "/pinctrl@1000b000/msdc1@ddr50";
		msdc1_pins_default = "/pinctrl@1000b000/msdc1@default";
		msdc1_pins_sdr104 = "/pinctrl@1000b000/msdc1@sdr104";
		msdc1_pins_sdr50 = "/pinctrl@1000b000/msdc1@sdr50";
		msdc1_register_setting_default = "/pinctrl@1000b000/msdc1@register_default";
		msdc2 = "/msdc@11250000";
		msdc3 = "/msdc@11260000";
		msdc3_pins_default = "/pinctrl@1000b000/msdc3@default";
		msdc3_register_setting_default = "/pinctrl@1000b000/msdc3@register_default";
		mt6357_charger = "/pwrap@1000d000/main_pmic/mt6357_charger";
		mt6357_ts_buck1 = "/pwrap@1000d000/main_pmic/mt6357_ts_buck1";
		mt6357_ts_buck2 = "/pwrap@1000d000/main_pmic/mt6357_ts_buck2";
		mt6357keys = "/pwrap@1000d000/main_pmic/mt6357keys";
		mt6357regulator = "/pwrap@1000d000/main_pmic/mt6357regulator";
		mt6370_chg = "/mt6370_pmu_dts/charger";
		mt6370_pmu = "/mt6370_pmu_dts";
		mt6370_typec = "/type_c_port0";
		mt_pmic_vaud28_ldo_reg = "/pwrap@1000d000/main_pmic/mt6357regulator/ldo_vaud28";
		mt_pmic_vaux18_ldo_reg = "/pwrap@1000d000/main_pmic/mt6357regulator/ldo_vaux18";
		mt_pmic_vcama_ldo_reg = "/pwrap@1000d000/main_pmic/mt6357regulator/ldo_vcama";
		mt_pmic_vcamd_ldo_reg = "/pwrap@1000d000/main_pmic/mt6357regulator/ldo_vcamd";
		mt_pmic_vcamio_ldo_reg = "/pwrap@1000d000/main_pmic/mt6357regulator/ldo_vcamio";
		mt_pmic_vcn18_ldo_reg = "/pwrap@1000d000/main_pmic/mt6357regulator/ldo_vcn18";
		mt_pmic_vcn28_ldo_reg = "/pwrap@1000d000/main_pmic/mt6357regulator/ldo_vcn28";
		mt_pmic_vcn33_bt_ldo_reg = "/pwrap@1000d000/main_pmic/mt6357regulator/ldo_vcn33_bt";
		mt_pmic_vcn33_wifi_ldo_reg = "/pwrap@1000d000/main_pmic/mt6357regulator/ldo_vcn33_wifi";
		mt_pmic_vcore_buck_reg = "/pwrap@1000d000/main_pmic/mt6357regulator/buck_vcore";
		mt_pmic_vdram_ldo_reg = "/pwrap@1000d000/main_pmic/mt6357regulator/ldo_vdram";
		mt_pmic_vefuse_ldo_reg = "/pwrap@1000d000/main_pmic/mt6357regulator/ldo_vefuse";
		mt_pmic_vemc_ldo_reg = "/pwrap@1000d000/main_pmic/mt6357regulator/ldo_vemc";
		mt_pmic_vfe28_ldo_reg = "/pwrap@1000d000/main_pmic/mt6357regulator/ldo_vfe28";
		mt_pmic_vibr_ldo_reg = "/pwrap@1000d000/main_pmic/mt6357regulator/ldo_vibr";
		mt_pmic_vio18_ldo_reg = "/pwrap@1000d000/main_pmic/mt6357regulator/ldo_vio18";
		mt_pmic_vio28_ldo_reg = "/pwrap@1000d000/main_pmic/mt6357regulator/ldo_vio28";
		mt_pmic_vldo28_ldo_reg = "/pwrap@1000d000/main_pmic/mt6357regulator/ldo_vldo28";
		mt_pmic_vmc_ldo_reg = "/pwrap@1000d000/main_pmic/mt6357regulator/ldo_vmc";
		mt_pmic_vmch_ldo_reg = "/pwrap@1000d000/main_pmic/mt6357regulator/ldo_vmch";
		mt_pmic_vmodem_buck_reg = "/pwrap@1000d000/main_pmic/mt6357regulator/buck_vmodem";
		mt_pmic_vpa_buck_reg = "/pwrap@1000d000/main_pmic/mt6357regulator/buck_vpa";
		mt_pmic_vproc_buck_reg = "/pwrap@1000d000/main_pmic/mt6357regulator/buck_vproc";
		mt_pmic_vrf12_ldo_reg = "/pwrap@1000d000/main_pmic/mt6357regulator/ldo_vrf12";
		mt_pmic_vrf18_ldo_reg = "/pwrap@1000d000/main_pmic/mt6357regulator/ldo_vrf18";
		mt_pmic_vs1_buck_reg = "/pwrap@1000d000/main_pmic/mt6357regulator/buck_vs1";
		mt_pmic_vsim1_ldo_reg = "/pwrap@1000d000/main_pmic/mt6357regulator/ldo_vsim1";
		mt_pmic_vsim2_ldo_reg = "/pwrap@1000d000/main_pmic/mt6357regulator/ldo_vsim2";
		mt_pmic_vsram_others_ldo_reg = "/pwrap@1000d000/main_pmic/mt6357regulator/ldo_vsram_others";
		mt_pmic_vsram_proc_ldo_reg = "/pwrap@1000d000/main_pmic/mt6357regulator/ldo_vsram_proc";
		mt_pmic_vusb33_ldo_reg = "/pwrap@1000d000/main_pmic/mt6357regulator/ldo_vusb33";
		mt_pmic_vxo22_ldo_reg = "/pwrap@1000d000/main_pmic/mt6357regulator/ldo_vxo22";
		mtk_charger_type = "/pwrap@1000d000/main_pmic/mtk_charger_type";
		mtk_gauge = "/pwrap@1000d000/main_pmic/mtk_gauge";
		mtk_rtc = "/pwrap@1000d000/main_pmic/mtk_rtc";
		mtk_ts_pmic = "/pwrap@1000d000/main_pmic/mtk_ts_pmic";
		mtkfb = "/mtkfb@0";
		nfc = "/nfc";
		odm = "/odm";
		otg_iddig = "/otg_iddig";
		otg_vbus = "/mt6370_pmu_dts/charger/usb-otg-vbus";
		pd_adapter = "/pd_adapter";
		pdc = "/pdc";
		pe = "/pe";
		pe2 = "/pe2";
		pe4 = "/pe4";
		pericfg = "/pericfg@10003000";
		pio = "/pinctrl@1000b000";
		pmic_accdet = "/pwrap@1000d000/main_pmic/pmic_accdet";
		pmic_auxadc = "/pwrap@1000d000/main_pmic/pmic_auxadc";
		pmic_clock_buffer_ctrl = "/pmic_clock_buffer_ctrl";
		pmic_codec = "/pwrap@1000d000/main_pmic/pmic_codec";
		pmic_efuse = "/pwrap@1000d000/main_pmic/pmic_efuse";
		pwm = "/pwm@11006000";
		pwrap = "/pwrap@1000d000";
		radio_md_cfg = "/radio_md_cfg";
		reserved_memory = "/reserved-memory";
		rt9465_slave_chr = "/rt9465_slave_chr";
		scp_infra = "/scp_infra@10001000";
		scpsys = "/scpsys@10001000";
		sileadfp = "/sileadfp";
		sleep = "/sleep@10006000";
		smart_pa = "/smart_pa";
		smi_common = "/smi_common@14002000";
		smi_larb0 = "/smi_larb0@14003000";
		smi_larb1 = "/smi_larb1@17010000";
		smi_larb2 = "/smi_larb2@15021000";
		smi_larb3 = "/smi_larb3@1a002000";
		spi0 = "/spi@1100a000";
		spi1 = "/spi@11010000";
		spi2 = "/spi@11012000";
		spi3 = "/spi@11013000";
		spi4 = "/spi@11014000";
		spi5 = "/spi@11015000";
		subpmic_pmu_eint = "/mt6370_pmu_eint";
		swtp = "/swtp";
		sysirq = "/intpol-controller@10200a80";
		tboard_thermistor1 = "/thermal-sensor1";
		tboard_thermistor2 = "/thermal-sensor2";
		tcpc_pd = "/mt6370_pd_eint";
		thermal_efuse = "/efuse@11c50000/segment@190";
		timer = "/timer@10017000";
		topckgen = "/topckgen@10000000";
		toprgu = "/toprgu@10007000";
		touch = "/touch";
		u2_phy_data = "/efuse@11c50000/u2_phy_data@1ac";
		u2phy0 = "/usb-phy@11210000";
		u2port0 = "/usb-phy@11210000/usb-phy@11210000";
		uart0 = "/serial@11020000";
		uart1 = "/serial@11030000";
		usb = "/usb0@11200000";
		vcodecsys = "/vcodecsys@17000000";
		venc_gcon = "/venc_gcon@17000000";
		wifi_mem = "/reserved-memory/wifi-reserve-memory";
	};

	accdet {
		compatible = "mediatek,pmic-accdet";
		phandle = <0x9b>;
	};

	aes_top0@10016000 {
		compatible = "mediatek,aes_top0";
		reg = <0x0 0x10016000 0x0 0x1000>;
	};

	amms_control {
		compatible = "mediatek,amms";
		interrupts = <0x0 0x86 0x1>;
	};

	ap_ccif0@10209000 {
		compatible = "mediatek,ap_ccif0";
		interrupts = <0x0 0x94 0x8>;
		reg = <0x0 0x10209000 0x0 0x1000>;
	};

	ap_ccif1@1020b000 {
		compatible = "mediatek,ap_ccif1";
		interrupts = <0x0 0x96 0x8>;
		reg = <0x0 0x1020b000 0x0 0x1000>;
	};

	ap_ccif2@1023c000 {
		compatible = "mediatek,ap_ccif2";
		interrupts = <0x0 0x8f 0x8>;
		reg = <0x0 0x1023c000 0x0 0x1000>;
	};

	ap_ccif3@1023e000 {
		compatible = "mediatek,ap_ccif3";
		interrupts = <0x0 0x92 0x8>;
		reg = <0x0 0x1023e000 0x0 0x1000>;
	};

	ap_dma@11000000 {
		compatible = "mediatek,ap_dma";
		interrupts = <0x0 0x61 0x8>;
		reg = <0x0 0x11000000 0x0 0x1000>;
	};

	apcldmain@1021b000 {
		compatible = "mediatek,apcldmain";
		reg = <0x0 0x1021b000 0x0 0x0>;
	};

	apcldmain_ao@10014000 {
		compatible = "mediatek,apcldmain_ao";
		reg = <0x0 0x10014000 0x0 0x400>;
	};

	apcldmamisc@1021b800 {
		compatible = "mediatek,apcldmamisc";
		interrupts = <0x0 0xa5 0x4>;
		reg = <0x0 0x1021b800 0x0 0x0>;
	};

	apcldmamisc_ao@10014800 {
		compatible = "mediatek,apcldmamisc_ao";
		reg = <0x0 0x10014800 0x0 0x400>;
	};

	apcldmaout@1021b400 {
		compatible = "mediatek,apcldmaout";
		reg = <0x0 0x1021b400 0x0 0x0>;
	};

	apcldmaout_ao@10014400 {
		compatible = "mediatek,apcldmaout_ao";
		reg = <0x0 0x10014400 0x0 0x400>;
	};

	apmixed@1000c000 {
		#clock-cells = <0x1>;
		compatible = "mediatek,mt6765-apmixedsys", "syscon";
		phandle = <0x3>;
		reg = <0x0 0x1000c000 0x0 0xe00>;
	};

	apxgpt@10008000 {
		clocks = <0x23>;
		compatible = "mediatek,apxgpt";
		interrupts = <0x0 0xaa 0x8>;
		reg = <0x0 0x10008000 0x0 0x1000>;
	};

	atf_logger {
		compatible = "mediatek,atf_logger";
		interrupts = <0x0 0xf7 0x1>;
	};

	audclk@11220000 {
		#clock-cells = <0x1>;
		compatible = "mediatek,mt6765-audsys", "syscon";
		phandle = <0x5d>;
		reg = <0x0 0x11220000 0x0 0x1000>;
	};

	audio@11220000 {
		compatible = "mediatek,audio", "syscon";
		mediatek,btcvsd_snd = <0x5c>;
		phandle = <0xc0>;
		reg = <0x0 0x11220000 0x0 0x1000>;
	};

	audio_snd_card {
		compatible = "mediatek,audio_snd_card";
	};

	audio_sram@11221000 {
		compatible = "mediatek,audio_sram";
		reg = <0x0 0x11221000 0x0 0x9000>;
	};

	auxadc@11001000 {
		#interconnect-cells = <0x1>;
		#io-channel-cells = <0x1>;
		clock-names = "main";
		clocks = <0x25 0x21>;
		compatible = "mediatek,mt6765-auxadc";
		interrupts = <0x0 0x4c 0x2>;
		mediatek,cali-efuse-reg-offset = <0x1a8>;
		mediatek,cali-en-bit = <0x14>;
		mediatek,cali-ge-bit = <0xa>;
		mediatek,cali-oe-bit = <0x0>;
		nvmem = <0x3b>;
		nvmem-names = "mtk_efuse";
		phandle = <0x2b>;
		reg = <0x0 0x11001000 0x0 0x1000>;
	};

	bpi_bsi_slv0@1021e000 {
		compatible = "mediatek,bpi_bsi_slv0";
		reg = <0x0 0x1021e000 0x0 0x1000>;
	};

	bpi_bsi_slv1@1021f000 {
		compatible = "mediatek,bpi_bsi_slv1";
		reg = <0x0 0x1021f000 0x0 0x6000>;
	};

	bpi_bsi_slv2@10225000 {
		compatible = "mediatek,bpi_bsi_slv2";
		reg = <0x0 0x10225000 0x0 0x1000>;
	};

	btif@1100c000 {
		clock-names = "btifc", "apdmac";
		clocks = <0x25 0x1a 0x25 0x26>;
		compatible = "mediatek,btif";
		interrupts = <0x0 0x70 0x8 0x0 0x84 0x8 0x0 0x85 0x8>;
		reg = <0x0 0x1100c000 0x0 0x1000 0x0 0x11000880 0x0 0x80 0x0 0x11000900 0x0 0x80>;
	};

	bus_dbg@10208000 {
		compatible = "mediatek,bus_dbg-v2";
		interrupts = <0x0 0x8d 0x8>;
		mediatek,bus_dbg_con_offset = <0x2fc>;
		reg = <0x0 0x10208000 0x0 0x1000 0x0 0x10001000 0x0 0x1000>;
	};

	cam1@1a003000 {
		compatible = "mediatek,cam1";
		interrupts = <0x0 0xeb 0x8>;
		reg = <0x0 0x1a003000 0x0 0x1000>;
	};

	cam2@1a004000 {
		compatible = "mediatek,cam2";
		interrupts = <0x0 0xec 0x8>;
		reg = <0x0 0x1a004000 0x0 0x1000>;
	};

	cam3@1a005000 {
		compatible = "mediatek,cam3";
		interrupts = <0x0 0xed 0x8>;
		reg = <0x0 0x1a005000 0x0 0x1000>;
	};

	cam_clear@1a01b000 {
		compatible = "mediatek,cam_clear";
		reg = <0x0 0x1a01b000 0x0 0x1000>;
	};

	cam_inner@1a013000 {
		compatible = "mediatek,cam_inner";
		reg = <0x0 0x1a013000 0x0 0x1000>;
	};

	cam_set@1a00b000 {
		compatible = "mediatek,cam_set";
		reg = <0x0 0x1a00b000 0x0 0x1000>;
	};

	cama_clear@1a01c000 {
		compatible = "mediatek,cama_clear";
		reg = <0x0 0x1a01c000 0x0 0x1000>;
	};

	cama_ext@1a024000 {
		compatible = "mediatek,cama_ext";
		reg = <0x0 0x1a024000 0x0 0x1000>;
	};

	cama_inner@1a014000 {
		compatible = "mediatek,cama_inner";
		reg = <0x0 0x1a014000 0x0 0x1000>;
	};

	cama_set@1a00c000 {
		compatible = "mediatek,cama_set";
		reg = <0x0 0x1a00c000 0x0 0x1000>;
	};

	camb_clear@1a01d000 {
		compatible = "mediatek,camb_clear";
		reg = <0x0 0x1a01d000 0x0 0x1000>;
	};

	camb_ext@1a025000 {
		compatible = "mediatek,camb_ext";
		reg = <0x0 0x1a025000 0x0 0x1000>;
	};

	camb_inner@1a015000 {
		compatible = "mediatek,camb_inner";
		reg = <0x0 0x1a015000 0x0 0x1000>;
	};

	camb_set@1a00d000 {
		compatible = "mediatek,camb_set";
		reg = <0x0 0x1a00d000 0x0 0x1000>;
	};

	camera_af_hw_node {
		camaf_m1_pmic-supply = <0x65>;
		compatible = "mediatek,camera_af_lens";
		phandle = <0xd6>;
	};

	camsv1@1a050000 {
		compatible = "mediatek,camsv1";
		interrupts = <0x0 0xf3 0x8>;
		reg = <0x0 0x1a050000 0x0 0x1000>;
	};

	camsv2@1a051000 {
		compatible = "mediatek,camsv2";
		interrupts = <0x0 0xf4 0x8>;
		reg = <0x0 0x1a051000 0x0 0x1000>;
	};

	camsv3@1a052000 {
		compatible = "mediatek,camsv3";
		interrupts = <0x0 0xf1 0x8>;
		reg = <0x0 0x1a052000 0x0 0x1000>;
	};

	camsv4@1a053000 {
		compatible = "mediatek,camsv4";
		interrupts = <0x0 0xf2 0x8>;
		reg = <0x0 0x1a053000 0x0 0x1000>;
	};

	camsys@1a000000 {
		#clock-cells = <0x1>;
		compatible = "mediatek,mt6765-camsys", "syscon";
		phandle = <0x62>;
		reg = <0x0 0x1a000000 0x0 0x1000>;
	};

	camsysisp@1a000000 {
		#clock-cells = <0x1>;
		compatible = "mediatek,camsys", "syscon";
		phandle = <0xd3>;
		reg = <0x0 0x1a000000 0x0 0x1000>;
	};

	cci {
		clock-names = "dsu_clock";
		clocks = <0x3 0x2>;
		compatible = "mediatek,mtk-cci";
		operating-points-v2 = <0x4>;
		phandle = <0x6a>;
	};

	ccifdriver@10209000 {
		clock-names = "infra-ccif-ap", "infra-ccif-md", "infra-ccif1-ap", "infra-ccif1-md", "infra-ccif2-ap", "infra-ccif2-md";
		clocks = <0x25 0x29 0x25 0x2c 0x25 0x23 0x25 0x24 0x25 0x51 0x25 0x52>;
		compatible = "mediatek,ccci_ccif";
		interrupts = <0x0 0x94 0x8 0x0 0x95 0x8>;
		mediatek,sram_size = <0x200>;
		phandle = <0xa2>;
		reg = <0x0 0x10209000 0x0 0x1000 0x0 0x1020a000 0x0 0x1000>;
	};

	ccu@1a0b1000 {
		clock-names = "CCU_CLK_CAM_CCU", "CAM_PWR";
		clocks = <0x62 0x8 0x36 0x9>;
		compatible = "mediatek,ccu";
		interrupts = <0x0 0xf6 0x8>;
		reg = <0x0 0x1a0b1000 0x0 0x1000>;
	};

	cdfinger {
		compatible = "mediatek,cdfinger";
		phandle = <0x9c>;
	};

	charger {
		ac_charger_current = <0x17a6b0>;
		ac_charger_input_current = <0x16e360>;
		algorithm_name = "Basic";
		battery_cv = <0x432380>;
		bootmode = <0x2a>;
		charger = <0x29>;
		charger_configuration = <0x0>;
		charging_host_charger_current = <0x16e360>;
		compatible = "mediatek,charger";
		enable_dynamic_mivr;
		enable_min_charge_temp;
		enable_sw_jeita;
		gauge = <0x66>;
		jeita_temp_above_t4_cc = <0x0>;
		jeita_temp_above_t4_cv = <0x3e8fa0>;
		jeita_temp_below_t0_cc = <0x0>;
		jeita_temp_below_t0_cv = <0x432380>;
		jeita_temp_t0_to_t1_cc = <0x0>;
		jeita_temp_t0_to_t1_cv = <0x432380>;
		jeita_temp_t1_to_t2_cc = <0xcf850>;
		jeita_temp_t1_to_t2_cv = <0x432380>;
		jeita_temp_t2_to_t3_cc = <0x17a6b0>;
		jeita_temp_t2_to_t3_cv = <0x432380>;
		jeita_temp_t3_to_t4_cc = <0x17a6b0>;
		jeita_temp_t3_to_t4_cv = <0x3e8fa0>;
		max_charge_temp = <0x37>;
		max_charge_temp_minus_x_degree = <0x35>;
		max_charger_voltage = <0x632ea0>;
		max_dmivr_charger_current = <0x1b7740>;
		min_charge_temp = <0x0>;
		min_charge_temp_plus_x_degree = <0x2>;
		min_charger_voltage = <0x4630c0>;
		min_charger_voltage_1 = <0x432380>;
		min_charger_voltage_2 = <0x401640>;
		phandle = <0x2f>;
		pmic = <0x31>;
		temp_neg_10_thres = <0x0>;
		temp_t0_thres = <0x0>;
		temp_t0_thres_plus_x_degree = <0x0>;
		temp_t1_thres = <0x0>;
		temp_t1_thres_plus_x_degree = <0x2>;
		temp_t2_thres = <0xf>;
		temp_t2_thres_plus_x_degree = <0x11>;
		temp_t3_thres = <0x2d>;
		temp_t3_thres_minus_x_degree = <0x2b>;
		temp_t4_thres = <0x37>;
		temp_t4_thres_minus_x_degree = <0x35>;
		usb_charger_current = <0x7a120>;
	};

	chipid@08000000 {
		compatible = "mediatek,chipid";
		reg = <0x0 0x8000000 0x0 0x4 0x0 0x8000004 0x0 0x4 0x0 0x8000008 0x0 0x4 0x0 0x800000c 0x0 0x4>;
	};

	chosen {
		bootargs = "console=tty0 console=ttyS0,921600n1 vmalloc=400M \t\t\t\tslub_debug=OFZPU page_owner=on \t\t\t\tswiotlb=noforce androidboot.hardware=mt6765 \t\t\t\tmaxcpus=8 loop.max_part=7 \t\t\t\tfirmware_class.path=/vendor/firmware";
		phandle = <0x2a>;
	};

	cldmadriver@10014000 {
		cldma-infracfg = <0x25>;
		clock-names = "infra-cldma-bclk";
		clocks = <0x25 0x32>;
		compatible = "mediatek,ccci_cldma";
		interrupts = <0x0 0xa5 0x4>;
		mediatek,cldma_capability = <0x6>;
		mediatek,md_generation = <0x1895>;
		mediatek,platform = <0x1a6d>;
		phandle = <0xa3>;
		reg = <0x0 0x10014000 0x0 0x1000 0x0 0x1021b000 0x0 0x1000>;
	};

	clocks {

		clk13m {
			#clock-cells = <0x0>;
			clock-frequency = <0xc65d40>;
			compatible = "fixed-clock";
			phandle = <0x35>;
		};

		clk26m {
			#clock-cells = <0x0>;
			clock-frequency = <0x18cba80>;
			compatible = "fixed-clock";
			phandle = <0x24>;
		};

		clk32k {
			#clock-cells = <0x0>;
			clock-frequency = <0x7d00>;
			compatible = "fixed-clock";
			phandle = <0x23>;
		};
	};

	cm_mgr@10200000 {
		cm_mgr,cp_down = <0x64 0x64>;
		cm_mgr,cp_up = <0x64 0x64>;
		cm_mgr,dt_down = <0x0 0x3>;
		cm_mgr,dt_up = <0x0 0x3>;
		cm_mgr,vp_down = <0x64 0x64>;
		cm_mgr,vp_up = <0x64 0x64>;
		compatible = "mediatek,mt6765-cm_mgr";
		phandle = <0xef>;
		reg = <0x0 0x10200000 0x0 0x4000>;
		reg-names = "cm_mgr_base";
		required-opps = <0x32 0x33 0x34>;
	};

	consys@18002000 {
		#address-cells = <0x2>;
		#size-cells = <0x2>;
		clock-names = "conn";
		clocks = <0x36 0x1>;
		compatible = "mediatek,mt6765-consys";
		interrupts = <0x0 0x10b 0x8 0x0 0x10d 0x8 0x0 0x10e 0x1>;
		memory-region = <0x4b>;
		phandle = <0x21>;
		pmic = <0x31>;
		reg = <0x0 0x18002000 0x0 0x1000 0x0 0x10007000 0x0 0x100 0x0 0x10001000 0x0 0x1000 0x0 0x10006000 0x0 0x1000 0x0 0x18007000 0x0 0x1000 0x0 0x180b1000 0x0 0x1000 0x0 0x180a3000 0x0 0x1000 0x0 0x180a5000 0x0 0x800 0x0 0x180c1000 0x0 0x1000 0x0 0x18004000 0x0 0x1000 0x0 0x0 0x0 0x0 0x0 0x0 0x0 0x0 0x0 0x1020e000 0x0 0x1000>;
	};

	cpu_dbgapb@0d410000 {
		compatible = "mediatek,hw_dbg";
		num = <0x8>;
		phandle = <0x6c>;
		reg = <0x0 0xd410000 0x0 0x1000 0x0 0xd510000 0x0 0x1000 0x0 0xd610000 0x0 0x1000 0x0 0xd710000 0x0 0x1000 0x0 0xd810000 0x0 0x1000 0x0 0xd910000 0x0 0x1000 0x0 0xda10000 0x0 0x1000 0x0 0xdb10000 0x0 0x1000>;
	};

	cpus {
		#address-cells = <0x1>;
		#size-cells = <0x0>;

		cpu-map {

			cluster0 {

				core0 {
					cpu = <0xe>;
				};

				core1 {
					cpu = <0xf>;
				};

				core2 {
					cpu = <0x10>;
				};

				core3 {
					cpu = <0x11>;
				};
			};

			cluster1 {

				core0 {
					cpu = <0x12>;
				};

				core1 {
					cpu = <0x13>;
				};

				core2 {
					cpu = <0x14>;
				};

				core3 {
					cpu = <0x15>;
				};
			};
		};

		cpu@000 {
			capacity-dmips-mhz = <0x400>;
			clock-frequency = <0x89267940>;
			compatible = "arm,cortex-a53";
			cpu-idle-states = <0x6 0x7 0x8 0x9 0xa 0xb 0xc>;
			device_type = "cpu";
			dynamic-power-coefficient = <0x113>;
			enable-method = "psci";
			operating-points-v2 = <0x5>;
			phandle = <0xe>;
			reg = <0x0>;
		};

		cpu@001 {
			capacity-dmips-mhz = <0x400>;
			clock-frequency = <0x89267940>;
			compatible = "arm,cortex-a53";
			cpu-idle-states = <0x6 0x7 0x8 0x9 0xa 0xb 0xc>;
			device_type = "cpu";
			dynamic-power-coefficient = <0x113>;
			enable-method = "psci";
			operating-points-v2 = <0x5>;
			phandle = <0xf>;
			reg = <0x1>;
		};

		cpu@002 {
			capacity-dmips-mhz = <0x400>;
			clock-frequency = <0x89267940>;
			compatible = "arm,cortex-a53";
			cpu-idle-states = <0x6 0x7 0x8 0x9 0xa 0xb 0xc>;
			device_type = "cpu";
			dynamic-power-coefficient = <0x113>;
			enable-method = "psci";
			operating-points-v2 = <0x5>;
			phandle = <0x10>;
			reg = <0x2>;
		};

		cpu@003 {
			capacity-dmips-mhz = <0x400>;
			clock-frequency = <0x89267940>;
			compatible = "arm,cortex-a53";
			cpu-idle-states = <0x6 0x7 0x8 0x9 0xa 0xb 0xc>;
			device_type = "cpu";
			dynamic-power-coefficient = <0x113>;
			enable-method = "psci";
			operating-points-v2 = <0x5>;
			phandle = <0x11>;
			reg = <0x3>;
		};

		cpu@100 {
			capacity-dmips-mhz = <0x321>;
			clock-frequency = <0x6b49d200>;
			compatible = "arm,cortex-a53";
			cpu-idle-states = <0x6 0x7 0x8 0x9 0xa 0xb 0xc>;
			device_type = "cpu";
			dynamic-power-coefficient = <0x55>;
			enable-method = "psci";
			operating-points-v2 = <0xd>;
			phandle = <0x12>;
			reg = <0x100>;
		};

		cpu@101 {
			capacity-dmips-mhz = <0x321>;
			clock-frequency = <0x6b49d200>;
			compatible = "arm,cortex-a53";
			cpu-idle-states = <0x6 0x7 0x8 0x9 0xa 0xb 0xc>;
			device_type = "cpu";
			dynamic-power-coefficient = <0x55>;
			enable-method = "psci";
			operating-points-v2 = <0xd>;
			phandle = <0x13>;
			reg = <0x101>;
		};

		cpu@102 {
			capacity-dmips-mhz = <0x321>;
			clock-frequency = <0x6b49d200>;
			compatible = "arm,cortex-a53";
			cpu-idle-states = <0x6 0x7 0x8 0x9 0xa 0xb 0xc>;
			device_type = "cpu";
			dynamic-power-coefficient = <0x55>;
			enable-method = "psci";
			operating-points-v2 = <0xd>;
			phandle = <0x14>;
			reg = <0x102>;
		};

		cpu@103 {
			capacity-dmips-mhz = <0x321>;
			clock-frequency = <0x6b49d200>;
			compatible = "arm,cortex-a53";
			cpu-idle-states = <0x6 0x7 0x8 0x9 0xa 0xb 0xc>;
			device_type = "cpu";
			dynamic-power-coefficient = <0x55>;
			enable-method = "psci";
			operating-points-v2 = <0xd>;
			phandle = <0x15>;
			reg = <0x103>;
		};

		idle-states {
			entry-method = "arm,psci";

			dpidle {
				arm,psci-suspend-param = <0x1010004>;
				compatible = "arm,idle-state";
				entry-latency-us = <0x320>;
				exit-latency-us = <0x3e8>;
				min-residency-us = <0x7d0>;
				phandle = <0xb>;
			};

			mcdi-cluster {
				arm,psci-suspend-param = <0x1010001>;
				compatible = "arm,idle-state";
				entry-latency-us = <0x258>;
				exit-latency-us = <0x258>;
				min-residency-us = <0x4b0>;
				phandle = <0x8>;
			};

			mcdi-cpu {
				arm,psci-suspend-param = <0x10001>;
				compatible = "arm,idle-state";
				entry-latency-us = <0x258>;
				exit-latency-us = <0x258>;
				min-residency-us = <0x4b0>;
				phandle = <0x7>;
			};

			sodi {
				arm,psci-suspend-param = <0x1010002>;
				compatible = "arm,idle-state";
				entry-latency-us = <0x320>;
				exit-latency-us = <0x3e8>;
				min-residency-us = <0x7d0>;
				phandle = <0x9>;
			};

			sodi3 {
				arm,psci-suspend-param = <0x1010003>;
				compatible = "arm,idle-state";
				entry-latency-us = <0x320>;
				exit-latency-us = <0x3e8>;
				min-residency-us = <0x7d0>;
				phandle = <0xa>;
			};

			standby {
				arm,psci-suspend-param = <0x1>;
				compatible = "arm,idle-state";
				entry-latency-us = <0x258>;
				exit-latency-us = <0x258>;
				min-residency-us = <0x4b0>;
				phandle = <0x6>;
			};

			suspend {
				arm,psci-suspend-param = <0x1010005>;
				compatible = "arm,idle-state";
				entry-latency-us = <0x320>;
				exit-latency-us = <0x3e8>;
				min-residency-us = <0x7d0>;
				phandle = <0xc>;
			};
		};
	};

	cq_dma@10212000 {
		clock-names = "cqdma";
		clocks = <0x25 0x43>;
		compatible = "mediatek,mt-cqdma-v1";
		interrupts = <0x0 0x71 0x8 0x0 0x72 0x8>;
		keep_clock_ao = "yes";
		nr_channel = <0x2>;
		reg = <0x0 0x10212000 0x0 0x80 0x0 0x10212080 0x0 0x80>;
	};

	dbg_apmcu_mp0@0d400000 {
		compatible = "mediatek,dbg_apmcu_mp0";
		reg = <0x0 0xd400000 0x0 0x1000>;
	};

	dbg_apmcu_mp0@0d410000 {
		compatible = "mediatek,dbg_apmcu_mp0";
		reg = <0x0 0xd410000 0x0 0x1000>;
	};

	dbg_apmcu_mp0@0d420000 {
		compatible = "mediatek,dbg_apmcu_mp0";
		reg = <0x0 0xd420000 0x0 0x1000>;
	};

	dbg_apmcu_mp0@0d430000 {
		compatible = "mediatek,dbg_apmcu_mp0";
		reg = <0x0 0xd430000 0x0 0x1000>;
	};

	dbg_apmcu_mp0@0d440000 {
		compatible = "mediatek,dbg_apmcu_mp0";
		reg = <0x0 0xd440000 0x0 0x1000>;
	};

	dbg_apmcu_mp0@0d510000 {
		compatible = "mediatek,dbg_apmcu_mp0";
		reg = <0x0 0xd510000 0x0 0x1000>;
	};

	dbg_apmcu_mp0@0d520000 {
		compatible = "mediatek,dbg_apmcu_mp0";
		reg = <0x0 0xd520000 0x0 0x1000>;
	};

	dbg_apmcu_mp0@0d530000 {
		compatible = "mediatek,dbg_apmcu_mp0";
		reg = <0x0 0xd530000 0x0 0x1000>;
	};

	dbg_apmcu_mp0@0d540000 {
		compatible = "mediatek,dbg_apmcu_mp0";
		reg = <0x0 0xd540000 0x0 0x1000>;
	};

	dbg_apmcu_mp0@0d610000 {
		compatible = "mediatek,dbg_apmcu_mp0";
		reg = <0x0 0xd610000 0x0 0x1000>;
	};

	dbg_apmcu_mp0@0d620000 {
		compatible = "mediatek,dbg_apmcu_mp0";
		reg = <0x0 0xd620000 0x0 0x1000>;
	};

	dbg_apmcu_mp0@0d630000 {
		compatible = "mediatek,dbg_apmcu_mp0";
		reg = <0x0 0xd630000 0x0 0x1000>;
	};

	dbg_apmcu_mp0@0d640000 {
		compatible = "mediatek,dbg_apmcu_mp0";
		reg = <0x0 0xd640000 0x0 0x1000>;
	};

	dbg_apmcu_mp0@0d710000 {
		compatible = "mediatek,dbg_apmcu_mp0";
		reg = <0x0 0xd710000 0x0 0x1000>;
	};

	dbg_apmcu_mp0@0d720000 {
		compatible = "mediatek,dbg_apmcu_mp0";
		reg = <0x0 0xd720000 0x0 0x1000>;
	};

	dbg_apmcu_mp0@0d730000 {
		compatible = "mediatek,dbg_apmcu_mp0";
		reg = <0x0 0xd730000 0x0 0x1000>;
	};

	dbg_apmcu_mp0@0d740000 {
		compatible = "mediatek,dbg_apmcu_mp0";
		reg = <0x0 0xd740000 0x0 0x1000>;
	};

	dbg_apmcu_mp1@0d800000 {
		compatible = "mediatek,dbg_apmcu_mp1";
		reg = <0x0 0xd800000 0x0 0x1000>;
	};

	dbg_apmcu_mp1@0d810000 {
		compatible = "mediatek,dbg_apmcu_mp1";
		reg = <0x0 0xd810000 0x0 0x1000>;
	};

	dbg_apmcu_mp1@0d820000 {
		compatible = "mediatek,dbg_apmcu_mp1";
		reg = <0x0 0xd820000 0x0 0x1000>;
	};

	dbg_apmcu_mp1@0d830000 {
		compatible = "mediatek,dbg_apmcu_mp1";
		reg = <0x0 0xd830000 0x0 0x1000>;
	};

	dbg_apmcu_mp1@0d840000 {
		compatible = "mediatek,dbg_apmcu_mp1";
		reg = <0x0 0xd840000 0x0 0x1000>;
	};

	dbg_apmcu_mp1@0d910000 {
		compatible = "mediatek,dbg_apmcu_mp1";
		reg = <0x0 0xd910000 0x0 0x1000>;
	};

	dbg_apmcu_mp1@0d920000 {
		compatible = "mediatek,dbg_apmcu_mp1";
		reg = <0x0 0xd920000 0x0 0x1000>;
	};

	dbg_apmcu_mp1@0d930000 {
		compatible = "mediatek,dbg_apmcu_mp1";
		reg = <0x0 0xd930000 0x0 0x1000>;
	};

	dbg_apmcu_mp1@0d940000 {
		compatible = "mediatek,dbg_apmcu_mp1";
		reg = <0x0 0xd940000 0x0 0x1000>;
	};

	dbg_apmcu_mp1@0da10000 {
		compatible = "mediatek,dbg_apmcu_mp1";
		reg = <0x0 0xda10000 0x0 0x1000>;
	};

	dbg_apmcu_mp1@0da20000 {
		compatible = "mediatek,dbg_apmcu_mp1";
		reg = <0x0 0xda20000 0x0 0x1000>;
	};

	dbg_apmcu_mp1@0da30000 {
		compatible = "mediatek,dbg_apmcu_mp1";
		reg = <0x0 0xda30000 0x0 0x1000>;
	};

	dbg_apmcu_mp1@0da40000 {
		compatible = "mediatek,dbg_apmcu_mp1";
		reg = <0x0 0xda40000 0x0 0x1000>;
	};

	dbg_apmcu_mp1@0db10000 {
		compatible = "mediatek,dbg_apmcu_mp1";
		reg = <0x0 0xdb10000 0x0 0x1000>;
	};

	dbg_apmcu_mp1@0db20000 {
		compatible = "mediatek,dbg_apmcu_mp1";
		reg = <0x0 0xdb20000 0x0 0x1000>;
	};

	dbg_apmcu_mp1@0db30000 {
		compatible = "mediatek,dbg_apmcu_mp1";
		reg = <0x0 0xdb30000 0x0 0x1000>;
	};

	dbg_apmcu_mp1@0db40000 {
		compatible = "mediatek,dbg_apmcu_mp1";
		reg = <0x0 0xdb40000 0x0 0x1000>;
	};

	dbg_cti@0d020000 {
		compatible = "mediatek,dbg_cti";
		reg = <0x0 0xd020000 0x0 0x10000>;
	};

	dbg_dem@0d0a0000 {
		compatible = "mediatek,dbg_dem";
		interrupts = <0x0 0x8c 0x8>;
		reg = <0x0 0xd0a0000 0x0 0x10000>;
	};

	dbg_etr@0d030000 {
		compatible = "mediatek,dbg_etr";
		reg = <0x0 0xd030000 0x0 0x10000>;
	};

	dbg_funnel@0d040000 {
		compatible = "mediatek,dbg_funnel";
		reg = <0x0 0xd040000 0x0 0x10000>;
	};

	dbg_mdsys1@0d0c0000 {
		compatible = "mediatek,dbg_mdsys1";
		reg = <0x0 0xd0c0000 0x0 0x40000>;
	};

	dcm@10001000 {
		compatible = "mediatek,mt6765-dcm";
		phandle = <0x6d>;
		reg = <0x0 0x10001000 0x0 0x1000 0x0 0x10200000 0x0 0x1000 0x0 0x10200000 0x0 0x1000 0x0 0x10200200 0x0 0x1000 0x0 0x10200400 0x0 0x1000 0x0 0x1022d000 0x0 0x1000 0x0 0x10235000 0x0 0x1000 0x0 0x10238000 0x0 0x1000 0x0 0x11220000 0x0 0x1000 0x0 0x11c50000 0x0 0x1000 0x0 0x13000000 0x0 0x1000 0x0 0x14000000 0x0 0x1000 0x0 0x14002000 0x0 0x1000 0x0 0x14003000 0x0 0x1000 0x0 0x15021000 0x0 0x1000 0x0 0x17010000 0x0 0x1000 0x0 0x17020000 0x0 0x1000 0x0 0x17030000 0x0 0x1000>;
		reg-names = "infracfg_ao", "mcucfg", "mp0_cpucfg", "mp1_cpucfg", "mcu_misccfg", "chn0_emi", "chn1_emi", "gce", "audio", "efusec", "mfgcfg", "mmsys_config", "smi_common", "smi_larb0", "smi_larb2", "smi_larb1", "venc", "jpgenc";
	};

	ddrphy@10015000 {
		compatible = "mediatek,ddrphy";
		reg = <0x0 0x10015000 0x0 0x1000>;
	};

	ddrphy@1001e000 {
		compatible = "mediatek,ddrphy";
		reg = <0x0 0x1001e000 0x0 0x1000>;
	};

	devapc@10207000 {
		clock-names = "devapc-infra-clock";
		clocks = <0x25 0x28>;
		compatible = "mediatek,devapc";
		interrupts = <0x0 0x8e 0x8>;
		reg = <0x0 0x10207000 0x0 0x1000>;
	};

	dfd@10200b00 {
		compatible = "mediatek,dfd";
		mediatek,chain_length = <0xc350>;
		mediatek,check_dfd_support = <0x1>;
		mediatek,dfd_ap_addr_offset = <0x18>;
		mediatek,dfd_infra_base = <0x390>;
		mediatek,dfd_latch_offset = <0x48>;
		mediatek,enabled = <0x1>;
		mediatek,rg_dfd_timeout = <0xa0>;
		reg = <0x0 0x10200b00 0x0 0x10000>;
		reg_base = <0x47>;
	};

	dip1@15022000 {
		compatible = "mediatek,dip1";
		interrupts = <0x0 0xff 0x8>;
		reg = <0x0 0x15022000 0x0 0x3000>;
	};

	disp_aal0@14011000 {
		compatible = "mediatek,disp_aal0";
		interrupts = <0x0 0xde 0x8>;
		reg = <0x0 0x14011000 0x0 0x1000>;
	};

	disp_ccorr0@14010000 {
		compatible = "mediatek,disp_ccorr0";
		interrupts = <0x0 0xdd 0x8>;
		reg = <0x0 0x14010000 0x0 0x1000>;
	};

	disp_color0@1400f000 {
		clock-names = "MDP_COLOR";
		clocks = <0x60 0xc>;
		compatible = "mediatek,disp_color0";
		interrupts = <0x0 0xdc 0x8>;
		phandle = <0x43>;
		reg = <0x0 0x1400f000 0x0 0x1000>;
	};

	disp_dither0@14013000 {
		compatible = "mediatek,disp_dither0";
		interrupts = <0x0 0xe0 0x8>;
		reg = <0x0 0x14013000 0x0 0x1000>;
	};

	disp_gamma0@14012000 {
		compatible = "mediatek,disp_gamma0";
		interrupts = <0x0 0xdf 0x8>;
		reg = <0x0 0x14012000 0x0 0x1000>;
	};

	disp_mutex0@14001000 {
		compatible = "mediatek,disp_mutex0";
		interrupts = <0x0 0xd2 0x8>;
		phandle = <0x45>;
		reg = <0x0 0x14001000 0x0 0x1000>;
	};

	disp_ovl0@1400b000 {
		compatible = "mediatek,disp_ovl0";
		interrupts = <0x0 0xd9 0x8>;
		reg = <0x0 0x1400b000 0x0 0x1000>;
	};

	disp_ovl0_2l@1400c000 {
		compatible = "mediatek,disp_ovl0_2l";
		interrupts = <0x0 0xe5 0x8>;
		reg = <0x0 0x1400c000 0x0 0x1000>;
	};

	disp_pwm@1100e000 {
		compatible = "mediatek,disp_pwm";
		reg = <0x0 0x1100e000 0x0 0x1000>;
	};

	disp_rdma0@1400d000 {
		compatible = "mediatek,disp_rdma0";
		interrupts = <0x0 0xda 0x8>;
		reg = <0x0 0x1400d000 0x0 0x1000>;
	};

	disp_rsz0@14015000 {
		compatible = "mediatek,disp_rsz0";
		interrupts = <0x0 0x114 0x8>;
		reg = <0x0 0x14015000 0x0 0x1000>;
	};

	disp_wdma0@1400e000 {
		compatible = "mediatek,disp_wdma0";
		interrupts = <0x0 0xdb 0x8>;
		reg = <0x0 0x1400e000 0x0 0x1000>;
	};

	dispsys {
		clock-names = "MMSYS_MTCMOS", "MMSYS_SMI_COMMON", "MMSYS_SMI_LARB0", "MMSYS_GALS_COMM0", "MMSYS_GALS_COMM1", "MMSYS_DISP_OVL0", "MMSYS_DISP_OVL0_2L", "MMSYS_DISP_RDMA0", "MMSYS_DISP_WDMA0", "MMSYS_DISP_COLOR0", "MMSYS_DISP_CCORR0", "MMSYS_DISP_AAL0", "MMSYS_DISP_GAMMA0", "MMSYS_DISP_DITHER0", "MMSYS_DSI0_MM_CK", "MMSYS_DSI0_IF_CK", "MMSYS_26M", "MMSYS_DISP_RSZ0", "APMIXED_MIPI_26M", "TOP_MUX_DISP_PWM", "DISP_PWM", "TOP_26M", "TOP_UNIVPLL2_D4", "TOP_ULPOSC1_D2", "TOP_ULPOSC1_D8";
		clocks = <0x36 0x3 0x60 0x13 0x60 0x14 0x60 0x15 0x60 0x16 0x60 0x7 0x60 0x8 0x60 0xa 0x60 0xb 0x60 0xc 0x60 0xd 0x60 0xe 0x60 0xf 0x60 0x10 0x60 0x11 0x60 0x1c 0x60 0x1d 0x60 0x9 0x3 0x15 0x26 0x73 0x25 0x31 0x24 0x26 0x1b 0x26 0x2e 0x26 0x30>;
		compatible = "mediatek,dispsys";
	};

	dispsys_config@14000000 {
		clock-names = "CAM_MDP", "IMG_DL_RELAY", "IMG_DL_ASYNC_TOP";
		clocks = <0x60 0x17 0x60 0x1a 0x60 0x1b>;
		compatible = "mediatek,mmsys_config", "syscon";
		interrupts = <0x0 0xab 0x8>;
		phandle = <0x3c>;
		reg = <0x0 0x14000000 0x0 0x1000>;
	};

	dma-controller@11000580 {
		#dma-cells = <0x1>;
		clock-names = "apdma";
		clocks = <0x25 0x26>;
		compatible = "mediatek,mt6577-uart-dma";
		dma-requests = <0x4>;
		interrupts = <0x0 0x6d 0x8 0x0 0x6e 0x8 0x0 0x6f 0x8 0x0 0x74 0x8>;
		phandle = <0x48>;
		reg = <0x0 0x11000680 0x0 0x80 0x0 0x11000700 0x0 0x80 0x0 0x11000780 0x0 0x80 0x0 0x11000800 0x0 0x80>;
	};

	dpe@15028000 {
		clock-names = "DPE_CG_IMG_DPE";
		clocks = <0x61 0x3>;
		compatible = "mediatek,dpe";
		interrupts = <0x0 0x100 0x8>;
		reg = <0x0 0x15028000 0x0 0x1000>;
	};

	dram_ctrl {
		compatible = "mediatek,dram-qosctrl";
		required-opps = <0x32 0x33>;
	};

	dramc0@1001d000 {
		compatible = "mediatek,dramc0";
		reg = <0x0 0x1001d000 0x0 0x1000>;
	};

	dramc@1022a000 {
		compatible = "mediatek,dramc";
		reg = <0x0 0x1022a000 0x0 0x2000 0x0 0x10232000 0x0 0x2000 0x0 0x1022c000 0x0 0x1000 0x0 0x10234000 0x0 0x1000 0x0 0x10228000 0x0 0x2000 0x0 0x10230000 0x0 0x2000 0x0 0x1022e000 0x0 0x1000 0x0 0x10236000 0x0 0x1000>;
	};

	dramc_nao@1021d000 {
		compatible = "mediatek,dramc_nao";
		reg = <0x0 0x1021d000 0x0 0x1000>;
	};

	dsi0@14014000 {
		compatible = "mediatek,dsi0";
		interrupts = <0x0 0xe1 0x8>;
		reg = <0x0 0x14014000 0x0 0x1000>;
	};

	dsi_te {
		compatible = "mediatek, DSI_TE-eint";
		phandle = <0xcf>;
		status = "disabled";
	};

	dvfsp@00110c00 {
		B-table = <0x898 0x64 0x1 0x1 0x855 0x60 0x1 0x1 0x812 0x5c 0x1 0x1 0x7d0 0x58 0x1 0x1 0x78d 0x54 0x1 0x1 0x74a 0x50 0x1 0x1 0x708 0x4b 0x1 0x1 0x673 0x46 0x1 0x1 0x5df 0x40 0x1 0x1 0x586 0x3d 0x2 0x1 0x50f 0x39 0x2 0x1 0x498 0x35 0x2 0x1 0x43f 0x31 0x2 0x1 0x3e6 0x2e 0x2 0x1 0x38d 0x2b 0x2 0x1 0x352 0x28 0x2 0x1>;
		CCI-table = <0x578 0x60 0x2 0x1 0x549 0x5c 0x2 0x1 0x51a 0x58 0x2 0x1 0x4ec 0x54 0x2 0x1 0x4a6 0x4e 0x2 0x1 0x483 0x4b 0x2 0x1 0x460 0x47 0x2 0x1 0x3d8 0x40 0x2 0x1 0x395 0x3e 0x2 0x1 0x33b 0x3a 0x2 0x1 0x2e1 0x36 0x2 0x2 0x29d 0x33 0x2 0x2 0x243 0x2f 0x2 0x2 0x200 0x2c 0x2 0x2 0x1bd 0x29 0x2 0x2 0x190 0x26 0x2 0x2>;
		L-table = <0x7d0 0x60 0x1 0x1 0x78d 0x5c 0x1 0x1 0x74a 0x58 0x1 0x1 0x708 0x53 0x1 0x1 0x6c5 0x50 0x1 0x1 0x682 0x4b 0x1 0x1 0x60c 0x47 0x1 0x1 0x5c3 0x42 0x2 0x1 0x55f 0x40 0x2 0x1 0x4fb 0x3a 0x2 0x1 0x497 0x36 0x2 0x1 0x433 0x31 0x2 0x1 0x3e7 0x2e 0x2 0x1 0x39d 0x2b 0x2 0x1 0x352 0x28 0x2 0x1 0x306 0x26 0x2 0x1>;
		big-down-time = <0x2ee>;
		big-rise-time = <0x3e8>;
		change_flag = <0x0>;
		compatible = "mediatek,mt6765-dvfsp";
		little-down-time = <0x2ee>;
		little-rise-time = <0x3e8>;
		nvmem-cell-names = "efuse_segment_cell", "efuse_ly_cell";
		nvmem-cells = <0x39 0x3a>;
		reg = <0x0 0x110c00 0x0 0x1400 0x0 0x110c00 0x0 0x1400>;
		state = <0x1>;
	};

	dvfsp@10227000 {
		compatible = "mediatek,dvfsp";
		reg = <0x0 0x10227000 0x0 0x1000>;
	};

	dvfsrc@10012000 {
		#address-cells = <0x2>;
		#size-cells = <0x2>;
		compatible = "mediatek,mt6765-dvfsrc";
		phandle = <0x9f>;
		ranges;
		reg = <0x0 0x10012000 0x0 0x1000 0x0 0x10006000 0x0 0x1000>;
		reg-names = "dvfsrc", "spm";

		dvfsrc-debug {
			compatible = "mediatek,mt6765-dvfsrc-debug";
			required-opps = <0x32 0x33 0x34>;
		};

		dvfsrc-met {
			compatible = "mediatek,mt6765-dvfsrc-met";
		};

		dvfsrc-up {
			compatible = "mediatek,mt6765-dvfsrc-up";
		};

		opp0 {
			opp-level = <0x0>;
			phandle = <0x32>;
		};

		opp1 {
			opp-level = <0x1>;
			phandle = <0x33>;
		};

		opp2 {
			opp-level = <0x2>;
			phandle = <0x34>;
		};

		qos@00110b80 {
			compatible = "mediatek,mt6765-qos";
			reg = <0x0 0x110b80 0x0 0x80>;
		};
	};

	dxcc_sec@10210000 {
		compatible = "mediatek,dxcc_sec";
		interrupts = <0x0 0xa2 0x4>;
		reg = <0x0 0x10210000 0x0 0x1000>;
	};

	dynamic_options {
		compatible = "mediatek,dynamic_options";
		phandle = <0xe7>;
	};

	eas {
		eff_turn_point = <0x1d3>;
		tiny = <0x32>;
	};

	eem_fsm@1100b000 {
		compatible = "mediatek,eem_fsm";
		interrupts = <0x0 0x7d 0x8>;
		nvmem = <0x3b>;
		nvmem-cell-names = "efuse_segment_cell";
		nvmem-cells = <0x39>;
		nvmem-names = "mtk_efuse";
		reg = <0x0 0x1100b000 0x0 0x1000>;
	};

	efuse@11c50000 {
		#address-cells = <0x1>;
		#size-cells = <0x1>;
		compatible = "mediatek,devinfo";
		phandle = <0x3b>;
		reg = <0x0 0x11c50000 0x0 0x10000>;

		ly@210 {
			phandle = <0x3a>;
			reg = <0x210 0x4>;
		};

		segment@190 {
			phandle = <0x4a>;
			reg = <0x190 0xc>;
		};

		segment@1c {
			phandle = <0x49>;
			reg = <0x1c 0x4>;
		};

		segment@78 {
			phandle = <0x39>;
			reg = <0x78 0x4>;
		};

		u2_phy_data@1ac {
			phandle = <0x4f>;
			reg = <0x1ac 0x4>;
		};
	};

	efuse_dbg@10004000 {
		compatible = "mediatek,efuse_dbg";
		reg = <0x0 0x10004000 0x0 0x1000>;
	};

	eint@1000b000 {
		compatible = "mediatek,eint";
		phandle = <0x70>;
		reg = <0x0 0x1000b000 0x0 0x1000>;
	};

	emi@10219000 {
		compatible = "mediatek,emi";
		interrupts = <0x0 0x90 0x8>;
		reg = <0x0 0x10219000 0x0 0x1000 0x0 0x10226000 0x0 0x1000 0x0 0x1022d000 0x0 0x1000 0x0 0x10235000 0x0 0x1000>;
	};

	extcon_usb {
		charger = <0x29>;
		compatible = "mediatek,extcon-usb";
		dev-conn = <0x67>;
		mediatek,bypss-typec-sink = <0x1>;
		phandle = <0xe0>;
	};

	fdvt@1502b000 {
		clock-names = "FD_CLK_IMG_FDVT";
		clocks = <0x61 0x2>;
		compatible = "mediatek,fdvt";
		interrupts = <0x0 0x102 0x8>;
		reg = <0x0 0x1502b000 0x0 0x1000>;
	};

	fhctl@1000ce00 {
		compatible = "mediatek,mt6765-fhctl";
		mediatek,apmixed = <0x3>;
		reg = <0x0 0x1000ce00 0x0 0x100>;

		armpll {
			mediatek,fh-cpu-pll;
			mediatek,fh-id = <0x0>;
			mediatek,fh-pll-id = <0x1>;
		};

		armpll_l {
			mediatek,fh-cpu-pll;
			mediatek,fh-id = <0x7>;
			mediatek,fh-pll-id = <0x0>;
		};

		mainpll {
			mediatek,fh-id = <0x1>;
			mediatek,fh-pll-id = <0x3>;
		};

		mfgpll {
			mediatek,fh-id = <0x3>;
			mediatek,fh-pll-id = <0x4>;
		};

		mmpll {
			mediatek,fh-id = <0x6>;
			mediatek,fh-pll-id = <0x5>;
		};

		mpll {
			mediatek,fh-id = <0x5>;
			mediatek,fh-pll-id = <0x9>;
		};

		msdcpll {
			mediatek,fh-id = <0x2>;
			mediatek,fh-pll-id = <0x7>;
		};
	};

	fingerprint {
		compatible = "mediatek,mt6765-fingerprint";
		phandle = <0x9e>;
	};

	flashlight_core {
		compatible = "mediatek,flashlight_core";
		phandle = <0xd7>;
	};

	flashlights_mt6370 {
		compatible = "mediatek,flashlights_mt6370";
		decouple = <0x0>;
		phandle = <0xd8>;

		channel@1 {
			ct = <0x0>;
			part = <0x0>;
			type = <0x0>;
		};

		channel@2 {
			ct = <0x1>;
			part = <0x0>;
			type = <0x0>;
		};
	};

	flashlights_ocp8132a {
		compatible = "mediatek,flashlights_ocp8132a";
		phandle = <0xd9>;
	};

	gce@10238000 {
		ap_dma_base = <0x18010000 0x17 0xffff0000>;
		audio_base = <0x17000000 0x12 0xffff0000>;
		buf_underrun_event_0 = <0x8c>;
		camsys1_base = <0x180a0000 0x1c 0xffff0000>;
		camsys2_base = <0x180b0000 0x1d 0xffff0000>;
		camsys_base = <0x18080000 0x1b 0xffff0000>;
		clock-names = "GCE", "GCE_TIMER";
		clocks = <0x25 0x9 0x25 0x18>;
		compatible = "mediatek,gce", "syscon";
		conn_peri_base = <0x18820000 0x7 0xffff0000>;
		dip_cq_thread0_frame_done = <0x101>;
		dip_cq_thread10_frame_done = <0x10b>;
		dip_cq_thread11_frame_done = <0x10c>;
		dip_cq_thread12_frame_done = <0x10d>;
		dip_cq_thread13_frame_done = <0x10e>;
		dip_cq_thread14_frame_done = <0x10f>;
		dip_cq_thread15_frame_done = <0x110>;
		dip_cq_thread16_frame_done = <0x111>;
		dip_cq_thread17_frame_done = <0x112>;
		dip_cq_thread18_frame_done = <0x113>;
		dip_cq_thread1_frame_done = <0x102>;
		dip_cq_thread2_frame_done = <0x103>;
		dip_cq_thread3_frame_done = <0x104>;
		dip_cq_thread4_frame_done = <0x105>;
		dip_cq_thread5_frame_done = <0x106>;
		dip_cq_thread6_frame_done = <0x107>;
		dip_cq_thread7_frame_done = <0x108>;
		dip_cq_thread8_frame_done = <0x109>;
		dip_cq_thread9_frame_done = <0x10a>;
		disp_2l_ovl0_frame_done = <0x1c>;
		disp_2l_ovl0_sof = <0x8>;
		disp_aal0_frame_done = <0x22>;
		disp_aal0_sof = <0xd>;
		disp_ccorr0_frame_done = <0x21>;
		disp_ccorr0_sof = <0xc>;
		disp_color0_frame_done = <0x20>;
		disp_color0_sof = <0xb>;
		disp_dither0_frame_done = <0x24>;
		disp_dither0_sof = <0xf>;
		disp_dither_base = <0x14010000 0x2 0xffff0000>;
		disp_dsi0_frame_done = <0x25>;
		disp_dsi0_sof = <0x10>;
		disp_gamma0_frame_done = <0x23>;
		disp_gamma0_sof = <0xe>;
		disp_ovl0_frame_done = <0x1b>;
		disp_ovl0_frame_rst_done_pusle = <0x98>;
		disp_ovl0_sof = <0x7>;
		disp_pwm0_sof = <0x13>;
		disp_rdma0_frame_done = <0x1e>;
		disp_rdma0_sof = <0x9>;
		disp_rsz0_frame_done = <0x1d>;
		disp_rsz0_sof = <0x11>;
		disp_wdma0_frame_done = <0x1f>;
		disp_wdma0_rst_done = <0x93>;
		disp_wdma0_sof = <0xa>;
		dsi0_done_event = <0x8f>;
		dsi0_irq_event = <0x8e>;
		dsi0_te_event = <0x8d>;
		dve_frame_done = <0x114>;
		g3d_config_base = <0x13000000 0x0 0xffff0000>;
		gce_base = <0x18020000 0x18 0xffff0000>;
		gcpu_base = <0x10050000 0xf 0xffff0000>;
		img_dl_relay_sof = <0x12>;
		imgsys_base = <0x15020000 0x4 0xffff0000>;
		infra_na3_base = <0x10010000 0xb 0xffff0000>;
		infra_na4_base = <0x10020000 0xc 0xffff0000>;
		interrupts = <0x0 0x9a 0x8 0x0 0x9b 0x8>;
		jpgdec_done = <0x123>;
		jpgenc_done = <0x122>;
		kp_base = <0x18840000 0x9 0xffff0000>;
		max_prefetch_cnt = <0x1>;
		mboxes = <0x46 0x0 0x0 0x4 0x46 0x1 0x0 0x4 0x46 0x2 0x0 0x5 0x46 0x3 0x0 0x4 0x46 0x4 0x0 0x4 0x46 0x5 0x0 0x4 0x46 0x6 0x0 0x4 0x46 0x7 0xffffffff 0x2 0x46 0x8 0x0 0x1 0x46 0x9 0x0 0x1 0x46 0xa 0x0 0x1 0x46 0xb 0x0 0x1 0x46 0xc 0x0 0x1 0x46 0xd 0x0 0x1 0x46 0xe 0x0 0x1 0x46 0xf 0x0 0x1>;
		mcucfg_base = <0x10040000 0xe 0xffff0000>;
		mdp_ccorr0 = <0x44>;
		mdp_ccorr0_frame_done = <0x15>;
		mdp_ccorr0_sof = <0x1>;
		mdp_color0 = <0x43>;
		mdp_rdma0 = <0x3d>;
		mdp_rdma0_frame_done = <0x14>;
		mdp_rdma0_rst_done = <0x97>;
		mdp_rdma0_sof = <0x0>;
		mdp_rsz0 = <0x3e>;
		mdp_rsz0_frame_done = <0x16>;
		mdp_rsz0_sof = <0x2>;
		mdp_rsz1 = <0x3f>;
		mdp_rsz1_frame_done = <0x17>;
		mdp_rsz1_sof = <0x3>;
		mdp_tdshp0 = <0x42>;
		mdp_tdshp0_frame_done = <0x1a>;
		mdp_tdshp0_sof = <0x6>;
		mdp_wdma0 = <0x40>;
		mdp_wdma_frame_done = <0x19>;
		mdp_wdma_rst_done = <0x94>;
		mdp_wdma_sof = <0x4>;
		mdp_wrot0 = <0x41>;
		mdp_wrot0_rst_done = <0x95>;
		mdp_wrot0_sof = <0x5>;
		mdp_wrot0_write_frame_done = <0x18>;
		mediatek,mailbox-gce = <0x46>;
		mipitx0_base = <0x11c80000 0x63 0xffff0000>;
		mm_mutex = <0x45>;
		mm_na_base = <0x14020000 0x3 0xffff0000>;
		mmsys_config = <0x3c>;
		mmsys_config_base = <0x14000000 0x1 0xffff0000>;
		msdc2_base = <0x17020000 0x14 0xffff0000>;
		msdc3_base = <0x18000000 0x16 0xffff0000>;
		phandle = <0xa5>;
		prefetch_size = <0x60>;
		pwm_sw_base = <0x1100e000 0x63 0xffff0000>;
		reg = <0x0 0x10238000 0x0 0x4000>;
		rsc_frame_done = <0x116>;
		scp_base = <0x10030000 0xd 0xffff0000>;
		scp_sram_base = <0x10000000 0xa 0xffff0000>;
		sram_share_cnt = <0x1>;
		sram_share_engine = <0xa>;
		sram_share_event = <0x2c6>;
		sram_size_cpr_64 = <0x40>;
		stream_done_0 = <0x82>;
		stream_done_1 = <0x83>;
		stream_done_2 = <0x84>;
		stream_done_3 = <0x85>;
		stream_done_4 = <0x86>;
		stream_done_5 = <0x87>;
		stream_done_6 = <0x88>;
		stream_done_7 = <0x89>;
		stream_done_8 = <0x8a>;
		stream_done_9 = <0x8b>;
		topckgen_base = <0x18830000 0x8 0xffff0000>;
		usb0_base = <0x10200000 0x10 0xffff0000>;
		usb_sif_base = <0x10280000 0x11 0xffff0000>;
		vdec1_base = <0x17030000 0x15 0xffff0000>;
		vdec2_base = <0x18040000 0x19 0xffff0000>;
		vdec3_base = <0x18050000 0x1a 0xffff0000>;
		vdec_base = <0x17010000 0x13 0xffff0000>;
		vdec_gcon_base = <0x18800000 0x5 0xffff0000>;
		venc_128byte_cnt_done = <0x125>;
		venc_done = <0x121>;
		venc_gcon_base = <0x18810000 0x6 0xffff0000>;
		venc_mb_done = <0x124>;
		wmf_frame_done = <0x115>;
	};

	gce_mbox@10238000 {
		#gce-event-cells = <0x1>;
		#gce-subsys-cells = <0x2>;
		#mbox-cells = <0x3>;
		clock-names = "gce", "gce-timer";
		clocks = <0x25 0x9 0x25 0x18>;
		compatible = "mediatek,mt6761-gce";
		default_tokens = [02 bc 02 bd 02 be 02 bf 02 c0 02 c6 02 c7];
		interrupts = <0x0 0x9a 0x8 0x0 0x9b 0x8>;
		phandle = <0x46>;
		reg = <0x0 0x10238000 0x0 0x4000>;
	};

	gce_mbox_svp@10238000 {
		#mbox-cells = <0x3>;
		clock-names = "gce", "GCE_TIMER";
		clocks = <0x25 0x9 0x25 0x18>;
		compatible = "mediatek,mailbox-gce-svp";
		interrupts = <0x0 0x9a 0x8 0x0 0x9b 0x8>;
		phandle = <0xa6>;
		reg = <0x0 0x10238000 0x0 0x4000>;
	};

	ged {
		compatible = "mediatek,ged";
		gpufreq-supply = <0x5f>;
		phandle = <0x5e>;
	};

	gic500@0c000000 {
		compatible = "mediatek,gic500";
		reg = <0x0 0xc000000 0x0 0x1000>;
	};

	gic_cpu@0c400000 {
		compatible = "mediatek,gic_cpu";
		reg = <0x0 0xc400000 0x0 0x40000>;
	};

	gpio {
		compatible = "mediatek,gpio_usage_mapping";
		phandle = <0x6f>;
	};

	gpio@10005000 {
		compatible = "mediatek,gpio", "syscon";
		phandle = <0x17>;
		reg = <0x0 0x10005000 0x0 0x1000>;
	};

	gps {
		compatible = "mediatek,gps";
	};

	gpufreq {
		clock-names = "clk_mux", "clk_main_parent", "clk_sub_parent", "mtcmos_mfg_async", "mtcmos_mfg", "mtcmos_mfg_core0";
		clocks = <0x26 0x64 0x26 0x26 0x24 0x36 0x8 0x36 0x4 0x36 0x7>;
		compatible = "mediatek,mt6765-gpufreq";
		nvmem-cell-names = "efuse_segment_cell";
		nvmem-cells = <0x39>;
		phandle = <0x5f>;
		vcore-supply = <0x38>;
	};

	hacc@1000a000 {
		compatible = "mediatek,hacc";
		interrupts = <0x0 0xbd 0x8>;
		reg = <0x0 0x1000a000 0x0 0x1000>;
	};

	hwrng {
		compatible = "mediatek,mt67xx-rng";
		phandle = <0xa1>;
	};

	i2c0@11007000 {
		aed = <0x1a>;
		clock-div = <0x5>;
		clock-names = "main", "dma";
		clocks = <0x25 0xb 0x25 0x26>;
		compatible = "mediatek,i2c";
		eh_cfg = <0x20>;
		gpio_start = <0x10002a00>;
		id = <0x0>;
		interrupts = <0x0 0x54 0x8>;
		mediatek,hs_only;
		mem_len = <0x200>;
		phandle = <0xaa>;
		pu_cfg = <0x50>;
		reg = <0x0 0x11007000 0x0 0x1000 0x0 0x11000080 0x0 0x80>;
		rsel_cfg = <0x70>;
		scl-gpio-id = <0x53>;
		sda-gpio-id = <0x52>;
	};

	i2c1@11008000 {
		aed = <0x1a>;
		clock-div = <0x5>;
		clock-names = "main", "dma";
		clocks = <0x25 0xb 0x25 0x26>;
		compatible = "mediatek,i2c";
		eh_cfg = <0x20>;
		gpio_start = <0x10002a00>;
		id = <0x1>;
		interrupts = <0x0 0x55 0x8>;
		mediatek,hs_only;
		mem_len = <0x200>;
		phandle = <0xab>;
		pu_cfg = <0x50>;
		reg = <0x0 0x11008000 0x0 0x1000 0x0 0x11000100 0x0 0x80>;
		rsel_cfg = <0x70>;
		scl-gpio-id = <0x54>;
		sda-gpio-id = <0x51>;
	};

	i2c2@11009000 {
		aed = <0x1a>;
		ch_offset_ccu = <0x200>;
		ch_offset_default = <0x100>;
		clock-div = <0x5>;
		clock-names = "main", "dma";
		clocks = <0x25 0xb 0x25 0x26>;
		compatible = "mediatek,i2c";
		eh_cfg = <0x20>;
		gpio_start = <0x10002800>;
		id = <0x2>;
		interrupts = <0x0 0x56 0x8>;
		mediatek,hs_only;
		mem_len = <0x200>;
		phandle = <0xac>;
		pu_cfg = <0x60>;
		reg = <0x0 0x11009000 0x0 0x1000 0x0 0x11000180 0x0 0x180>;
		rsel_cfg = <0xa0>;
		scl-gpio-id = <0x67>;
		sda-gpio-id = <0x68>;
	};

	i2c3@1100f000 {
		aed = <0x1a>;
		ch_offset_default = <0x100>;
		clock-div = <0x5>;
		clock-names = "main", "dma";
		clocks = <0x25 0xb 0x25 0x26>;
		compatible = "mediatek,i2c";
		eh_cfg = <0x20>;
		gpio_start = <0x10002600>;
		id = <0x3>;
		interrupts = <0x0 0x57 0x8>;
		mediatek,hs_only;
		mem_len = <0x200>;
		phandle = <0xad>;
		pu_cfg = <0x90>;
		reg = <0x0 0x1100f000 0x0 0x1000 0x0 0x11000300 0x0 0x100>;
		rsel_cfg = <0xb0>;
		scl-gpio-id = <0x32>;
		sda-gpio-id = <0x33>;
	};

	i2c4@11011000 {
		aed = <0x1a>;
		ch_offset_ccu = <0x200>;
		ch_offset_default = <0x100>;
		clock-div = <0x5>;
		clock-names = "main", "dma";
		clocks = <0x25 0xb 0x25 0x26>;
		compatible = "mediatek,i2c";
		eh_cfg = <0x20>;
		gpio_start = <0x10002800>;
		id = <0x4>;
		interrupts = <0x0 0x58 0x8>;
		mediatek,hs_only;
		mem_len = <0x200>;
		phandle = <0xae>;
		pu_cfg = <0x60>;
		reg = <0x0 0x11011000 0x0 0x1000 0x0 0x11000400 0x0 0x180>;
		rsel_cfg = <0xa0>;
		scl-gpio-id = <0x69>;
		sda-gpio-id = <0x6a>;
	};

	i2c5@11016000 {
		aed = <0x1a>;
		clock-div = <0x5>;
		clock-names = "main", "dma";
		clocks = <0x25 0xb 0x25 0x26>;
		compatible = "mediatek,i2c";
		eh_cfg = <0x20>;
		gpio_start = <0x10002600>;
		id = <0x5>;
		interrupts = <0x0 0x82 0x8>;
		mediatek,hs_only;
		mem_len = <0x200>;
		phandle = <0xaf>;
		pu_cfg = <0x90>;
		reg = <0x0 0x11016000 0x0 0x1000 0x0 0x11000580 0x0 0x80>;
		rsel_cfg = <0xb0>;
		scl-gpio-id = <0x30>;
		sda-gpio-id = <0x31>;
	};

	i2c6@1100d000 {
		aed = <0x1a>;
		ch_offset_ccu = <0x200>;
		ch_offset_default = <0x100>;
		clock-div = <0x5>;
		clock-names = "main", "dma";
		clocks = <0x25 0xb 0x25 0x26>;
		compatible = "mediatek,i2c";
		eh_cfg = <0x20>;
		gpio_start = <0x10002c00>;
		id = <0x6>;
		interrupts = <0x0 0x83 0x8>;
		mediatek,hs_only;
		mem_len = <0x200>;
		phandle = <0xb0>;
		pu_cfg = <0x50>;
		reg = <0x0 0x1100d000 0x0 0x1000 0x0 0x11000600 0x0 0x80>;
		rsel_cfg = <0x70>;
		scl-gpio-id = <0xa1>;
		sda-gpio-id = <0xa2>;
	};

	i2c7 {
		phandle = <0xe9>;
	};

	i2c8 {
		phandle = <0xea>;
	};

	i2c9 {
		phandle = <0xeb>;
	};

	i2c_common {
		check_max_freq = [01];
		cnt_constraint = [01];
		compatible = "mediatek,i2c_common";
		dma_support = [02];
		ext_time_config = [18 01];
		idvfs = [01];
		phandle = <0xa9>;
		set_dt_div = [01];
		set_ltiming = [01];
		ver = [02];
	};

	imgsys@15020000 {
		clock-names = "ISP_SCP_SYS_DIS", "ISP_SCP_SYS_ISP", "ISP_SCP_SYS_CAM", "ISP_CLK_IMG_DIP", "ISP_CLK_CAM", "ISP_CLK_CAMTG", "ISP_CLK_CAM_SENINF", "ISP_CLK_CAMSV0", "ISP_CLK_CAMSV1", "ISP_CLK_CAMSV2";
		clocks = <0x36 0x3 0x36 0x5 0x36 0x9 0x61 0x1 0x62 0x2 0x62 0x3 0x62 0x4 0x62 0x5 0x62 0x6 0x62 0x7>;
		compatible = "mediatek,imgsys", "syscon";
		reg = <0x0 0x15020000 0x0 0x1000>;
	};

	imgsys_clk@15020000 {
		#clock-cells = <0x1>;
		compatible = "mediatek,mt6765-imgsys", "syscon";
		phandle = <0x61>;
		reg = <0x0 0x15020000 0x0 0x1000>;
	};

	imp_iic@11017000 {
		compatible = "mediatek,imp_iic";
		reg = <0x0 0x11017000 0x0 0x1000>;
	};

	infra_mbist@1020d000 {
		compatible = "mediatek,infra_mbist";
		reg = <0x0 0x1020d000 0x0 0x1000>;
	};

	infracfg@1020e000 {
		compatible = "mediatek,infracfg";
		reg = <0x0 0x1020e000 0x0 0x1000>;
	};

	infracfg_ao@10001000 {
		#clock-cells = <0x1>;
		compatible = "mediatek,common-infracfg_ao", "mediatek,mt6765-infracfg", "syscon";
		interrupts = <0x0 0x93 0x1>;
		phandle = <0x25>;
		reg = <0x0 0x10001000 0x0 0x1000>;
	};

	interrupt-controller@0c000000 {
		#address-cells = <0x2>;
		#interrupt-cells = <0x3>;
		#redistributor-regions = <0x1>;
		#size-cells = <0x2>;
		compatible = "arm,gic-v3";
		interrupt-controller;
		interrupt-parent = <0x16>;
		interrupts = <0x1 0x9 0x4>;
		phandle = <0x16>;
		reg = <0x0 0xc000000 0x0 0x40000 0x0 0xc100000 0x0 0x200000 0x0 0x10200a80 0x0 0x50>;
	};

	intpol-controller@10200a80 {
		#interrupt-cells = <0x3>;
		compatible = "mediatek,mt6577-sysirq";
		interrupt-controller;
		interrupt-parent = <0x16>;
		phandle = <0x1>;
		reg = <0x0 0x10200a80 0x0 0x50>;
	};

	io_cfg_bl@10002600 {
		compatible = "mediatek,io_cfg_bl";
		phandle = <0x1b>;
		reg = <0x0 0x10002600 0x0 0x200>;
	};

	io_cfg_lb@10002400 {
		compatible = "mediatek,io_cfg_lb";
		phandle = <0x1a>;
		reg = <0x0 0x10002400 0x0 0x200>;
	};

	io_cfg_lm@10002200 {
		compatible = "mediatek,io_cfg_lm";
		phandle = <0x19>;
		reg = <0x0 0x10002200 0x0 0x200>;
	};

	io_cfg_lt@10002000 {
		compatible = "mediatek,io_cfg_lt";
		phandle = <0x18>;
		reg = <0x0 0x10002000 0x0 0x200>;
	};

	io_cfg_rb@10002a00 {
		compatible = "mediatek,io_cfg_rb";
		phandle = <0x1d>;
		reg = <0x0 0x10002a00 0x0 0x200>;
	};

	io_cfg_rr@10002800 {
		compatible = "mediatek,io_cfg_rr";
		phandle = <0x1c>;
		reg = <0x0 0x10002800 0x0 0x200>;
	};

	io_cfg_rt@10002c00 {
		compatible = "mediatek,io_cfg_rt";
		phandle = <0x1e>;
		reg = <0x0 0x10002c00 0x0 0x200>;
	};

	irq_nfc {
		compatible = "mediatek,irq_nfc-eint";
		phandle = <0xca>;
	};

	irtx_pwm {
		compatible = "mediatek,irtx-pwm";
		phandle = <0xe4>;
		pwm_ch = <0x0>;
		pwm_data_invert = <0x0>;
	};

	kd_camera_hw1@1a040000 {
		clock-names = "CLK_TOP_CAMTG_SEL", "CLK_TOP_CAMTG1_SEL", "CLK_TOP_CAMTG2_SEL", "CLK_TOP_CAMTG3_SEL", "CLK_MCLK_6M", "CLK_MCLK_12M", "CLK_MCLK_13M", "CLK_MCLK_48M", "CLK_MCLK_52M", "CLK_MCLK_24M", "CLK_MCLK_26M", "CLK_CAM_SENINF_CG", "CLK_MIPI_C0_26M_CG", "CLK_MIPI_C1_26M_CG", "CLK_MIPI_ANA_0A_CG", "CLK_TOP_CAMTM_SEL_CG", "CLK_TOP_CAMTM_208_CG", "CLK_SCP_SYS_CAM";
		clocks = <0x26 0x66 0x26 0x67 0x26 0x68 0x26 0x69 0x26 0x14 0x26 0x13 0x26 0x1d 0x26 0x11 0x26 0x1c 0x26 0x12 0x24 0x62 0x4 0x3 0xe 0x3 0x12 0x64 0x0 0x26 0x7d 0x26 0x1a 0x36 0x9>;
		compatible = "mediatek,camera_hw";
		phandle = <0xd5>;
		reg = <0x0 0x1a040000 0x0 0x1000>;
	};

	key_google {
		compatible = "mediatek, key_google_key-eint";
		deb-gpios = <0x1f 0x3 0x0>;
		debounce = <0xfa00>;
		interrupt-parent = <0x1f>;
		interrupts = <0x3 0x8 0x3 0x0>;
		phandle = <0x96>;
		status = "okay";
	};

	kp@10010000 {
		clock-names = "kpd";
		clocks = <0x24>;
		compatible = "mediatek,kp";
		interrupts = <0x0 0xb4 0x2>;
		phandle = <0x20>;
		reg = <0x0 0x10010000 0x0 0x1000>;
	};

	l2c_parity {
		compatible = "mediatek,l2c_parity-v1";
		interrupts = <0x0 0x18 0x4 0x0 0x19 0x4>;
	};

	lcm_gpio {
		compatible = "mediatek,lcm_gpio";
		phandle = <0x9a>;
	};

	lk_charger {
		ac_charger_current = <0x17a6b0>;
		ac_charger_input_current = <0x16e360>;
		charging_host_charger_current = <0x16e360>;
		compatible = "mediatek,lk_charger";
		enable_anime;
		fast_charge_voltage = <0x2dc6c0>;
		max_charger_voltage = <0x632ea0>;
		non_std_ac_charger_current = <0xdbba0>;
		pd_charger_current = <0x7a120>;
		phandle = <0xda>;
		ta_ac_charger_current = <0x17a6b0>;
		temp_t1_threshold = <0x0>;
		temp_t3_threshold = <0x2d>;
		temp_t4_threshold = <0x32>;
		usb_charger_current = <0x7a120>;
	};

	m4u@10205000 {
		cell-index = <0x0>;
		compatible = "mediatek,m4u";
		interrupts = <0x0 0x9e 0x8>;
		reg = <0x0 0x10205000 0x0 0x1000>;
	};

	mbist@17050000 {
		compatible = "mediatek,mbist";
		reg = <0x0 0x17050000 0x0 0x10000>;
	};

	mbist_ao@10013000 {
		compatible = "mediatek,mbist_ao";
		reg = <0x0 0x10013000 0x0 0x1000>;
	};

	mcdi@00110100 {
		compatible = "mediatek,mt6765-mcdi";
		reg = <0x0 0x110100 0x0 0x800>;
	};

	mcucfg@10200000 {
		compatible = "mediatek,mcucfg";
		interrupts = <0x0 0x0 0x8>;
		reg = <0x0 0x10200000 0x0 0x1000>;
	};

	mcucfg_mp0_counter@10200000 {
		compatible = "mediatek,mcucfg_mp0_counter";
		reg = <0x0 0x10200000 0x0 0x4000>;
	};

	mcupm_reg@10216000 {
		compatible = "mediatek,mcupm_reg";
		reg = <0x0 0x10216000 0x0 0x1000>;
	};

	mcupm_sram0@10217000 {
		compatible = "mediatek,mcupm_sram0";
		reg = <0x0 0x10217000 0x0 0x1000>;
	};

	mcupm_sram1@10218000 {
		compatible = "mediatek,mcupm_sram1";
		reg = <0x0 0x10218000 0x0 0x1000>;
	};

	mcupm_sram2@10211000 {
		compatible = "mediatek,mcupm_sram2";
		reg = <0x0 0x10211000 0x0 0x1000>;
	};

	mcupm_sram3@10213000 {
		compatible = "mediatek,mcupm_sram3";
		reg = <0x0 0x10213000 0x0 0x1000>;
	};

	md1_sim1_hot_plug_eint {
		phandle = <0xed>;
	};

	md1_sim2_hot_plug_eint {
		phandle = <0xee>;
	};

	md_auxadc {
		compatible = "mediatek,md_auxadc";
		io-channel-names = "md-channel", "md-battery";
		io-channels = <0x2b 0x2>;
		phandle = <0xa4>;
	};

	md_ccif0@1020a000 {
		compatible = "mediatek,md_ccif0";
		reg = <0x0 0x1020a000 0x0 0x1000>;
	};

	md_ccif1@1020c000 {
		compatible = "mediatek,md_ccif1";
		reg = <0x0 0x1020c000 0x0 0x1000>;
	};

	md_ccif2@1023d000 {
		compatible = "mediatek,md_ccif2";
		reg = <0x0 0x1023d000 0x0 0x1000>;
	};

	md_ccif3@1023f000 {
		compatible = "mediatek,md_ccif3";
		reg = <0x0 0x1023f000 0x0 0x1000>;
	};

	mdcldmain@1021c000 {
		compatible = "mediatek,mdcldmain";
		reg = <0x0 0x1021c000 0x0 0x400>;
	};

	mdcldmain_ao@10015000 {
		compatible = "mediatek,mdcldmain_ao";
		reg = <0x0 0x10015000 0x0 0x400>;
	};

	mdcldmamisc@1021c800 {
		compatible = "mediatek,mdcldmamisc";
		reg = <0x0 0x1021c800 0x0 0x1000>;
	};

	mdcldmamisc_ao@10015800 {
		compatible = "mediatek,mdcldmamisc_ao";
		reg = <0x0 0x10015800 0x0 0x400>;
	};

	mdcldmaout@1021c400 {
		compatible = "mediatek,mdcldmaout";
		reg = <0x0 0x1021c400 0x0 0x400>;
	};

	mdcldmaout_ao@10015400 {
		compatible = "mediatek,mdcldmaout_ao";
		reg = <0x0 0x10015400 0x0 0x400>;
	};

	mddriver@10014000 {
		_vcore-supply = <0x38>;
		_vmodem-supply = <0x37>;
		ccci-infracfg = <0x25>;
		clock-names = "scp-sys-md1-main", "infra-cldma-bclk", "infra-ccif-ap", "infra-ccif-md", "infra-ccif1-ap", "infra-ccif1-md", "infra-ccif2-ap", "infra-ccif2-md";
		clocks = <0x36 0x0 0x25 0x32 0x25 0x29 0x25 0x2c 0x25 0x23 0x25 0x24 0x25 0x51 0x25 0x52>;
		compatible = "mediatek,mddriver", "mediatek,mddriver-mt6765";
		interrupts = <0x0 0xa5 0x4 0x0 0x94 0x8 0x0 0x95 0x8 0x0 0x105 0x2>;
		mediatek,ap_plat_info = <0x1a6d>;
		mediatek,cldma_capability = <0x6>;
		mediatek,md_generation = <0x1895>;
		mediatek,md_id = <0x0>;
		mediatek,mdhif_type = <0x3>;
		mediatek,offset_apon_md1 = <0x1c24>;
		phandle = <0x22>;
		reg = <0x0 0x10014000 0x0 0x1000 0x0 0x1021b000 0x0 0x1000 0x0 0x10209000 0x0 0x1000 0x0 0x1020a000 0x0 0x1000>;
	};

	mdp_ccorr0@14005000 {
		clock-names = "MDP_CCORR";
		clocks = <0x60 0x1>;
		compatible = "mediatek,mdp_ccorr0";
		interrupts = <0x0 0xe2 0x8>;
		phandle = <0x44>;
		reg = <0x0 0x14005000 0x0 0x1000>;
	};

	mdp_rdma0@14004000 {
		clock-names = "MDP_RDMA0";
		clocks = <0x60 0x0>;
		compatible = "mediatek,mdp_rdma0";
		interrupts = <0x0 0xd3 0x8>;
		phandle = <0x3d>;
		reg = <0x0 0x14004000 0x0 0x1000>;
	};

	mdp_rsz0@14006000 {
		clock-names = "MDP_RSZ0";
		clocks = <0x60 0x2>;
		compatible = "mediatek,mdp_rsz0";
		interrupts = <0x0 0xd4 0x8>;
		phandle = <0x3e>;
		reg = <0x0 0x14006000 0x0 0x1000>;
	};

	mdp_rsz1@14007000 {
		clock-names = "MDP_RSZ1";
		clocks = <0x60 0x3>;
		compatible = "mediatek,mdp_rsz1";
		interrupts = <0x0 0xd5 0x8>;
		phandle = <0x3f>;
		reg = <0x0 0x14007000 0x0 0x1000>;
	};

	mdp_tdshp0@1400a000 {
		clock-names = "MDP_TDSHP";
		clocks = <0x60 0x4>;
		compatible = "mediatek,mdp_tdshp0";
		phandle = <0x42>;
		reg = <0x0 0x1400a000 0x0 0x1000>;
	};

	mdp_wdma0@14008000 {
		clock-names = "MDP_WDMA";
		clocks = <0x60 0x6>;
		compatible = "mediatek,mdp_wdma0";
		interrupts = <0x0 0xd8 0x8>;
		phandle = <0x40>;
		reg = <0x0 0x14008000 0x0 0x1000>;
	};

	mdp_wrot0@14009000 {
		clock-names = "MDP_WROT0";
		clocks = <0x60 0x5>;
		compatible = "mediatek,mdp_wrot0";
		interrupts = <0x0 0xd7 0x8>;
		phandle = <0x41>;
		reg = <0x0 0x14009000 0x0 0x1000>;
	};

	memory {
		device_type = "memory";
		reg = <0x0 0x40000000 0x0 0x20000000>;
	};

	mfg_cfg@13ffe000 {
		#clock-cells = <0x1>;
		compatible = "mediatek,mfgcfg", "syscon";
		phandle = <0xc8>;
		reg = <0x0 0x13ffe000 0x0 0x1000>;
	};

	mfg_doma@13000000 {
		clock-frequency = <0x21f98280>;
		compatible = "mediatek,doma";
		ged-supply = <0x5e>;
		interrupt-names = "RGX";
		interrupts = <0x0 0x103 0x8>;
		phandle = <0xc7>;
		reg = <0x0 0x13000000 0x0 0x80000>;
	};

	mipi_rx_ana_csi0a@11c10000 {
		#clock-cells = <0x1>;
		compatible = "mediatek,mt6765-mipi0a", "syscon";
		phandle = <0x64>;
		reg = <0x0 0x11c10000 0x0 0x1000>;
	};

	mipi_rx_ana_csi0b@11c11000 {
		#clock-cells = <0x1>;
		compatible = "mediatek,mt6765-mipi0b", "syscon";
		phandle = <0xc2>;
		reg = <0x0 0x11c11000 0x0 0x1000>;
	};

	mipi_rx_ana_csi1a@11c12000 {
		#clock-cells = <0x1>;
		compatible = "mediatek,mt6765-mipi1a", "syscon";
		phandle = <0xc3>;
		reg = <0x0 0x11c12000 0x0 0x1000>;
	};

	mipi_rx_ana_csi1b@11c13000 {
		#clock-cells = <0x1>;
		compatible = "mediatek,mt6765-mipi1b", "syscon";
		phandle = <0xc4>;
		reg = <0x0 0x11c13000 0x0 0x1000>;
	};

	mipi_rx_ana_csi2a@11c14000 {
		#clock-cells = <0x1>;
		compatible = "mediatek,mt6765-mipi2a", "syscon";
		phandle = <0xc5>;
		reg = <0x0 0x11c14000 0x0 0x1000>;
	};

	mipi_rx_ana_csi2b@11c15000 {
		#clock-cells = <0x1>;
		compatible = "mediatek,mt6765-mipi2b", "syscon";
		phandle = <0xc6>;
		reg = <0x0 0x11c15000 0x0 0x1000>;
	};

	mipi_tx0@11c80000 {
		compatible = "mediatek,mipi_tx0";
		reg = <0x0 0x11c80000 0x0 0x10000>;
	};

	mmdvfs_pmqos {
		cam_freq = "mm_step0", "mm_step1", "mm_step2";
		clock-names = "mmdvfs_clk_mm_sel_ck", "mmdvfs_clk_mmpll_ck", "mmdvfs_clk_univpll1_d2_ck", "mmdvfs_clk_mmpll_d2_ck";
		clocks = <0x26 0x62 0x26 0x21 0x26 0x17 0x26 0x22>;
		compatible = "mediatek,mmdvfs_pmqos";
		disp_freq = "mm_step0", "mm_step1", "mm_step2";
		img_freq = "mm_step0", "mm_step1", "mm_step2";
		mdp_freq = "mm_step0", "mm_step1", "mm_step2";
		mm_step0 = <0x1c9 0x1 0x0 0x1>;
		mm_step1 = <0x138 0x1 0x0 0x2>;
		mm_step2 = <0xe4 0x1 0x0 0x3>;
		vdec_freq = "mm_step0", "mm_step1", "mm_step2";
		venc_freq = "mm_step0", "mm_step1", "mm_step2";
		vopp_steps = <0x0 0x1 0x3>;
	};

	mmsys_config@14000000 {
		#clock-cells = <0x1>;
		compatible = "mediatek,mt6765-mmsys_config", "syscon";
		interrupts = <0x0 0xe3 0x8>;
		phandle = <0x60>;
		reg = <0x0 0x14000000 0x0 0x1000>;
	};

	mobicore {
		compatible = "trustonic,mobicore";
		interrupts = <0x0 0x10f 0x1>;
	};

	modem_temp_share@10018000 {
		compatible = "mediatek,modem_temp_share";
		reg = <0x0 0x10018000 0x0 0x1000>;
	};

	mrdump_ext_rst {
		compatible = "mediatek, mrdump_ext_rst-eint";
		force_mode = "EINT";
		mode = "IRQ";
		phandle = <0x98>;
		status = "okay";
	};

	msdc0_pad_macro@11cd0000 {
		compatible = "mediatek,msdc0_pad_macro";
		reg = <0x0 0x11cd0000 0x0 0x10000>;
	};

	msdc0_top@11cd0000 {
		compatible = "mediatek,msdc0_top";
		reg = <0x0 0x11cd0000 0x0 0x1000>;
	};

	msdc1_ins@0 {
		compatible = "mediatek,mt6765-sdcard-ins";
		phandle = <0xbf>;
	};

	msdc1_pad_macro@11c90000 {
		compatible = "mediatek,msdc1_pad_macro";
		reg = <0x0 0x11c90000 0x0 0x10000>;
	};

	msdc1_top@11c90000 {
		compatible = "mediatek,msdc1_top";
		reg = <0x0 0x11c90000 0x0 0x1000>;
	};

	msdc@11230000 {
		bootable;
		bus-width = <0x8>;
		cap-mmc-highspeed;
		clk_src = [01];
		clock-names = "msdc0-clock", "msdc0-hclock", "msdc0-aes-clock";
		clocks = <0x25 0x4c 0x25 0x1c 0x25 0x44>;
		compatible = "mediatek,msdc";
		host_function = [00];
		index = [00];
		infracfg = <0x25>;
		interrupts = <0x0 0x4f 0x8>;
		max-frequency = <0xbebc200>;
		mmc-ddr-1_8v;
		mmc-hs200-1_8v;
		mmc-hs400-1_8v;
		no-sd;
		no-sdio;
		non-removable;
		phandle = <0xbb>;
		pinctl = <0x50>;
		pinctl_hs200 = <0x52>;
		pinctl_hs400 = <0x51>;
		reg = <0x0 0x11230000 0x0 0x10000>;
		register_setting = <0x53>;
		status = "okay";
		topckgen = <0x26>;
		vmmc-supply = <0x54>;
	};

	msdc@11240000 {
		bus-width = <0x4>;
		cap-sd-highspeed;
		cd-gpios = <0x1f 0x1 0x0>;
		cd_level = [01];
		clk_src = [02];
		clock-names = "msdc1-clock", "msdc1-hclock";
		clocks = <0x25 0x4d 0x25 0x1d>;
		compatible = "mediatek,msdc";
		host_function = [01];
		index = [01];
		interrupts = <0x0 0x50 0x8>;
		max-frequency = <0xbebc200>;
		mediatek,pwrap-regmap = <0x30>;
		no-mmc;
		no-sdio;
		phandle = <0xbc>;
		pinctl = <0x55>;
		pinctl_ddr50 = <0x58>;
		pinctl_sdr104 = <0x56>;
		pinctl_sdr50 = <0x57>;
		reg = <0x0 0x11240000 0x0 0x10000>;
		register_setting = <0x59>;
		sd-uhs-ddr50;
		sd-uhs-sdr104;
		sd-uhs-sdr12;
		sd-uhs-sdr25;
		sd-uhs-sdr50;
		status = "okay";
		vmmc-supply = <0x5a>;
		vqmmc-supply = <0x5b>;
	};

	msdc@11250000 {
		compatible = "mediatek,msdc2";
		phandle = <0xbd>;
		reg = <0x0 0x11250000 0x0 0x10000>;
		status = "disable";
	};

	msdc@11260000 {
		compatible = "mediatek,msdc3";
		phandle = <0xbe>;
		reg = <0x0 0x11250000 0x0 0x10000>;
		status = "disable";
	};

	mt6370_pd_eint {
		phandle = <0xe3>;
	};

	mt6370_pmu_dts {
		#interrupt-cells = <0x1>;
		interrupt-controller;
		mt6370,intr_gpio = <0x1f 0x3 0x0>;
		mt6370,intr_gpio_num = <0x3>;
		phandle = <0xf0>;

		bled {
			compatible = "mediatek,mt6370_pmu_bled";
			interrupt-names = "bled_ocp";
			mt,bl_ocp_level = <0x2>;
			mt,bl_ovp_level = <0x3>;
			mt,bled_curr_scale = <0x0>;
			mt,bled_flash_ramp = <0x1>;
			mt,bled_name = "mt6370_pmu_bled";
			mt,bled_ramptime = <0x3>;
			mt,chan_en = <0xf>;
			mt,map_linear;
			mt,max_bled_brightness = <0x200>;
			mt,pwm_avg_cycle = <0x0>;
			mt,pwm_deglitch = <0x1>;
			mt,pwm_fsample = <0x2>;
			mt,pwm_hys = <0x0>;
			mt,pwm_hys_en = <0x1>;
			mt,pwm_lpf_coef = <0x0>;
			mt,use_pwm;
		};

		charger {
			aicr = <0x7a120>;
			bc12_sel = <0x0>;
			bootmode = <0x2a>;
			charger = <0x69>;
			charger_name = "primary_chg";
			compatible = "mediatek,mt6370_pmu_charger";
			cv = <0x426030>;
			dc_wdt = <0x3d0900>;
			enable_otg_wdt;
			enable_te;
			enable_wdt;
			ichg = <0x1e8480>;
			ieoc = <0x249f0>;
			interrupt-names = "chg_mivr", "chg_aiclmeasi", "attachi", "ovpctrl_uvp_d_evt", "chg_wdtmri", "chg_vbusov", "chg_tmri", "chg_treg", "dcdti";
			ircmp_resistor = <0x61a8>;
			ircmp_vclamp = <0x7d00>;
			lbp_dt = <0x1>;
			lbp_hys_sel = <0x1>;
			load_switch_name = "primary_load_switch";
			mivr = <0x432380>;
			phandle = <0x69>;
			safety_timer = <0xc>;

			usb-otg-vbus {
				phandle = <0xf1>;
				regulator-compatible = "usb-otg-vbus";
				regulator-max-microamp = <0x2dc6c0>;
				regulator-max-microvolt = <0x588040>;
				regulator-min-microamp = <0x7a120>;
				regulator-min-microvolt = <0x426030>;
				regulator-name = "usb-otg-vbus";
			};
		};

		core {
			compatible = "mediatek,mt6370_pmu_core";
			i2cstmr_rst_tmr = <0x0>;
			int_deg = <0x0>;
			int_wdt = <0x0>;
			interrupt-names = "otp", "vdda_ovp", "vdda_uv";
			mrstb_en;
			mrstb_tmr = <0x3>;
		};

		dsv {
			compatible = "mediatek,mt6370_pmu_dsv";
			db_delay = <0x3>;
			db_ext_en = <0x0>;
			db_freq_pm = <0x0>;
			db_periodic_fix = <0x0>;
			db_periodic_mode = <0x0>;
			db_single_pin = <0x0>;
			db_startup = <0x0>;
			db_vbst = <0x1644>;
			db_vneg_20ms = <0x1>;
			db_vneg_disc = <0x0>;
			db_vneg_slew = <0x1>;
			db_vpos_20ms = <0x1>;
			db_vpos_disc = <0x1>;
			db_vpos_slew = <0x1>;
			interrupt-names = "dsv_vneg_ocp", "dsv_vpos_ocp", "dsv_bst_ocp", "dsv_vneg_scp", "dsv_vpos_scp";

			mt6370_dsvn {
				regulator-max-microvolt = <0x5b8d80>;
				regulator-min-microvolt = <0x3d0900>;
				regulator-name = "dsv_neg";
			};

			mt6370_dsvp {
				regulator-max-microvolt = <0x5b8d80>;
				regulator-min-microvolt = <0x3d0900>;
				regulator-name = "dsv_pos";
			};
		};

		ldo {
			compatible = "mediatek,mt6370_pmu_ldo";
			interrupt-names = "ldo_oc";
			ldo_oms = <0x1>;
			ldo_vrc_lt = <0x1>;

			mt6370_ldo {
				regulator-max-microvolt = <0x3d0900>;
				regulator-min-microvolt = <0x186a00>;
				regulator-name = "irtx_ldo";
			};
		};

		mt6370_pmu_fled1 {
			compatible = "mediatek,mt6370_pmu_fled1";
			fled_enable = <0x1>;
			interrupt-names = "fled_lvf", "fled2_short", "fled1_short";
			strobe_cur = <0x124f80>;
			strobe_timeout = <0x960>;
			torch_cur = <0x493e0>;
		};

		mt6370_pmu_fled2 {
			compatible = "mediatek,mt6370_pmu_fled2";
			fled_enable = <0x1>;
			strobe_cur = <0xf4240>;
			strobe_timeout = <0x4b0>;
			torch_cur = <0x30d40>;
		};

		rgbled {
			compatible = "mediatek,mt6370_pmu_rgbled";
			interrupt-names = "isink4_short", "isink3_short", "isink2_short", "isink1_short", "isink4_open", "isink3_open", "isink2_open", "isink1_open";
			mt,led_default_trigger = "cc_mode", "cc_mode", "cc_mode", "none";
			mt,led_name = "mt6370_pmu_led1", "mt6370_pmu_led2", "mt6370_pmu_led3", "mt6370_pmu_led4";
		};
	};

	mt6370_pmu_eint {
		phandle = <0xe2>;
	};

	mt_soc_anc_pcm {
		compatible = "mediatek,mt_soc_pcm_anc";
	};

	mt_soc_codec_dummy_name {
		compatible = "mediatek,mt_soc_codec_dummy";
	};

	mt_soc_codec_name {
		compatible = "mediatek,mt_soc_codec_63xx";
		use_hp_depop_flow = <0x0>;
		use_ul_260k = <0x0>;
	};

	mt_soc_dai_name {
		compatible = "mediatek,mt_soc_dai_stub";
	};

	mt_soc_deep_buffer_dl_pcm {
		compatible = "mediatek,mt_soc_pcm_deep_buffer_dl";
	};

	mt_soc_dl1_awb_pcm {
		compatible = "mediatek,mt_soc_pcm_dl1_awb";
	};

	mt_soc_dl1_pcm@11220000 {
		clock-names = "aud_afe_clk", "aud_dac_clk", "aud_dac_predis_clk", "aud_adc_clk", "aud_apll22m_clk", "aud_apll1_tuner_clk", "aud_tml_clk", "aud_infra_clk", "mtkaif_26m_clk", "top_mux_audio", "top_mux_audio_int", "top_sys_pll1_d4", "top_mux_aud_1", "top_apll1_ck", "top_mux_aud_eng1", "top_apll1_d8", "apmixed_apll1", "top_clk26m_clk";
		clocks = <0x5d 0x0 0x5d 0x4 0x5d 0x5 0x5d 0x3 0x5d 0x1 0x5d 0x2 0x5d 0x6 0x25 0x2b 0x25 0x33 0x26 0x6f 0x26 0x70 0x26 0x3 0x26 0x71 0x26 0x29 0x26 0x72 0x26 0x2c 0x3 0x8 0x24>;
		compatible = "mediatek,mt_soc_pcm_dl1";
		interrupts = <0x0 0x99 0x8>;
		phandle = <0xc1>;
		reg = <0x0 0x11220000 0x0 0x1000>;
	};

	mt_soc_dl2_pcm {
		compatible = "mediatek,mt_soc_pcm_dl2";
	};

	mt_soc_dummy_pcm {
		compatible = "mediatek,mt_soc_pcm_dummy";
	};

	mt_soc_fm_i2s_awb_pcm {
		compatible = "mediatek,mt_soc_pcm_fm_i2s_awb";
	};

	mt_soc_fm_i2s_pcm {
		compatible = "mediatek,mt_soc_pcm_fm_i2s";
	};

	mt_soc_fm_mrgtx_pcm {
		compatible = "mediatek,mt_soc_pcm_fmtx";
	};

	mt_soc_hp_impedance_pcm {
		compatible = "mediatek,mt_soc_pcm_hp_impedance";
	};

	mt_soc_i2s0_awb_pcm {
		compatible = "mediatek,mt_soc_pcm_i2s0_awb";
	};

	mt_soc_i2s0_pcm {
		compatible = "mediatek,mt_soc_pcm_dl1_i2s0";
	};

	mt_soc_i2s0dl1_pcm {
		compatible = "mediatek,mt_soc_pcm_dl1_i2s0dl1";
	};

	mt_soc_mrgrx_awb_pcm {
		compatible = "mediatek,mt_soc_pcm_mrgrx_awb";
	};

	mt_soc_mrgrx_pcm {
		compatible = "mediatek,mt_soc_pcm_mrgrx";
	};

	mt_soc_pcm_dl1_scp_spk {
		compatible = "mediatek,mt_soc_pcm_dl1_scp_spk";
	};

	mt_soc_pcm_voice_scp {
		compatible = "mediatek,mt_soc_pcm_voice_scp";
	};

	mt_soc_pcm_voice_ultra {
		compatible = "mediatek,mt_soc_pcm_voice_ultra";
	};

	mt_soc_pcm_voice_usb {
		compatible = "mediatek,mt_soc_pcm_voice_usb";
	};

	mt_soc_pcm_voice_usb_echoref {
		compatible = "mediatek,mt_soc_pcm_voice_usb_echoref";
	};

	mt_soc_routing_dai_name {
		compatible = "mediatek,mt_soc_dai_routing";
	};

	mt_soc_routing_pcm {
		compatible = "mediatek,mt_soc_pcm_routing";
	};

	mt_soc_tdmrx_pcm {
		compatible = "mediatek,mt_soc_tdm_capture";
	};

	mt_soc_ul1_pcm {
		compatible = "mediatek,mt_soc_pcm_capture";
	};

	mt_soc_ul2_pcm {
		compatible = "mediatek,mt_soc_pcm_capture2";
	};

	mt_soc_uldlloopback_pcm {
		compatible = "mediatek,mt_soc_pcm_uldlloopback";
	};

	mt_soc_voice_md1 {
		compatible = "mediatek,mt_soc_pcm_voice_md1";
	};

	mt_soc_voice_md1_bt {
		compatible = "mediatek,mt_soc_pcm_voice_md1_bt";
	};

	mt_soc_voice_md2 {
		compatible = "mediatek,mt_soc_pcm_voice_md2";
	};

	mt_soc_voice_md2_bt {
		compatible = "mediatek,mt_soc_pcm_voice_md2_bt";
	};

	mt_soc_voip_bt_in {
		compatible = "mediatek,mt_soc_pcm_bt_dai";
	};

	mt_soc_voip_bt_out {
		compatible = "mediatek,mt_soc_pcm_dl1_bt";
	};

	mtk-btcvsd-snd@18050000 {
		compatible = "mediatek,mtk-btcvsd-snd";
		interrupts = <0x0 0x10a 0x8>;
		mediatek,infracfg = <0x25>;
		mediatek,offset = <0xf00 0x800 0x140 0x144 0x148>;
		phandle = <0x5c>;
		reg = <0x0 0x18050000 0x0 0x1000 0x0 0x18080000 0x0 0x10000>;
	};

	mtkfb@0 {
		compatible = "mediatek,mtkfb";
		phandle = <0xcd>;
	};

	nfc {
		compatible = "mediatek,nfc-gpio-v2";
		gpio-irq = <0xa>;
		gpio-irq-std = <0x1f 0xa 0x0>;
		gpio-rst = <0xac>;
		gpio-rst-std = <0x1f 0xac 0x0>;
		phandle = <0xc9>;
	};

	nfi@11018000 {
		compatible = "mediatek,nfi";
		reg = <0x0 0x11018000 0x0 0x1000>;
	};

	nfiecc@11019000 {
		compatible = "mediatek,nfiecc";
		reg = <0x0 0x11019000 0x0 0x1000>;
	};

	odm {
		compatible = "simple-bus";
		phandle = <0xe5>;
	};

	opp_table0 {
		compatible = "operating-points-v2";
		opp-shared;
		phandle = <0x5>;

		opp0 {
			opp-hz = <0x0 0x35a4e900>;
			opp-microvolt = <0x927c0>;
		};

		opp1 {
			opp-hz = <0x0 0x3a5a5ac0>;
			opp-microvolt = <0x970fe>;
		};

		opp10 {
			opp-hz = <0x0 0x73df1600>;
			opp-microvolt = <0xdec74>;
		};

		opp11 {
			opp-hz = <0x0 0x77bee840>;
			opp-microvolt = <0xe7ef0>;
		};

		opp12 {
			opp-hz = <0x0 0x7b9eba80>;
			opp-microvolt = <0xf116c>;
		};

		opp13 {
			opp-hz = <0x0 0x7f7e8cc0>;
			opp-microvolt = <0xfa3e8>;
		};

		opp14 {
			opp-hz = <0x0 0x840637c0>;
			opp-microvolt = <0x104ece>;
		};

		opp15 {
			opp-hz = <0x0 0x89267940>;
			opp-microvolt = <0x11121e>;
		};

		opp2 {
			opp-hz = <0x0 0x40abc940>;
			opp-microvolt = <0x9d2a6>;
		};

		opp3 {
			opp-hz = <0x0 0x48993480>;
			opp-microvolt = <0xa4cb8>;
		};

		opp4 {
			opp-hz = <0x0 0x50869fc0>;
			opp-microvolt = <0xac6ca>;
		};

		opp5 {
			opp-hz = <0x0 0x58740b00>;
			opp-microvolt = <0xb40dc>;
		};

		opp6 {
			opp-hz = <0x0 0x60617640>;
			opp-microvolt = <0xbbaee>;
		};

		opp7 {
			opp-hz = <0x0 0x684ee180>;
			opp-microvolt = <0xc3500>;
		};

		opp8 {
			opp-hz = <0x0 0x6c1f7180>;
			opp-microvolt = <0xcc77c>;
		};

		opp9 {
			opp-hz = <0x0 0x6fff43c0>;
			opp-microvolt = <0xd59f8>;
		};
	};

	opp_table1 {
		compatible = "operating-points-v2";
		opp-shared;
		phandle = <0xd>;

		opp0 {
			opp-hz = <0x0 0x17d78400>;
			opp-microvolt = <0x927c0>;
		};

		opp1 {
			opp-hz = <0x0 0x1ddca740>;
			opp-microvolt = <0x9a1d2>;
		};

		opp10 {
			opp-hz = <0x0 0x4e520c80>;
			opp-microvolt = <0xdec74>;
		};

		opp11 {
			opp-hz = <0x0 0x5390d280>;
			opp-microvolt = <0xe7ef0>;
		};

		opp12 {
			opp-hz = <0x0 0x58dedac0>;
			opp-microvolt = <0xf116c>;
		};

		opp13 {
			opp-hz = <0x0 0x5e1da0c0>;
			opp-microvolt = <0xfa3e8>;
		};

		opp14 {
			opp-hz = <0x0 0x64414880>;
			opp-microvolt = <0x104ec4>;
		};

		opp15 {
			opp-hz = <0x0 0x6b49d200>;
			opp-microvolt = <0x11121e>;
		};

		opp2 {
			opp-hz = <0x0 0x204e4380>;
			opp-microvolt = <0x9d2a6>;
		};

		opp3 {
			opp-hz = <0x0 0x265366c0>;
			opp-microvolt = <0xa4cb8>;
		};

		opp4 {
			opp-hz = <0x0 0x2c67cc40>;
			opp-microvolt = <0xac6ca>;
		};

		opp5 {
			opp-hz = <0x0 0x326cef80>;
			opp-microvolt = <0xb40dc>;
		};

		opp6 {
			opp-hz = <0x0 0x38815500>;
			opp-microvolt = <0xbbaee>;
		};

		opp7 {
			opp-hz = <0x0 0x3e95ba80>;
			opp-microvolt = <0xc3500>;
		};

		opp8 {
			opp-hz = <0x0 0x43d48080>;
			opp-microvolt = <0xcc77c>;
		};

		opp9 {
			opp-hz = <0x0 0x49134680>;
			opp-microvolt = <0xd59f8>;
		};
	};

	opp_table2 {
		compatible = "operating-points-v2";
		opp-shared;
		phandle = <0x4>;

		opp00 {
			opp-hz = <0x0 0x11e1a300>;
			opp-microvolt = <0x927c0>;
		};

		opp01 {
			opp-hz = <0x0 0x1434bac0>;
			opp-microvolt = <0x970fe>;
		};

		opp02 {
			opp-hz = <0x0 0x175d7200>;
			opp-microvolt = <0x9d2a6>;
		};

		opp03 {
			opp-hz = <0x0 0x1b5bc8c0>;
			opp-microvolt = <0xa4cb8>;
		};

		opp04 {
			opp-hz = <0x0 0x1f4add40>;
			opp-microvolt = <0xac6ca>;
		};

		opp05 {
			opp-hz = <0x0 0x23493400>;
			opp-microvolt = <0xb40dc>;
		};

		opp06 {
			opp-hz = <0x0 0x27384880>;
			opp-microvolt = <0xbbaee>;
		};

		opp07 {
			opp-hz = <0x0 0x2b275d00>;
			opp-microvolt = <0xc3500>;
		};

		opp08 {
			opp-hz = <0x0 0x48c3ee0>;
			opp-microvolt = <0xcc77c>;
		};

		opp09 {
			opp-hz = <0x0 0x4c63aa0>;
			opp-microvolt = <0xd59f8>;
		};

		opp10 {
			opp-hz = <0x0 0x501bd00>;
			opp-microvolt = <0xdec74>;
		};

		opp11 {
			opp-hz = <0x0 0x53bb8c0>;
			opp-microvolt = <0xe7ef0>;
		};

		opp12 {
			opp-hz = <0x0 0x36a84f40>;
			opp-microvolt = <0xf116c>;
		};

		opp13 {
			opp-hz = <0x0 0x38ec24c0>;
			opp-microvolt = <0xfa3e8>;
		};

		opp14 {
			opp-hz = <0x0 0x3b9aca00>;
			opp-microvolt = <0x104ece>;
		};

		opp15 {
			opp-hz = <0x0 0x3ea4fcc0>;
			opp-microvolt = <0x11121e>;
		};
	};

	otg_iddig {
		compatible = "mediatek,usb_iddig_bi_eint";
		phandle = <0x97>;
	};

	pd_adapter {
		adapter_name = "pd_adapter";
		compatible = "mediatek,pd_adapter";
		phandle = <0xdf>;
	};

	pdc {
		compatible = "mediatek,charger,pd";
		dcs_chg1_charger_current = <0x16e360>;
		dcs_chg2_charger_current = <0x16e360>;
		dcs_input_current = <0x30d400>;
		dual_polling_ieoc = <0x6ddd0>;
		gauge = <0x66>;
		ibus_err = <0xe>;
		min_charger_voltage = <0x4630c0>;
		pd_stop_battery_soc = <0x50>;
		pd_vbus_low_bound = <0x4c4b40>;
		pd_vbus_upper_bound = <0x4c4b40>;
		phandle = <0xdd>;
		sc_charger_current = <0x2dc6c0>;
		sc_input_current = <0x30d400>;
		slave_mivr_diff = <0x186a0>;
		vsys_watt = <0x4c4b40>;
	};

	pe {
		compatible = "mediatek,charger,pe";
		gauge = <0x66>;
		min_charger_voltage = <0x4630c0>;
		pe_charger_current = <0x2dc6c0>;
		pe_ichg_level_threshold = <0xf4240>;
		phandle = <0xdb>;
		ta_12v_support;
		ta_9v_support;
		ta_ac_12v_input_current = <0x30d400>;
		ta_ac_7v_input_current = <0x30d400>;
		ta_ac_9v_input_current = <0x30d400>;
		ta_start_battery_soc = <0x0>;
		ta_stop_battery_soc = <0x55>;
	};

	pe2 {
		cable_imp_threshold = <0x2bb>;
		compatible = "mediatek,charger,pe2";
		dcs_chg1_charger_current = <0x16e360>;
		dcs_chg2_charger_current = <0x16e360>;
		dcs_input_current = <0x30d400>;
		dual_polling_ieoc = <0x6ddd0>;
		gauge = <0x66>;
		min_charger_voltage = <0x4630c0>;
		pe20_ichg_level_threshold = <0xf4240>;
		phandle = <0xdc>;
		sc_charger_current = <0x2dc6c0>;
		sc_input_current = <0x30d400>;
		slave_mivr_diff = <0x186a0>;
		ta_start_battery_soc = <0x0>;
		ta_stop_battery_soc = <0x55>;
		vbat_cable_imp_threshold = <0x3b8260>;
	};

	pe4 {
		compatible = "mediatek,charger,pe4";
		dcs_chg1_charger_current = <0x16e360>;
		dcs_chg2_charger_current = <0x16e360>;
		dcs_input_current = <0x30d400>;
		dual_polling_ieoc = <0x6ddd0>;
		gauge = <0x66>;
		high_temp_to_enter_pe40 = <0x27>;
		high_temp_to_leave_pe40 = <0x2e>;
		ibus_err = <0xe>;
		low_temp_to_enter_pe40 = <0x10>;
		low_temp_to_leave_pe40 = <0xa>;
		min_charger_voltage = <0x4630c0>;
		pe40_r_cable_1a_lower = <0x1f4>;
		pe40_r_cable_2a_lower = <0x15f>;
		pe40_r_cable_3a_lower = <0xf0>;
		pe40_stop_battery_soc = <0x50>;
		phandle = <0xde>;
		sc_charger_current = <0x2dc6c0>;
		sc_input_current = <0x30d400>;
		slave_mivr_diff = <0x186a0>;
	};

	pericfg@10003000 {
		#clock-cells = <0x1>;
		compatible = "mediatek,pericfg", "syscon";
		phandle = <0x4d>;
		reg = <0x0 0x10003000 0x0 0x1000>;
	};

	pinctrl@1000b000 {
		#gpio-cells = <0x2>;
		#interrupt-cells = <0x2>;
		compatible = "mediatek,mt6765-pinctrl";
		gpio-controller;
		gpio-ranges = <0x1f 0x0 0x0 0xb3>;
		interrupt-controller;
		interrupt-parent = <0x16>;
		interrupts = <0x0 0xab 0x4>;
		phandle = <0x1f>;
		pins-are-numbered;
		reg_bases = <0x17 0x18 0x19 0x1a 0x1b 0x1c 0x1d 0x1e>;

		msdc0@default {
			phandle = <0x50>;

			pins_clk {
				drive-strength = [03];
			};

			pins_cmd {
				drive-strength = [03];
			};

			pins_dat {
				drive-strength = [03];
			};

			pins_ds {
				drive-strength = [03];
			};

			pins_rst {
				drive-strength = [03];
			};
		};

		msdc0@hs200 {
			phandle = <0x52>;

			pins_clk {
				drive-strength = [04];
			};

			pins_cmd {
				drive-strength = [03];
			};

			pins_dat {
				drive-strength = [04];
			};

			pins_ds {
				drive-strength = [04];
			};

			pins_rst {
				drive-strength = [03];
			};
		};

		msdc0@hs400 {
			phandle = <0x51>;

			pins_clk {
				drive-strength = [04];
			};

			pins_cmd {
				drive-strength = [03];
			};

			pins_dat {
				drive-strength = [04];
			};

			pins_ds {
				drive-strength = [04];
			};

			pins_rst {
				drive-strength = [03];
			};
		};

		msdc0@register_default {
			cmd_edge = [00];
			phandle = <0x53>;
			rdata_edge = [00];
			wdata_edge = [00];
		};

		msdc1@ddr50 {
			phandle = <0x58>;

			pins_clk {
				drive-strength = [03];
			};

			pins_cmd {
				drive-strength = [03];
			};

			pins_dat {
				drive-strength = [03];
			};
		};

		msdc1@default {
			phandle = <0x55>;

			pins_clk {
				drive-strength = [03];
			};

			pins_cmd {
				drive-strength = [03];
			};

			pins_dat {
				drive-strength = [03];
			};
		};

		msdc1@register_default {
			cmd_edge = [00];
			phandle = <0x59>;
			rdata_edge = [00];
			wdata_edge = [00];
		};

		msdc1@sdr104 {
			phandle = <0x56>;

			pins_clk {
				drive-strength = [03];
			};

			pins_cmd {
				drive-strength = [03];
			};

			pins_dat {
				drive-strength = [03];
			};
		};

		msdc1@sdr50 {
			phandle = <0x57>;

			pins_clk {
				drive-strength = [03];
			};

			pins_cmd {
				drive-strength = [03];
			};

			pins_dat {
				drive-strength = [03];
			};
		};

		msdc3@default {
			phandle = <0x71>;

			pins_clk {
				drive-strength = [04];
			};

			pins_cmd {
				drive-strength = [04];
			};

			pins_dat {
				drive-strength = [04];
			};
		};

		msdc3@register_default {
			cmd_edge = [01];
			phandle = <0x72>;
			rdata_edge = [01];
			wdata_edge = [01];
		};
	};

	pmic_clock_buffer_ctrl {
		compatible = "mediatek,pmic_clock_buffer";
		mediatek,bblpm-support = "enable";
		mediatek,clkbuf-config = <0x2 0x1 0x1 0x2 0x0 0x0 0x0>;
		mediatek,clkbuf-driving-current = <0x1 0x1 0x1 0x1 0x1 0x1 0x1>;
		mediatek,clkbuf-quantity = <0x7>;
		phandle = <0xe8>;
		pwrap = <0x30>;
		pwrap-dcxo-cfg = <0x18c 0x19c>;
		pwrap-dcxo-en = <0x188 0x0 0x188 0x1 0x188 0x0>;
		sleep = <0x68>;
		spm-pwr-status = <0x180 0x0 0x180 0x1>;
	};

	pmu {
		compatible = "arm,cortex-a7-pmu";
		interrupt-parent = <0x16>;
		interrupts = <0x1 0x7 0x8>;
	};

	psci {
		compatible = "arm,psci-1.0";
		method = "smc";
	};

	pwm@11006000 {
		clock-names = "PWM1-main", "PWM2-main", "PWM3-main", "PWM4-main", "PWM5-main", "PWM6-main", "PWM-HCLK-main", "PWM-main";
		clocks = <0x25 0x10 0x25 0x11 0x25 0x12 0x25 0x13 0x25 0x14 0x25 0x30 0x25 0xf 0x25 0x15>;
		compatible = "mediatek,pwm";
		interrupts = <0x0 0x4d 0x8>;
		phandle = <0xb1>;
		reg = <0x0 0x11006000 0x0 0x10000>;
	};

	pwrap@1000d000 {
		clock-names = "spi", "wrap", "ulposc";
		clocks = <0x24 0x25 0x2 0x26 0x7c>;
		compatible = "mediatek,mt6765-pwrap", "syscon";
		interrupts = <0x0 0xb3 0x4>;
		phandle = <0x30>;
		reg = <0x0 0x1000d000 0x0 0x1000>;
		reg-names = "pwrap";

		main_pmic {
			#interrupt-cells = <0x2>;
			compatible = "mediatek,mt6357";
			interrupt-controller;
			interrupt-parent = <0x1f>;
			interrupts = <0x90 0x4 0x90 0x0>;
			phandle = <0x31>;

			clock_buffer_ctrl {
				clkbuf-pmic-dependent = "pmic-drvcurr", "pmic-auxout-sel", "pmic-auxout-xo", "pmic-auxout-drvcurr", "pmic-auxout-bblpm-en";
				compatible = "mediatek,clock_buffer";
				n-clkbuf-pmic-dependent = <0x5>;
				n-pmic-auxout-bblpm-en = <0x1>;
				n-pmic-auxout-drvcurr = <0x7>;
				n-pmic-auxout-sel = <0x6>;
				n-pmic-auxout-xo = <0x7>;
				n-pmic-drvcurr = <0x7>;
				phandle = <0x95>;
				pmic-auxout-bblpm-en = <0x7b6 0x0>;
				pmic-auxout-drvcurr = <0x7b6 0x1 0x7b6 0x7 0x7b6 0x1 0x7b6 0x7 0xffff 0xffff 0x7b6 0x1 0x7b6 0xc>;
				pmic-auxout-sel = <0x7b4 0x0 0x7b4 0x5 0x7b4 0x6 0x7b4 0x7 0x7b4 0x6 0x7b4 0x18>;
				pmic-auxout-xo = <0x7b6 0x0 0x7b6 0x6 0x7b6 0x0 0x7b6 0x6 0xffff 0xffff 0x7b6 0x6 0x7b6 0xc>;
				pmic-bblpm-sw = <0x788 0xc>;
				pmic-dcxo-cw = <0x788>;
				pmic-drvcurr = <0x7b0 0x0 0x7b0 0x2 0x7b0 0x4 0x7b0 0x6 0xffff 0xffff 0x7b0 0xa 0x7b0 0xc>;
				pmic-srclkeni3 = <0x44a 0x0>;
				pmic-xo-en = <0x788 0x2 0x788 0x5 0x788 0x8 0x788 0xb 0xffff 0xffff 0x7a2 0xa 0x7a2 0xd>;
				pmic-xo-mode = <0x788 0x0 0x788 0x3 0x788 0x6 0x788 0x9 0xffff 0xffff 0x7a2 0x8 0x7a2 0xb>;
			};

			mt6357_charger {
				alias_name = "mt6357";
				charger_name = "primary_chg";
				compatible = "mediatek,mt6357-pulse-charger";
				cv = <0x426030>;
				ichg = <0x7a120>;
				phandle = <0x75>;
				vbat_ov_thres = <0x43e6d0>;
				vcdt_hv_thres = <0x6acfc0>;
			};

			mt6357_debug {
				compatible = "mediatek,mt63xx-debug";
			};

			mt6357_ts_buck1 {
				compatible = "mediatek,mt6357_ts_buck1";
				interconnects = <0x2e 0x1>;
				io-channel-names = "pmic_buck1_temp";
				io-channels = <0x27 0x6>;
				phandle = <0x76>;
			};

			mt6357_ts_buck2 {
				compatible = "mediatek,mt6357_ts_buck2";
				interconnects = <0x2e 0x1>;
				io-channel-names = "pmic_buck2_temp";
				io-channels = <0x27 0x7>;
				phandle = <0x77>;
			};

			mt6357keys {
				compatible = "mediatek,mt6357-keys";
				mediatek,long-press-mode = <0x1>;
				phandle = <0x74>;
				power-off-time-sec = <0x0>;

				home {
					linux,keycodes = <0x73>;
				};

				power {
					linux,keycodes = <0x74>;
					wakeup-source;
				};
			};

			mt6357regulator {
				compatible = "mediatek,mt6357-regulator";
				phandle = <0x78>;

				buck_vcore {
					phandle = <0x38>;
					regulator-always-on;
					regulator-enable-ramp-delay = <0xdc>;
					regulator-max-microvolt = <0x1406f4>;
					regulator-min-microvolt = <0x7ea5e>;
					regulator-name = "vcore";
					regulator-ramp-delay = <0x186a>;
				};

				buck_vmodem {
					phandle = <0x37>;
					regulator-always-on;
					regulator-enable-ramp-delay = <0xdc>;
					regulator-max-microvolt = <0x123716>;
					regulator-min-microvolt = <0x7a120>;
					regulator-name = "vmodem";
					regulator-ramp-delay = <0x186a>;
				};

				buck_vpa {
					phandle = <0x7b>;
					regulator-enable-ramp-delay = <0xdc>;
					regulator-max-microvolt = <0x37b1d0>;
					regulator-min-microvolt = <0x7a120>;
					regulator-name = "vpa";
					regulator-ramp-delay = <0xc350>;
				};

				buck_vproc {
					phandle = <0x7a>;
					regulator-always-on;
					regulator-enable-ramp-delay = <0xdc>;
					regulator-max-microvolt = <0x1406f4>;
					regulator-min-microvolt = <0x7ea5e>;
					regulator-name = "vproc";
					regulator-ramp-delay = <0x186a>;
				};

				buck_vs1 {
					phandle = <0x79>;
					regulator-always-on;
					regulator-enable-ramp-delay = <0xdc>;
					regulator-max-microvolt = <0x2191c0>;
					regulator-min-microvolt = <0x124f80>;
					regulator-name = "vs1";
					regulator-ramp-delay = <0x30d4>;
				};

				ldo_vaud28 {
					phandle = <0x8b>;
					regulator-always-on;
					regulator-enable-ramp-delay = <0x108>;
					regulator-max-microvolt = <0x2ab980>;
					regulator-min-microvolt = <0x2ab980>;
					regulator-name = "vaud28";
				};

				ldo_vaux18 {
					phandle = <0x8a>;
					regulator-always-on;
					regulator-enable-ramp-delay = <0x108>;
					regulator-max-microvolt = <0x1b7740>;
					regulator-min-microvolt = <0x1b7740>;
					regulator-name = "vaux18";
				};

				ldo_vcama {
					phandle = <0x85>;
					regulator-enable-ramp-delay = <0x108>;
					regulator-max-microvolt = <0x2ab980>;
					regulator-min-microvolt = <0x2625a0>;
					regulator-name = "vcama";
				};

				ldo_vcamd {
					phandle = <0x86>;
					regulator-enable-ramp-delay = <0x108>;
					regulator-max-microvolt = <0x1b7740>;
					regulator-min-microvolt = <0xf4240>;
					regulator-name = "vcamd";
				};

				ldo_vcamio {
					phandle = <0x87>;
					regulator-enable-ramp-delay = <0x108>;
					regulator-max-microvolt = <0x1b7740>;
					regulator-min-microvolt = <0x1b7740>;
					regulator-name = "vcamio";
				};

				ldo_vcn18 {
					phandle = <0x84>;
					regulator-enable-ramp-delay = <0x108>;
					regulator-max-microvolt = <0x1b7740>;
					regulator-min-microvolt = <0x1b7740>;
					regulator-name = "vcn18";
				};

				ldo_vcn28 {
					phandle = <0x83>;
					regulator-enable-ramp-delay = <0x108>;
					regulator-max-microvolt = <0x2ab980>;
					regulator-min-microvolt = <0x2ab980>;
					regulator-name = "vcn28";
				};

				ldo_vcn33_bt {
					phandle = <0x81>;
					regulator-enable-ramp-delay = <0x108>;
					regulator-max-microvolt = <0x3567e0>;
					regulator-min-microvolt = <0x325aa0>;
					regulator-name = "vcn33_bt";
				};

				ldo_vcn33_wifi {
					phandle = <0x82>;
					regulator-enable-ramp-delay = <0x108>;
					regulator-max-microvolt = <0x3567e0>;
					regulator-min-microvolt = <0x325aa0>;
					regulator-name = "vcn33_wifi";
				};

				ldo_vdram {
					phandle = <0x8e>;
					regulator-always-on;
					regulator-enable-ramp-delay = <0xce4>;
					regulator-max-microvolt = <0x124f80>;
					regulator-min-microvolt = <0x10c8e0>;
					regulator-name = "vdram";
				};

				ldo_vefuse {
					phandle = <0x80>;
					regulator-enable-ramp-delay = <0x108>;
					regulator-max-microvolt = <0x325aa0>;
					regulator-min-microvolt = <0x124f80>;
					regulator-name = "vefuse";
				};

				ldo_vemc {
					phandle = <0x54>;
					regulator-always-on;
					regulator-enable-ramp-delay = <0x2c>;
					regulator-max-microvolt = <0x325aa0>;
					regulator-min-microvolt = <0x2c4020>;
					regulator-name = "vemc";
				};

				ldo_vfe28 {
					phandle = <0x7c>;
					regulator-enable-ramp-delay = <0x108>;
					regulator-max-microvolt = <0x2ab980>;
					regulator-min-microvolt = <0x2ab980>;
					regulator-name = "vfe28";
				};

				ldo_vibr {
					phandle = <0x2>;
					regulator-enable-ramp-delay = <0x2c>;
					regulator-max-microvolt = <0x325aa0>;
					regulator-min-microvolt = <0x124f80>;
					regulator-name = "vibr";
				};

				ldo_vio18 {
					phandle = <0x8d>;
					regulator-always-on;
					regulator-enable-ramp-delay = <0x108>;
					regulator-max-microvolt = <0x1b7740>;
					regulator-min-microvolt = <0x1b7740>;
					regulator-name = "vio18";
				};

				ldo_vio28 {
					phandle = <0x8c>;
					regulator-always-on;
					regulator-enable-ramp-delay = <0x108>;
					regulator-max-microvolt = <0x2ab980>;
					regulator-min-microvolt = <0x2ab980>;
					regulator-name = "vio28";
				};

				ldo_vldo28 {
					phandle = <0x65>;
					regulator-enable-ramp-delay = <0x108>;
					regulator-max-microvolt = <0x2dc6c0>;
					regulator-min-microvolt = <0x2ab980>;
					regulator-name = "vldo28";
				};

				ldo_vmc {
					phandle = <0x5b>;
					regulator-enable-ramp-delay = <0x2c>;
					regulator-max-microvolt = <0x325aa0>;
					regulator-min-microvolt = <0x1b7740>;
					regulator-name = "vmc";
				};

				ldo_vmch {
					phandle = <0x5a>;
					regulator-enable-ramp-delay = <0x2c>;
					regulator-max-microvolt = <0x325aa0>;
					regulator-min-microvolt = <0x2c4020>;
					regulator-name = "vmch";
				};

				ldo_vrf12 {
					phandle = <0x7f>;
					regulator-enable-ramp-delay = <0x6e>;
					regulator-max-microvolt = <0x124f80>;
					regulator-min-microvolt = <0x124f80>;
					regulator-name = "vrf12";
				};

				ldo_vrf18 {
					phandle = <0x7e>;
					regulator-enable-ramp-delay = <0x6e>;
					regulator-max-microvolt = <0x1b7740>;
					regulator-min-microvolt = <0x1b7740>;
					regulator-name = "vrf18";
				};

				ldo_vsim1 {
					phandle = <0x8f>;
					regulator-enable-ramp-delay = <0x108>;
					regulator-max-microvolt = <0x2f4d60>;
					regulator-min-microvolt = <0x19f0a0>;
					regulator-name = "vsim1";
				};

				ldo_vsim2 {
					phandle = <0x90>;
					regulator-enable-ramp-delay = <0x108>;
					regulator-max-microvolt = <0x2f4d60>;
					regulator-min-microvolt = <0x19f0a0>;
					regulator-name = "vsim2";
				};

				ldo_vsram_others {
					phandle = <0x88>;
					regulator-always-on;
					regulator-enable-ramp-delay = <0x6e>;
					regulator-max-microvolt = <0x1406f4>;
					regulator-min-microvolt = <0x7ea5e>;
					regulator-name = "vsram_others";
					regulator-ramp-delay = <0x186a>;
				};

				ldo_vsram_proc {
					phandle = <0x89>;
					regulator-always-on;
					regulator-enable-ramp-delay = <0x6e>;
					regulator-max-microvolt = <0x1406f4>;
					regulator-min-microvolt = <0x7ea5e>;
					regulator-name = "vsram_proc";
					regulator-ramp-delay = <0x186a>;
				};

				ldo_vusb33 {
					phandle = <0x91>;
					regulator-always-on;
					regulator-enable-ramp-delay = <0x108>;
					regulator-max-microvolt = <0x2f4d60>;
					regulator-min-microvolt = <0x2dc6c0>;
					regulator-name = "vusb33";
				};

				ldo_vxo22 {
					phandle = <0x7d>;
					regulator-always-on;
					regulator-enable-ramp-delay = <0x6e>;
					regulator-max-microvolt = <0x249f00>;
					regulator-min-microvolt = <0x2191c0>;
					regulator-name = "vxo22";
				};
			};

			mt63xx-oc-debug {
				compatible = "mediatek,mt63xx-oc-debug";
			};

			mtk_battery_oc_throttling {
				compatible = "mediatek,mt6357-battery_oc_throttling";
				oc-thd-h = <0x123e>;
				oc-thd-l = <0x157c>;
			};

			mtk_charger_type {
				bc12_active = <0x1>;
				compatible = "mediatek,mt6357-charger-type";
				io-channel-names = "pmic_vbus";
				io-channels = <0x27 0x2>;
				phandle = <0x29>;
			};

			mtk_dynamic_loading_throttling {
				compatible = "mediatek,mt6357-dynamic_loading_throttling";
				io-channel-names = "pmic_ptim", "pmic_imix_r", "pmic_isense", "pmic_batadc";
				io-channels = <0x27 0xf 0x27 0x10 0x27 0x1 0x27 0x0>;
				isense_support;
				mediatek,charger = <0x2f>;
				uvlo-level = <0xa28>;
			};

			mtk_gauge {
				ACTIVE_TABLE = <0x0>;
				CAR_TUNE_VALUE = <0x63>;
				COM_FG_METER_RESISTANCE = <0x64>;
				COM_R_FG_VALUE = <0x0>;
				DIFFERENCE_FULLOCV_ITH = <0xc8>;
				EMBEDDED_SEL = <0x1>;
				FG_METER_RESISTANCE = <0x4b>;
				KEEP_100_PERCENT = <0x4>;
				MULTI_BATTERY = <0x0>;
				MULTI_TEMP_GAUGE0 = <0x1>;
				PMIC_MIN_VOL = <0x82dc>;
				PMIC_SHUTDOWN_CURRENT = <0x14>;
				POWERON_SYSTEM_IBOOT = <0x1f4>;
				Q_MAX_SYS_VOLTAGE_BAT0 = <0xd16>;
				Q_MAX_SYS_VOLTAGE_BAT1 = <0xd16>;
				Q_MAX_SYS_VOLTAGE_BAT2 = <0xd16>;
				Q_MAX_SYS_VOLTAGE_BAT3 = <0xd16>;
				RBAT_PULL_UP_R = <0x27100>;
				RBAT_PULL_UP_VOLT = <0x708>;
				R_FG_VALUE = <0xa>;
				SHUTDOWN_1_TIME = <0x1e>;
				SHUTDOWN_GAUGE0_VOLTAGE = <0x84d0>;
				TEMPERATURE_T0 = <0x32>;
				TEMPERATURE_T1 = <0x19>;
				TEMPERATURE_T2 = <0xa>;
				TEMPERATURE_T3 = <0x0>;
				TEMPERATURE_T4 = <0xfffffffa>;
				TEMPERATURE_T5 = <0xfffffff6>;
				battery0_name = "JIADE_VK";
				battery0_profile_t0 = <0x0 0xaae9 0x384 0x1c7 0xaa75 0x389 0x38d 0xaa04 0x389 0x554 0xa996 0x38b 0x71a 0xa924 0x38f 0x8e1 0xa8af 0x388 0xaa7 0xa83b 0x386 0xc6e 0xa7c5 0x38b 0xe34 0xa74d 0x38c 0xffb 0xa6d4 0x38c 0x11c1 0xa65d 0x391 0x1388 0xa5e5 0x393 0x154f 0xa56c 0x38c 0x1715 0xa4f3 0x38a 0x18dc 0xa47e 0x395 0x1aa2 0xa407 0x396 0x1c69 0xa393 0x39b 0x1e2f 0xa320 0x39f 0x1ff6 0xa2ab 0x39b 0x21bc 0xa238 0x39c 0x2383 0xa1c8 0x3a2 0x2549 0xa155 0x3a2 0x2710 0xa0ea 0x3a9 0x28d7 0xa079 0x3a9 0x2a9d 0xa00e 0x3a9 0x2c64 0x9fa5 0x3b4 0x2e2a 0x9f3f 0x3be 0x2ff1 0x9ed8 0x3c3 0x31b7 0x9e73 0x3c5 0x337e 0x9e13 0x3c8 0x3544 0x9db5 0x3cb 0x370b 0x9d5c 0x3da 0x38d1 0x9d02 0x3e1 0x3a98 0x9ca4 0x3e8 0x3c5f 0x9c4a 0x3ee 0x3e25 0x9bf3 0x3f5 0x3fec 0x9b9b 0x3fc 0x41b2 0x9b48 0x415 0x4379 0x9af3 0x42e 0x453f 0x9a9c 0x43e 0x4706 0x9a3f 0x44c 0x48cc 0x99c9 0x43c 0x4a93 0x9930 0x3ef 0x4c59 0x989b 0x39a 0x4e20 0x9836 0x394 0x4fe7 0x97e5 0x38d 0x51ad 0x979d 0x38a 0x5374 0x9758 0x38b 0x553a 0x9719 0x38b 0x5701 0x96da 0x384 0x58c7 0x969e 0x37d 0x5a8e 0x9667 0x384 0x5c54 0x9632 0x38b 0x5e1b 0x95fd 0x38b 0x5fe1 0x95ca 0x384 0x61a8 0x959d 0x392 0x636f 0x956e 0x393 0x6535 0x9540 0x393 0x66fc 0x9515 0x391 0x68c2 0x94eb 0x396 0x6a89 0x94c4 0x39e 0x6c4f 0x949f 0x3a7 0x6e16 0x947b 0x3b3 0x6fdc 0x9459 0x3bb 0x71a3 0x9438 0x3ca 0x7369 0x9419 0x3d1 0x7530 0x93f7 0x3d8 0x76f7 0x93d8 0x3df 0x78bd 0x93b0 0x3db 0x7a84 0x9373 0x3b9 0x7c4a 0x9323 0x38f 0x7e11 0x92d7 0x37d 0x7fd7 0x929f 0x382 0x819e 0x9271 0x388 0x8364 0x9245 0x390 0x852b 0x9212 0x381 0x86f1 0x91e2 0x37a 0x88b8 0x91ba 0x383 0x8a7f 0x9196 0x38a 0x8c45 0x9171 0x38f 0x8e0c 0x9145 0x396 0x8fd2 0x910e 0x393 0x9199 0x90cf 0x387 0x935f 0x9091 0x386 0x9526 0x9058 0x391 0x96ec 0x9010 0x38d 0x98b3 0x8fbe 0x363 0x9a79 0x8fa5 0x35c 0x9c40 0x8f9b 0x37e 0x9e07 0x8f92 0x39b 0x9fcd 0x8f88 0x3c2 0xa194 0x8f72 0x3f4 0xa35a 0x8f32 0x40f 0xa521 0x8e6a 0x3ee 0xa6e7 0x8ce2 0x3c2 0xa8ae 0x8aca 0x3ea 0xaa74 0x8803 0x43d 0xac3b 0x83ff 0x4d7 0xae01 0x7bd8 0xab0 0xafc8 0x7b2c 0xb2c>;
				battery0_profile_t0_col = <0x3>;
				battery0_profile_t0_num = <0x64>;
				battery0_profile_t1 = <0x0 0xab52 0x47e 0x1c7 0xaadf 0x516 0x38d 0xaa72 0x52c 0x554 0xaa05 0x538 0x71a 0xa993 0x537 0x8e1 0xa920 0x535 0xaa7 0xa8a8 0x532 0xc6e 0xa82d 0x52f 0xe34 0xa7b3 0x529 0xffb 0xa738 0x51f 0x11c1 0xa6c2 0x525 0x1388 0xa648 0x51e 0x154f 0xa5cf 0x517 0x1715 0xa559 0x51d 0x18dc 0xa4e0 0x511 0x1aa2 0xa468 0x4f9 0x1c69 0xa3f4 0x4ee 0x1e2f 0xa37f 0x4e8 0x1ff6 0xa30a 0x4cf 0x21bc 0xa297 0x4b5 0x2383 0xa226 0x4c1 0x2549 0xa1b6 0x4e2 0x2710 0xa148 0x4f6 0x28d7 0xa0d7 0x4f6 0x2a9d 0xa069 0x50a 0x2c64 0x9ffb 0x514 0x2e2a 0x9f8d 0x512 0x2ff1 0x9f2b 0x51f 0x31b7 0x9edf 0x550 0x337e 0x9e9a 0x580 0x3544 0x9e3a 0x57d 0x370b 0x9dae 0x55f 0x38d1 0x9d1f 0x56b 0x3a98 0x9c98 0x56b 0x3c5f 0x9c2f 0x572 0x3e25 0x9be6 0x58c 0x3fec 0x9bb4 0x5b9 0x41b2 0x9b7d 0x5d2 0x4379 0x9b36 0x5d7 0x453f 0x9ae4 0x5e5 0x4706 0x9a8c 0x5f6 0x48cc 0x9a28 0x5eb 0x4a93 0x99ab 0x5b2 0x4c59 0x9914 0x543 0x4e20 0x9883 0x4e0 0x4fe7 0x981e 0x4cb 0x51ad 0x97ca 0x4bd 0x5374 0x9783 0x4be 0x553a 0x9742 0x4c1 0x5701 0x9703 0x4b9 0x58c7 0x96c6 0x4b3 0x5a8e 0x968e 0x4b3 0x5c54 0x9658 0x4b2 0x5e1b 0x9623 0x4b0 0x5fe1 0x95f3 0x4b0 0x61a8 0x95c4 0x4ab 0x636f 0x9594 0x4a9 0x6535 0x9569 0x4af 0x66fc 0x953f 0x4b2 0x68c2 0x9519 0x4c1 0x6a89 0x94f0 0x4c5 0x6c4f 0x94ca 0x4c8 0x6e16 0x94a7 0x4d1 0x6fdc 0x9485 0x4d5 0x71a3 0x9465 0x4e4 0x7369 0x9443 0x4f1 0x7530 0x9427 0x505 0x76f7 0x9408 0x50e 0x78bd 0x93ec 0x51b 0x7a84 0x93cd 0x523 0x7c4a 0x93a7 0x51c 0x7e11 0x9379 0x501 0x7fd7 0x934c 0x4ef 0x819e 0x9321 0x4e9 0x8364 0x92f8 0x4e2 0x852b 0x92d0 0x4e6 0x86f1 0x92a6 0x4d8 0x88b8 0x927c 0x4db 0x8a7f 0x925c 0x4df 0x8c45 0x923b 0x4ec 0x8e0c 0x9217 0x4fb 0x8fd2 0x91e8 0x4fe 0x9199 0x91af 0x503 0x935f 0x9171 0x508 0x9526 0x9138 0x515 0x96ec 0x90fe 0x52f 0x98b3 0x90b1 0x530 0x9a79 0x905d 0x51f 0x9c40 0x903e 0x526 0x9e07 0x9033 0x53c 0x9fcd 0x9027 0x557 0xa194 0x901a 0x584 0xa35a 0x9004 0x5ba 0xa521 0x8fcc 0x5f6 0xa6e7 0x8f0c 0x5f9 0xa8ae 0x8d8b 0x5ee 0xaa74 0x8b59 0x62f 0xac3b 0x8854 0x694 0xae01 0x83ab 0x8d7 0xafc8 0x7a49 0x1976>;
				battery0_profile_t1_col = <0x3>;
				battery0_profile_t1_num = <0x64>;
				battery0_profile_t2 = <0x0 0xab6e 0x4e2 0x1c7 0xaae9 0xb19 0x38d 0xaa72 0xbd7 0x554 0xa9fb 0xbde 0x71a 0xa983 0xbcf 0x8e1 0xa906 0xbbb 0xaa7 0xa88b 0xbaa 0xc6e 0xa810 0xb96 0xe34 0xa796 0xb7f 0xffb 0xa71f 0xb73 0x11c1 0xa6a6 0xb52 0x1388 0xa630 0xb3e 0x154f 0xa5b9 0xb27 0x1715 0xa540 0xb12 0x18dc 0xa4cc 0xb01 0x1aa2 0xa458 0xaf3 0x1c69 0xa3e6 0xaee 0x1e2f 0xa376 0xae7 0x1ff6 0xa305 0xadc 0x21bc 0xa294 0xad3 0x2383 0xa224 0xac8 0x2549 0xa1b6 0xac8 0x2710 0xa148 0xac8 0x28d7 0xa0d7 0xac1 0x2a9d 0xa069 0xaac 0x2c64 0xa002 0xaa2 0x2e2a 0x9fa8 0xaae 0x2ff1 0x9f5e 0xae6 0x31b7 0x9f19 0xb38 0x337e 0x9ebf 0xb5f 0x3544 0x9e3c 0xb36 0x370b 0x9d99 0xaf3 0x38d1 0x9cef 0xabc 0x3a98 0x9c57 0xaa8 0x3c5f 0x9be1 0xa9a 0x3e25 0x9b82 0xaa1 0x3fec 0x9b34 0xab3 0x41b2 0x9af5 0xad1 0x4379 0x9ab6 0xae4 0x453f 0x9a6e 0xadd 0x4706 0x9a14 0xaae 0x48cc 0x99a6 0xa57 0x4a93 0x9932 0x9fa 0x4c59 0x98ba 0x9a2 0x4e20 0x984f 0x963 0x4fe7 0x97f4 0x93e 0x51ad 0x97a5 0x930 0x5374 0x975c 0x927 0x553a 0x971a 0x91f 0x5701 0x96db 0x91d 0x58c7 0x96a0 0x91c 0x5a8e 0x9669 0x91f 0x5c54 0x9633 0x929 0x5e1b 0x95fe 0x935 0x5fe1 0x95cb 0x934 0x61a8 0x959e 0x942 0x636f 0x9571 0x952 0x6535 0x9544 0x95a 0x66fc 0x951c 0x960 0x68c2 0x94f4 0x971 0x6a89 0x94ce 0x981 0x6c4f 0x94aa 0x98d 0x6e16 0x9487 0x99a 0x6fdc 0x9465 0x9a9 0x71a3 0x9443 0x9ad 0x7369 0x9424 0x9c0 0x7530 0x940b 0x9ce 0x76f7 0x93ec 0x9d5 0x78bd 0x93d2 0x9dc 0x7a84 0x93bc 0x9ea 0x7c4a 0x93a9 0x9fd 0x7e11 0x9396 0xa11 0x7fd7 0x9381 0xa2a 0x819e 0x9367 0xa3b 0x8364 0x9348 0xa44 0x852b 0x9327 0xa66 0x86f1 0x92fd 0xa7e 0x88b8 0x92d5 0xaa0 0x8a7f 0x92ae 0xad2 0x8c45 0x9287 0xb10 0x8e0c 0x925d 0xb5b 0x8fd2 0x9229 0xba3 0x9199 0x91eb 0xbf6 0x935f 0x91aa 0xc51 0x9526 0x916a 0xcb8 0x96ec 0x9127 0xd2f 0x98b3 0x90d8 0xda7 0x9a79 0x908b 0xe27 0x9c40 0x9063 0xed5 0x9e07 0x904a 0xf94 0x9fcd 0x9036 0x1072 0xa194 0x901e 0x1176 0xa35a 0x8ff8 0x12a3 0xa521 0x8fa8 0x1405 0xa6e7 0x8ee6 0x154d 0xa8ae 0x8d6d 0x1679 0xaa74 0x8b2b 0x1822 0xac3b 0x880a 0x1ad1 0xae01 0x841c 0x1e12 0xafc8 0x841c 0x1e12>;
				battery0_profile_t2_col = <0x3>;
				battery0_profile_t2_num = <0x64>;
				battery0_profile_t3 = <0x0 0xab77 0x726 0x1c7 0xaada 0x14e2 0x38d 0xaa48 0x165a 0x554 0xa9bd 0x164a 0x71a 0xa933 0x161a 0x8e1 0xa8ab 0x15d9 0xaa7 0xa825 0x1599 0xc6e 0xa7a4 0x155b 0xe34 0xa72a 0x1519 0xffb 0xa6b3 0x14e2 0x11c1 0xa639 0x14a8 0x1388 0xa5c0 0x1478 0x154f 0xa54a 0x143f 0x1715 0xa4d3 0x1400 0x18dc 0xa45f 0x13d1 0x1aa2 0xa3ef 0x13b1 0x1c69 0xa37f 0x1384 0x1e2f 0xa310 0x1353 0x1ff6 0xa2a2 0x132d 0x21bc 0xa232 0x1306 0x2383 0xa1c4 0x12d7 0x2549 0xa156 0x12b2 0x2710 0xa0e8 0x1287 0x28d7 0xa077 0x1240 0x2a9d 0xa01d 0x122d 0x2c64 0x9fcd 0x1252 0x2e2a 0x9f7a 0x1279 0x2ff1 0x9f22 0x1294 0x31b7 0x9eb4 0x1283 0x337e 0x9e2a 0x123d 0x3544 0x9d90 0x11e6 0x370b 0x9ceb 0x119b 0x38d1 0x9c4f 0x115a 0x3a98 0x9bc8 0x1121 0x3c5f 0x9b55 0x10f8 0x3e25 0x9af1 0x10db 0x3fec 0x9a9c 0x10cb 0x41b2 0x9a4e 0x10bc 0x4379 0x99fc 0x109c 0x453f 0x99a5 0x106b 0x4706 0x994a 0x102e 0x48cc 0x98ed 0xfe9 0x4a93 0x9890 0xfab 0x4c59 0x9837 0xf75 0x4e20 0x97e2 0xf52 0x4fe7 0x9793 0xf35 0x51ad 0x974a 0xf13 0x5374 0x9707 0xf00 0x553a 0x96ca 0xefb 0x5701 0x968f 0xef7 0x58c7 0x9656 0xefa 0x5a8e 0x9622 0xf0c 0x5c54 0x95f0 0xf1c 0x5e1b 0x95bd 0xf1b 0x5fe1 0x958d 0xf1d 0x61a8 0x955d 0xf2b 0x636f 0x9533 0xf41 0x6535 0x950b 0xf54 0x66fc 0x94e2 0xf64 0x68c2 0x94bd 0xf79 0x6a89 0x949a 0xf89 0x6c4f 0x9476 0xf9a 0x6e16 0x9455 0xfa7 0x6fdc 0x9435 0xfb0 0x71a3 0x941c 0xfc7 0x7369 0x9403 0xfd1 0x7530 0x93f3 0xffd 0x76f7 0x93e2 0x101f 0x78bd 0x93d4 0x1057 0x7a84 0x93c3 0x108f 0x7c4a 0x93b2 0x10d0 0x7e11 0x93a0 0x1117 0x7fd7 0x938b 0x1161 0x819e 0x9372 0x11ab 0x8364 0x9356 0x1201 0x852b 0x9338 0x1270 0x86f1 0x9313 0x12c1 0x88b8 0x92ee 0x1331 0x8a7f 0x92c4 0x13ab 0x8c45 0x9297 0x1441 0x8e0c 0x9263 0x14e2 0x8fd2 0x922a 0x157f 0x9199 0x91eb 0x1623 0x935f 0x91a8 0x16e1 0x9526 0x9160 0x17b9 0x96ec 0x9119 0x189e 0x98b3 0x90d6 0x198d 0x9a79 0x909d 0x1a9f 0x9c40 0x9070 0x1be4 0x9e07 0x9050 0x1d34 0x9fcd 0x9034 0x1ed2 0xa194 0x9006 0x208b 0xa35a 0x8fba 0x2292 0xa521 0x8f2a 0x24bb 0xa6e7 0x8e27 0x26e3 0xa8ae 0x8c81 0x2955 0xaa74 0x8a14 0x2cae 0xac3b 0x8686 0x3192 0xae01 0x81c2 0x37c3 0xafc8 0x81c2 0x37c3>;
				battery0_profile_t3_col = <0x3>;
				battery0_profile_t3_num = <0x64>;
				battery0_profile_t4 = <0x0 0xabb5 0x29ea 0x1c7 0xaaed 0x29e8 0x38d 0xaa39 0x2a54 0x554 0xa987 0x2a48 0x71a 0xa8de 0x29f7 0x8e1 0xa83b 0x2991 0xaa7 0xa7a3 0x2924 0xc6e 0xa715 0x28b6 0xe34 0xa689 0x2847 0xffb 0xa5ff 0x27d3 0x11c1 0xa578 0x2771 0x1388 0xa4f6 0x2706 0x154f 0xa478 0x2697 0x1715 0xa3fe 0x264c 0x18dc 0xa387 0x25ee 0x1aa2 0xa310 0x2595 0x1c69 0xa298 0x2539 0x1e2f 0xa222 0x24e5 0x1ff6 0xa1af 0x2493 0x21bc 0xa13e 0x2439 0x2383 0xa0d6 0x2402 0x2549 0xa07d 0x23f0 0x2710 0xa028 0x23f0 0x28d7 0x9fc8 0x23d9 0x2a9d 0x9f51 0x2394 0x2c64 0x9ec8 0x232f 0x2e2a 0x9e36 0x22b7 0x2ff1 0x9da0 0x223c 0x31b7 0x9d0c 0x21c0 0x337e 0x9c7f 0x2150 0x3544 0x9bff 0x20f5 0x370b 0x9b8b 0x20a9 0x38d1 0x9b20 0x207e 0x3a98 0x9ac1 0x2056 0x3c5f 0x9a6f 0x2041 0x3e25 0x9a20 0x2031 0x3fec 0x99d1 0x2012 0x41b2 0x997e 0x1fea 0x4379 0x9928 0x1fd0 0x453f 0x98cf 0x1faa 0x4706 0x9877 0x1f73 0x48cc 0x9824 0x1f50 0x4a93 0x97d5 0x1f39 0x4c59 0x9787 0x1f26 0x4e20 0x973e 0x1f18 0x4fe7 0x96fa 0x1f08 0x51ad 0x96b9 0x1f09 0x5374 0x967b 0x1f0e 0x553a 0x963f 0x1f11 0x5701 0x9607 0x1f19 0x58c7 0x95d3 0x1f2d 0x5a8e 0x95a1 0x1f43 0x5c54 0x9572 0x1f51 0x5e1b 0x9545 0x1f63 0x5fe1 0x951b 0x1f80 0x61a8 0x94f7 0x1fa4 0x636f 0x94d0 0x1fb8 0x6535 0x94b0 0x1fe1 0x66fc 0x9493 0x2017 0x68c2 0x947d 0x203c 0x6a89 0x9469 0x2075 0x6c4f 0x9455 0x20be 0x6e16 0x9444 0x211d 0x6fdc 0x9436 0x219c 0x71a3 0x9427 0x2209 0x7369 0x9416 0x2288 0x7530 0x9405 0x2300 0x76f7 0x93f7 0x239b 0x78bd 0x93e6 0x2435 0x7a84 0x93d6 0x24d7 0x7c4a 0x93c1 0x2579 0x7e11 0x93ac 0x2616 0x7fd7 0x9397 0x26cd 0x819e 0x937d 0x278d 0x8364 0x935f 0x2846 0x852b 0x9344 0x2934 0x86f1 0x9322 0x2a16 0x88b8 0x92fb 0x2b07 0x8a7f 0x92ce 0x2bfc 0x8c45 0x92a3 0x2d06 0x8e0c 0x9270 0x2e1d 0x8fd2 0x9239 0x2f37 0x9199 0x91fe 0x3061 0x935f 0x91c1 0x3189 0x9526 0x9180 0x32a3 0x96ec 0x913b 0x33bb 0x98b3 0x90fb 0x34ce 0x9a79 0x90c1 0x35e2 0x9c40 0x908f 0x3703 0x9e07 0x906a 0x3823 0x9fcd 0x904a 0x392b 0xa194 0x902b 0x3a57 0xa35a 0x8ffb 0x3b8d 0xa521 0x8f9b 0x3cbf 0xa6e7 0x8ee0 0x3ddd 0xa8ae 0x8d8c 0x3ef9 0xaa74 0x8b6e 0x407f 0xac3b 0x8855 0x42f9 0xae01 0x8456 0x45f6 0xafc8 0x8456 0x45f6>;
				battery0_profile_t4_col = <0x3>;
				battery0_profile_t4_num = <0x64>;
				battery1_name = "FENGHUA_FHPV";
				battery1_profile_t0 = <0x0 0xab5e 0x406 0x1ce 0xaaa4 0x401 0x39c 0xaa0d 0x3f8 0x56b 0xa98b 0x3fd 0x739 0xa90a 0x3f6 0x907 0xa88c 0x3f0 0xad5 0xa814 0x3f2 0xca4 0xa79c 0x3f9 0xe72 0xa723 0x3f7 0x1040 0xa6a6 0x3f1 0x120e 0xa62c 0x3f0 0x13dc 0xa5b4 0x3f8 0x15ab 0xa53b 0x3f7 0x1779 0xa4c4 0x3f7 0x1947 0xa44e 0x3f7 0x1b15 0xa3d9 0x3fc 0x1ce4 0xa364 0x400 0x1eb2 0xa2f1 0x405 0x2080 0xa27f 0x408 0x224e 0xa20a 0x406 0x241c 0xa197 0x406 0x25eb 0xa126 0x3ff 0x27b9 0xa0b8 0x410 0x2987 0xa04b 0x40f 0x2b55 0x9fde 0x418 0x2d24 0x9f75 0x419 0x2ef2 0x9f0a 0x41d 0x30c0 0x9ea2 0x421 0x328e 0x9e3b 0x427 0x345c 0x9dd7 0x427 0x362b 0x9d73 0x42a 0x37f9 0x9d13 0x436 0x39c7 0x9cb3 0x439 0x3b95 0x9c57 0x43f 0x3d64 0x9bfd 0x44a 0x3f32 0x9ba7 0x459 0x4100 0x9b50 0x463 0x42ce 0x9afa 0x46f 0x449c 0x9aa6 0x481 0x466b 0x9a4f 0x483 0x4839 0x99fa 0x499 0x4a07 0x999d 0x49d 0x4bd5 0x9957 0x4e2 0x4da4 0x98c5 0x46f 0x4f72 0x983c 0x43d 0x5140 0x97c3 0x414 0x530e 0x9764 0x404 0x54dc 0x9713 0x3f7 0x56ab 0x96ce 0x3f4 0x5879 0x968e 0x3ef 0x5a47 0x9652 0x3ef 0x5c15 0x9619 0x3ef 0x5de4 0x95e4 0x3f0 0x5fb2 0x95af 0x3f4 0x6180 0x957e 0x3f7 0x634e 0x954d 0x3f2 0x651c 0x9521 0x3f5 0x66eb 0x94f7 0x3fd 0x68b9 0x94c9 0x3fe 0x6a87 0x94a1 0x405 0x6c55 0x947b 0x406 0x6e24 0x9457 0x406 0x6ff2 0x9433 0x410 0x71c0 0x9410 0x418 0x738e 0x93f0 0x419 0x755c 0x93d2 0x427 0x772b 0x93b1 0x427 0x78f9 0x9392 0x42a 0x7ac7 0x9372 0x438 0x7c95 0x934a 0x435 0x7e64 0x9314 0x41c 0x8032 0x92d1 0x400 0x8200 0x928c 0x3ef 0x83ce 0x9256 0x3ef 0x859c 0x9228 0x3f4 0x876b 0x91fc 0x3f2 0x8939 0x91ce 0x3ef 0x8b07 0x91a1 0x3f0 0x8cd5 0x917b 0x3ef 0x8ea4 0x9157 0x3fc 0x9072 0x9131 0x407 0x9240 0x9101 0x406 0x940e 0x90c4 0x406 0x95dc 0x9080 0x3f7 0x97ab 0x9045 0x400 0x9979 0x9001 0x40a 0x9b47 0x8fb1 0x3ea 0x9d15 0x8f7d 0x3d7 0x9ee4 0x8f6f 0x3f0 0xa0b2 0x8f67 0x413 0xa280 0x8f58 0x43c 0xa44e 0x8f43 0x46e 0xa61c 0x8f17 0x49d 0xa7eb 0x8e7d 0x474 0xa9b9 0x8d22 0x442 0xab87 0x8b1e 0x44c 0xad55 0x8863 0x473 0xaf24 0x845f 0x4c0 0xb0f2 0x832a 0x4d8 0xb2c0 0x832a 0x4d8>;
				battery1_profile_t0_col = <0x3>;
				battery1_profile_t0_num = <0x64>;
				battery1_profile_t1 = <0x0 0xabc5 0x550 0x1ce 0xab27 0x54e 0x39c 0xaaa8 0x55c 0x56b 0xaa31 0x55b 0x739 0xa9bf 0x554 0x907 0xa94b 0x553 0xad5 0xa8d2 0x551 0xca4 0xa859 0x54d 0xe72 0xa7df 0x549 0x1040 0xa764 0x544 0x120e 0xa6ec 0x545 0x13dc 0xa673 0x53c 0x15ab 0xa5fb 0x53e 0x1779 0xa582 0x53b 0x1947 0xa50b 0x53b 0x1b15 0xa495 0x53c 0x1ce4 0xa41e 0x53e 0x1eb2 0xa3a8 0x53c 0x2080 0xa332 0x535 0x224e 0xa2c0 0x543 0x241c 0xa24e 0x544 0x25eb 0xa1dc 0x54d 0x27b9 0xa16a 0x54c 0x2987 0xa0fb 0x555 0x2b55 0xa087 0x555 0x2d24 0xa018 0x55c 0x2ef2 0x9fab 0x561 0x30c0 0x9f41 0x571 0x328e 0x9ee7 0x56e 0x345c 0x9e9a 0x5af 0x362b 0x9e3a 0x5f6 0x37f9 0x9db3 0x5b7 0x39c7 0x9d1b 0x59a 0x3b95 0x9c8e 0x5a3 0x3d64 0x9c18 0x5a9 0x3f32 0x9bbc 0x5b4 0x4100 0x9b7e 0x5d9 0x42ce 0x9b42 0x5ee 0x449c 0x9af5 0x5ee 0x466b 0x9a9c 0x5e1 0x4839 0x9a3a 0x5d9 0x4a07 0x99ca 0x5b6 0x4bd5 0x9955 0x586 0x4da4 0x98de 0x554 0x4f72 0x9870 0x524 0x5140 0x980c 0x500 0x530e 0x97b7 0x4e9 0x54dc 0x9769 0x4d8 0x56ab 0x9722 0x4d5 0x5879 0x96e0 0x4cd 0x5a47 0x96a3 0x4cd 0x5c15 0x966a 0x4c6 0x5de4 0x9633 0x4c5 0x5fb2 0x95ff 0x4ce 0x6180 0x95ce 0x4cb 0x634e 0x959f 0x4cf 0x651c 0x956f 0x4ca 0x66eb 0x9543 0x4d0 0x68b9 0x9519 0x4d0 0x6a87 0x94ef 0x4d8 0x6c55 0x94cb 0x4e0 0x6e24 0x94a7 0x4e9 0x6ff2 0x9480 0x4e1 0x71c0 0x945f 0x4ef 0x738e 0x943c 0x4ef 0x755c 0x941c 0x4f1 0x772b 0x93fe 0x4f6 0x78f9 0x93dd 0x4f6 0x7ac7 0x93bd 0x4f3 0x7c95 0x939c 0x4ef 0x7e64 0x937b 0x4ef 0x8032 0x9357 0x4e1 0x8200 0x9334 0x4d3 0x83ce 0x9310 0x4cb 0x859c 0x92eb 0x4c9 0x876b 0x92c2 0x4c3 0x8939 0x9298 0x4b9 0x8b07 0x9270 0x4c0 0x8cd5 0x924c 0x4c2 0x8ea4 0x922b 0x4d8 0x9072 0x9201 0x4d1 0x9240 0x91cc 0x4d8 0x940e 0x9190 0x4d7 0x95dc 0x9150 0x4d3 0x97ab 0x9113 0x4de 0x9979 0x90cb 0x4da 0x9b47 0x907e 0x4dd 0x9d15 0x9046 0x4d8 0x9ee4 0x902f 0x4df 0xa0b2 0x9022 0x4f7 0xa280 0x9012 0x514 0xa44e 0x8ff8 0x539 0xa61c 0x8fcb 0x56a 0xa7eb 0x8f48 0x585 0xa9b9 0x8df3 0x55d 0xab87 0x8bea 0x56b 0xad55 0x891f 0x5a2 0xaf24 0x84fc 0x61f 0xb0f2 0x8491 0x62c 0xb2c0 0x8491 0x62c>;
				battery1_profile_t1_col = <0x3>;
				battery1_profile_t1_num = <0x64>;
				battery1_profile_t2 = <0x0 0xabcb 0x92e 0x1ce 0xab38 0x933 0x39c 0xaaaa 0x9c8 0x56b 0xaa2a 0x9d5 0x739 0xa9b0 0x9c3 0x907 0xa934 0x9b4 0xad5 0xa8b8 0x9a2 0xca4 0xa83b 0x98f 0xe72 0xa7c0 0x97a 0x1040 0xa746 0x95f 0x120e 0xa6cd 0x950 0x13dc 0xa655 0x93b 0x15ab 0xa5dd 0x92a 0x1779 0xa567 0x915 0x1947 0xa4f2 0x903 0x1b15 0xa47d 0x8f9 0x1ce4 0xa40a 0x8ef 0x1eb2 0xa395 0x8e0 0x2080 0xa326 0x8e5 0x224e 0xa2c9 0x913 0x241c 0xa248 0x8f4 0x25eb 0xa1d3 0x8e7 0x27b9 0xa15e 0x8d8 0x2987 0xa0ed 0x8e1 0x2b55 0xa07c 0x8e3 0x2d24 0xa00a 0x8da 0x2ef2 0x9fa1 0x8e0 0x30c0 0x9f45 0x8f1 0x328e 0x9ef5 0x916 0x345c 0x9e9e 0x932 0x362b 0x9e27 0x92f 0x37f9 0x9d8a 0x90f 0x39c7 0x9cdb 0x8e6 0x3b95 0x9c3a 0x8c8 0x3d64 0x9bb1 0x8b0 0x3f32 0x9b3f 0x89c 0x4100 0x9add 0x88c 0x42ce 0x9a88 0x882 0x449c 0x9a38 0x874 0x466b 0x99ea 0x864 0x4839 0x9992 0x833 0x4a07 0x9937 0x803 0x4bd5 0x98dc 0x7e5 0x4da4 0x9881 0x7c3 0x4f72 0x9828 0x7a1 0x5140 0x97d6 0x782 0x530e 0x9789 0x776 0x54dc 0x9745 0x775 0x56ab 0x9700 0x769 0x5879 0x96bf 0x761 0x5a47 0x9684 0x760 0x5c15 0x964b 0x75e 0x5de4 0x9612 0x757 0x5fb2 0x95df 0x759 0x6180 0x95af 0x762 0x634e 0x957d 0x75d 0x651c 0x954f 0x763 0x66eb 0x9524 0x762 0x68b9 0x94fa 0x76b 0x6a87 0x94d3 0x773 0x6c55 0x94af 0x77b 0x6e24 0x9484 0x772 0x6ff2 0x9464 0x781 0x71c0 0x9443 0x78b 0x738e 0x9423 0x792 0x755c 0x9402 0x78d 0x772b 0x93e4 0x789 0x78f9 0x93ca 0x798 0x7ac7 0x93b0 0x792 0x7c95 0x9397 0x795 0x7e64 0x9382 0x79e 0x8032 0x936d 0x7a2 0x8200 0x9354 0x7a5 0x83ce 0x933d 0x7af 0x859c 0x9321 0x7b8 0x876b 0x9302 0x7bf 0x8939 0x92e1 0x7c7 0x8b07 0x92ba 0x7c6 0x8cd5 0x9293 0x7cf 0x8ea4 0x9269 0x7e6 0x9072 0x923b 0x7fd 0x9240 0x9201 0x808 0x940e 0x91c3 0x81a 0x95dc 0x9184 0x83a 0x97ab 0x9141 0x85c 0x9979 0x90f3 0x879 0x9b47 0x90a6 0x894 0x9d15 0x9072 0x8bb 0x9ee4 0x9052 0x8ec 0xa0b2 0x9038 0x92b 0xa280 0x901e 0x98e 0xa44e 0x8ff7 0xa06 0xa61c 0x8fa2 0xa99 0xa7eb 0x8ee0 0xb3f 0xa9b9 0x8d73 0xbd4 0xab87 0x8b45 0xca2 0xad55 0x882f 0xe29 0xaf24 0x835c 0x1105 0xb0f2 0x82df 0x1151 0xb2c0 0x82df 0x1151>;
				battery1_profile_t2_col = <0x3>;
				battery1_profile_t2_num = <0x64>;
				battery1_profile_t3 = <0x0 0xab5b 0xec4 0x1ce 0xaa96 0xed2 0x39c 0xa9e9 0x1036 0x56b 0xa952 0x1049 0x739 0xa8be 0x1043 0x907 0xa82f 0x103f 0xad5 0xa7a6 0x1031 0xca4 0xa723 0x1021 0xe72 0xa6a0 0x100b 0x1040 0xa625 0xef8 0x120e 0xa5ab 0xec8 0x13dc 0xa52c 0xfd4 0x15ab 0xa4b1 0xfbf 0x1779 0xa438 0xf9e 0x1947 0xa3c4 0xf8f 0x1b15 0xa350 0xf83 0x1ce4 0xa2dd 0xf67 0x1eb2 0xa26b 0xf5b 0x2080 0xa1f9 0xf58 0x224e 0xa18a 0xf4c 0x241c 0xa118 0xf32 0x25eb 0xa0a9 0xf3e 0x27b9 0xa038 0xf10 0x2987 0x9fc7 0xef2 0x2b55 0x9f64 0xef0 0x2d24 0x9f08 0xf05 0x2ef2 0x9eb0 0xf27 0x30c0 0x9e4c 0xf41 0x328e 0x9dd3 0xf31 0x345c 0x9d42 0xefe 0x362b 0x9c9e 0xea6 0x37f9 0x9bf5 0xe3d 0x39c7 0x9b58 0xdf3 0x3b95 0x9acd 0xdb0 0x3d64 0x9a54 0xd86 0x3f32 0x99ea 0xd6e 0x4100 0x998f 0xd58 0x42ce 0x9939 0xd45 0x449c 0x98eb 0xd5a 0x466b 0x989c 0xd36 0x4839 0x984c 0xd1d 0x4a07 0x97fd 0xd19 0x4bd5 0x97b2 0xcfa 0x4da4 0x9764 0xcdd 0x4f72 0x971b 0xcd9 0x5140 0x96d6 0xcce 0x530e 0x9692 0xccb 0x54dc 0x964e 0xcc3 0x56ab 0x960e 0xcbb 0x5879 0x95d4 0xcba 0x5a47 0x9599 0xcbb 0x5c15 0x9561 0xcbd 0x5de4 0x952c 0xccd 0x5fb2 0x94f9 0xcc8 0x6180 0x94c9 0xcc4 0x634e 0x949c 0xcde 0x651c 0x946c 0xcd3 0x66eb 0x9443 0xce9 0x68b9 0x941c 0xd09 0x6a87 0x93f5 0xcfe 0x6c55 0x93d1 0xd0e 0x6e24 0x93ad 0xd22 0x6ff2 0x9391 0xd1d 0x71c0 0x9374 0xd24 0x738e 0x935d 0xd54 0x755c 0x934a 0xd80 0x772b 0x9337 0xd8e 0x78f9 0x9323 0xdc1 0x7ac7 0x9310 0xdf5 0x7c95 0x92f9 0xe21 0x7e64 0x92e0 0xe54 0x8032 0x92ca 0xe96 0x8200 0x92b3 0xed6 0x83ce 0x9298 0xf2e 0x859c 0x927d 0xf81 0x876b 0x925e 0xfca 0x8939 0x9239 0x1021 0x8b07 0x9214 0x1075 0x8cd5 0x91eb 0x10da 0x8ea4 0x91be 0x113c 0x9072 0x9187 0x11af 0x9240 0x9153 0x123e 0x940e 0x9117 0x12c5 0x95dc 0x90d8 0x1363 0x97ab 0x9093 0x13eb 0x9979 0x9055 0x149c 0x9b47 0x9019 0x1563 0x9d15 0x8fe5 0x1637 0x9ee4 0x8fb7 0x1724 0xa0b2 0x8f89 0x183c 0xa280 0x8f56 0x1985 0xa44e 0x8f07 0x1ae9 0xa61c 0x8e82 0x1c74 0xa7eb 0x8dac 0x1e26 0xa9b9 0x8c78 0x2006 0xab87 0x8ad4 0x2225 0xad55 0x88a1 0x247b 0xaf24 0x859f 0x2741 0xb0f2 0x8117 0x2e4c 0xb2c0 0x80a5 0x2f06>;
				battery1_profile_t3_col = <0x3>;
				battery1_profile_t3_num = <0x64>;
				battery1_profile_t4 = <0x0 0xab90 0x22ce 0x1ce 0xaa56 0x22ec 0x39c 0xa953 0x24f6 0x56b 0xa875 0x2121 0x739 0xa79d 0x2587 0x907 0xa6d8 0x2529 0xad5 0xa61f 0x248a 0xca4 0xa571 0x2404 0xe72 0xa4cc 0x235f 0x1040 0xa432 0x22dd 0x120e 0xa3a1 0x2270 0x13dc 0xa311 0x21ed 0x15ab 0xa286 0x2177 0x1779 0xa202 0x210c 0x1947 0xa17c 0x2091 0x1b15 0xa0f7 0x2013 0x1ce4 0xa07e 0x1fc0 0x1eb2 0xa011 0x1f6e 0x2080 0x9fa8 0x1f3a 0x224e 0x9f3d 0x1f20 0x241c 0x9ec5 0x1e93 0x25eb 0x9e3c 0x1e3b 0x27b9 0x9da7 0x1d81 0x2987 0x9d09 0x1d1a 0x2b55 0x9c6f 0x1c87 0x2d24 0x9bdf 0x1c00 0x2ef2 0x9b5b 0x1b9d 0x30c0 0x9af1 0x1b43 0x328e 0x9a8c 0x1b0d 0x345c 0x9a31 0x1ade 0x362b 0x99df 0x1ac1 0x37f9 0x9991 0x1aab 0x39c7 0x9943 0x1aa7 0x3b95 0x98f6 0x1a8d 0x3d64 0x98a6 0x1a66 0x3f32 0x9859 0x1a6a 0x4100 0x980b 0x1a48 0x42ce 0x97be 0x1a26 0x449c 0x9772 0x1a2d 0x466b 0x972a 0x1a0a 0x4839 0x96e3 0x1a09 0x4a07 0x969f 0x1a10 0x4bd5 0x9660 0x1a08 0x4da4 0x9620 0x1a04 0x4f72 0x95e3 0x1a12 0x5140 0x95a9 0x1a17 0x530e 0x9572 0x1a1a 0x54dc 0x953c 0x1a2e 0x56ab 0x950a 0x1a34 0x5879 0x94db 0x1a46 0x5a47 0x94ae 0x1a66 0x5c15 0x9485 0x1a6e 0x5de4 0x9462 0x1a87 0x5fb2 0x9443 0x1abf 0x6180 0x9426 0x1ae9 0x634e 0x9408 0x1b11 0x651c 0x93f0 0x1b6c 0x66eb 0x93dc 0x1ba1 0x68b9 0x93c3 0x1beb 0x6a87 0x93b2 0x1c55 0x6c55 0x939b 0x1ca7 0x6e24 0x9388 0x1d0b 0x6ff2 0x9374 0x1d8a 0x71c0 0x935d 0x1deb 0x738e 0x9346 0x1e58 0x755c 0x9330 0x1ee4 0x772b 0x9319 0x1f62 0x78f9 0x9302 0x1fff 0x7ac7 0x92eb 0x20a9 0x7c95 0x92d1 0x2135 0x7e64 0x92b6 0x21e9 0x8032 0x929a 0x22a3 0x8200 0x927a 0x233d 0x83ce 0x925c 0x240e 0x859c 0x923e 0x24d7 0x876b 0x921c 0x258d 0x8939 0x91f6 0x2682 0x8b07 0x91d2 0x274e 0x8cd5 0x91a8 0x281a 0x8ea4 0x917d 0x2913 0x9072 0x9153 0x29f6 0x9240 0x911f 0x2abf 0x940e 0x90f1 0x2bc8 0x95dc 0x90bf 0x2ca9 0x97ab 0x908a 0x2d90 0x9979 0x9059 0x2e96 0x9b47 0x9028 0x2f86 0x9d15 0x8ff6 0x306c 0x9ee4 0x8fc2 0x3163 0xa0b2 0x8f8d 0x3263 0xa280 0x8f52 0x336b 0xa44e 0x8f0a 0x3489 0xa61c 0x8eb0 0x3587 0xa7eb 0x8e30 0x3657 0xa9b9 0x8d7e 0x3732 0xab87 0x8c88 0x382f 0xad55 0x8b2e 0x394c 0xaf24 0x894c 0x3b35 0xb0f2 0x868f 0x3e6b 0xb2c0 0x821c 0x44ca>;
				battery1_profile_t4_col = <0x3>;
				battery1_profile_t4_num = <0x64>;
				bootmode = <0x2a>;
				charger = <0x29>;
				compatible = "mediatek,mt6357-gauge";
				enable_tmp_intr_suspend = <0x0>;
				g_FG_PSEUDO100_T0 = <0x61>;
				g_FG_PSEUDO100_T1 = <0x61>;
				g_FG_PSEUDO100_T2 = <0x61>;
				g_FG_PSEUDO100_T3 = <0x61>;
				g_FG_PSEUDO100_T4 = <0x61>;
				io-channel-names = "pmic_battery_temp", "pmic_battery_voltage", "pmic_bif_voltage", "pmic_ptim_voltage", "batteryID-channel";
				io-channels = <0x27 0x3 0x27 0x0 0x27 0xe 0x27 0xf 0x2b 0x2>;
				nvmem-cell-names = "initialization", "state-of-charge";
				nvmem-cells = <0x2c 0x2d>;
				phandle = <0x66>;
			};

			mtk_rtc {
				#address-cells = <0x1>;
				#size-cells = <0x1>;
				bootmode = <0x2a>;
				compatible = "mediatek,mt6357-rtc";
				phandle = <0x92>;

				ext_32k {
					bits = <0x6 0x1>;
					phandle = <0x93>;
					reg = <0x2 0x1>;
				};

				fg_init {
					bits = <0x0 0x8>;
					phandle = <0x2c>;
					reg = <0x0 0x1>;
				};

				fg_soc {
					bits = <0x0 0x8>;
					phandle = <0x2d>;
					reg = <0x1 0x1>;
				};
			};

			mtk_ts_pmic {
				#interconnect-cells = <0x1>;
				compatible = "mediatek,mtk_ts_pmic";
				interconnects = <0x27 0x1>;
				io-channel-names = "pmic_chip_temp", "pmic_buck1_temp", "pmic_buck2_temp";
				io-channels = <0x27 0x5 0x27 0x6 0x27 0x7>;
				phandle = <0x2e>;
			};

			pmic_accdet {
				accdet-mic-mode = <0x1>;
				accdet-mic-vol = <0x6>;
				accdet-name = "mt63xx-accdet";
				accdet-plugout-debounce = <0x1>;
				compatible = "mediatek,mt6357-accdet";
				headset-eint-level-pol = <0x8>;
				headset-eint-num = <0x0>;
				headset-eint-trig-mode = <0x0>;
				headset-four-key-threshold = <0x0 0x3a 0x79 0xc0 0x190>;
				headset-key-mode = <0x0>;
				headset-mode-setting = <0x500 0x500 0x1 0x1f0 0x800 0x800 0x20 0x44>;
				headset-three-key-threshold = <0x0 0x50 0xdc 0x190>;
				headset-three-key-threshold-CDD = <0x0 0x79 0xc0 0x258>;
				headset-use-ap-eint = <0x0>;
				io-channel-names = "pmic_accdet";
				io-channels = <0x27 0x9>;
				nvmem = <0x28>;
				nvmem-names = "mt63xx-accdet-efuse";
				phandle = <0x73>;
				status = "okay";
			};

			pmic_auxadc {
				#interconnect-cells = <0x1>;
				#io-channel-cells = <0x1>;
				compatible = "mediatek,pmic-auxadc", "mediatek,mt6357-auxadc";
				phandle = <0x27>;

				accdet {
					channel = <0x9>;
				};

				bat_temp {
					channel = <0x3>;
					resistance-ratio = <0x1 0x1>;
				};

				batadc {
					avg-num = <0x80>;
					channel = <0x0>;
					resistance-ratio = <0x3 0x1>;
				};

				chip_temp {
					channel = <0x5>;
				};

				dcxo_temp {
					avg-num = <0x10>;
					channel = <0xd>;
				};

				hpofs_cal {
					avg-num = <0x100>;
					channel = <0xc>;
				};

				imix_r {
					channel = <0x10>;
				};

				imp {
					avg-num = <0x80>;
					channel = <0xf>;
					resistance-ratio = <0x3 0x1>;
				};

				isense {
					avg-num = <0x80>;
					channel = <0x1>;
					resistance-ratio = <0x3 0x1>;
				};

				tsx_temp {
					avg-num = <0x80>;
					channel = <0xb>;
				};

				vbif {
					channel = <0xe>;
					resistance-ratio = <0x1 0x1>;
				};

				vcdt {
					channel = <0x2>;
				};

				vcore_temp {
					channel = <0x6>;
				};

				vproc_temp {
					channel = <0x7>;
				};
			};

			pmic_codec {
				compatible = "mediatek,mt6357-sound";
				io-channel-names = "pmic_codec", "pmic_accdet";
				io-channels = <0x27 0xc 0x27 0x9>;
				mediatek,pwrap-regmap = <0x30>;
				nvmem = <0x28>;
				nvmem-names = "pmic-hp-efuse";
				phandle = <0x94>;
				use_hp_depop_flow = <0x0>;
				use_ul_260k = <0x0>;
			};

			pmic_efuse {
				#address-cells = <0x1>;
				#size-cells = <0x1>;
				compatible = "mediatek,mt6357-efuse";
				phandle = <0x28>;
			};

			pmic_lbat_service {
				compatible = "mediatek,mt6357-lbat_service";
			};
		};
	};

	radio_md_cfg {
		compatible = "mediatek,radio_md_cfg";
		phandle = <0xe6>;
	};

	regulator_vibrator {
		compatible = "regulator-vibrator";
		max-limit = <0x3a98>;
		max-volt = <0x30d400>;
		min-limit = <0xf>;
		min-volt = <0x231860>;
		vib-supply = <0x2>;
	};

	reserved-memory {
		#address-cells = <0x2>;
		#size-cells = <0x2>;
		phandle = <0x6b>;
		ranges;

		consys-reserve-memory {
			alignment = <0x0 0x1000000>;
			alloc-ranges = <0x0 0x40000000 0x0 0x80000000>;
			compatible = "mediatek,consys-reserve-memory";
			no-map;
			phandle = <0x4b>;
			size = <0x0 0x400000>;
		};

		reserve-memory-scp_share {
			alignment = <0x0 0x1000000>;
			alloc-ranges = <0x0 0x40000000 0x0 0x50000000>;
			compatible = "mediatek,reserve-memory-scp_share";
			no-map;
			size = <0x0 0x300000>;
		};

		reserve-memory-sspm_share {
			alignment = <0x0 0x10000>;
			alloc-ranges = <0x0 0x40000000 0x0 0x60000000>;
			compatible = "mediatek,reserve-memory-sspm_share";
			no-map;
			size = <0x0 0x510000>;
			status = "okay";
		};

		wifi-reserve-memory {
			alignment = <0x0 0x1000000>;
			alloc-ranges = <0x0 0x40000000 0x0 0x80000000>;
			compatible = "shared-dma-pool";
			no-map;
			phandle = <0x4c>;
			size = <0x0 0x300000>;
		};
	};

	rt-pd-manager {
		compatible = "mediatek,rt-pd-manager";
	};

	rt9465_slave_chr {
		compatible = "richtek,rt9465";
		phandle = <0xe1>;
		status = "disabled";
	};

	scp@10500000 {
		compatible = "mediatek,scp";
		core_1 = "enable";
		interrupts = <0x0 0xc0 0x4>;
		reg = <0x0 0x10500000 0x0 0x40000 0x0 0x105c0000 0x0 0x3000 0x0 0x105c4000 0x0 0x1000 0x0 0x105d4000 0x0 0x6000>;
		scp_feature_tbl = <0x0 0x2f 0x1 0x164 0x2 0x3e 0x3 0x2f 0x4 0x1a 0x5 0x0 0x6 0xc8 0x7 0x0 0x8 0x64 0x9 0xa>;
		scp_mem_key = "mediatek,reserve-memory-scp_share";
		scp_mem_tbl = <0x1 0x100000 0x4 0x200000>;
		scp_sramSize = <0x40000>;
		status = "okay";
	};

	scp_dvfs {
		clock-names = "clk_mux", "clk_pll_0", "clk_pll_1", "clk_pll_2", "clk_pll_3", "clk_pll_4", "clk_pll_5", "clk_pll_6";
		clocks = <0x26 0x63 0x24 0x26 0xe 0x26 0x1a 0x26 0x2 0x26 0x17 0x26 0x6 0x26 0x19>;
		compatible = "mediatek,scp_dvfs";
		dvfs-opp = <0xff 0xff 0xff 0x0 0x0 0xfa 0x0 0xff 0xff 0xff 0x0 0x0 0x111 0x3 0xff 0xff 0xff 0x2 0x8 0x14a 0x5 0xff 0xff 0xff 0x3 0xc 0x1a0 0x6>;
		dvfsrc-opp-num = <0x3>;
		gpio = <0x17 0x1>;
		gpio-feature = "gpio-mode";
		gpio-feature-cfg = <0x0>;
		pmic = <0x31>;
		pmic-feature = "pmic-vow-lp", "pmic-pmrc";
		pmic-feature-cfg = <0x0 0x0>;
	};

	scp_infra@10001000 {
		compatible = "mediatek,scpinfra";
		phandle = <0x6e>;
		reg = <0x0 0x10001000 0x0 0x1000>;
	};

	scpsys@10001000 {
		#clock-cells = <0x1>;
		compatible = "mediatek,mt6765-scpsys", "syscon";
		phandle = <0x36>;
		reg = <0x0 0x10001000 0x0 0x1000 0x0 0x10006000 0x0 0x1000 0x0 0x14002000 0x0 0x1000 0x0 0x1020e000 0x0 0x1000 0x0 0x18004000 0x0 0x1000 0x0 0x18002000 0x0 0x1000>;
	};

	security_ao@1001a000 {
		compatible = "mediatek,security_ao";
		reg = <0x0 0x1001a000 0x0 0x1000>;
	};

	seninf1@1a040000 {
		compatible = "mediatek,seninf1";
		reg = <0x0 0x1a040000 0x0 0x1000>;
	};

	seninf2@1a041000 {
		compatible = "mediatek,seninf2";
		reg = <0x0 0x1a041000 0x0 0x1000>;
	};

	seninf3@1a042000 {
		compatible = "mediatek,seninf3";
		reg = <0x0 0x1a042000 0x0 0x1000>;
	};

	seninf4@1a043000 {
		compatible = "mediatek,seninf4";
		reg = <0x0 0x1a043000 0x0 0x1000>;
	};

	serial@11020000 {
		clock-names = "baud", "bus";
		clocks = <0x24 0x25 0x16>;
		compatible = "mediatek,mt6758-uart", "mediatek,mt6577-uart";
		dma-names = "tx", "rx";
		dmas = <0x48 0x0 0x48 0x1>;
		interrupts = <0x0 0x5b 0x8>;
		phandle = <0xa7>;
		reg = <0x0 0x11002000 0x0 0x1000>;
	};

	serial@11030000 {
		clock-names = "baud", "bus";
		clocks = <0x24 0x25 0x17>;
		compatible = "mediatek,mt6758-uart", "mediatek,mt6577-uart";
		interrupts = <0x0 0x5c 0x8>;
		phandle = <0xa8>;
		reg = <0x0 0x11003000 0x0 0x1000>;
	};

	sileadfp {
		compatible = "mediatek,mt6765-sileadfp";
		phandle = <0x9d>;
	};

	sleep@10006000 {
		compatible = "mediatek,sleep", "syscon";
		interrupts = <0x0 0xb5 0x8>;
		phandle = <0x68>;
		reg = <0x0 0x10006000 0x0 0x1000>;
		wakeup-source = <0x20 0x0 0x4 0x21 0x1 0x20 0x22 0x3 0x2000000>;
	};

	sleep_reg_md@1000f000 {
		compatible = "mediatek,sleep_reg_md";
		reg = <0x0 0x1000f000 0x0 0x1000>;
	};

	smart_pa {
		phandle = <0xec>;
	};

	smi_common@14002000 {
		clock-names = "mtcmos-mm", "smi-common-gals-comm0", "smi-common-gals-comm1", "smi-common", "mmdvfs_clk_mm_sel_ck", "mmdvfs_clk_mmpll_ck", "mmdvfs_clk_univpll1_d2_ck", "mmdvfs_clk_mmpll_d2_ck";
		clocks = <0x36 0x3 0x60 0x15 0x60 0x16 0x60 0x13 0x26 0x62 0x26 0x21 0x26 0x17 0x26 0x22>;
		compatible = "mediatek,smi_common";
		mediatek,smi-cnt = <0x5>;
		mediatek,smi-id = <0x4>;
		mmsys_config = <0x3c>;
		phandle = <0xcb>;
		reg = <0x0 0x14002000 0x0 0x1000>;
	};

	smi_larb0@14003000 {
		cell-index = <0x0>;
		clock-names = "mtcmos-mm", "mm-larb0";
		clocks = <0x36 0x3 0x60 0x14>;
		compatible = "mediatek,smi_larb0", "mediatek,smi_larb";
		mediatek,larb-id = <0x0>;
		mediatek,smi-id = <0x0>;
		phandle = <0xcc>;
		reg = <0x0 0x14003000 0x0 0x1000>;
	};

	smi_larb1@17010000 {
		cell-index = <0x1>;
		clock-names = "mtcmos-vcodec", "venc-larb1";
		clocks = <0x36 0xa 0x63 0x1>;
		compatible = "mediatek,smi_larb1", "mediatek,smi_larb";
		mediatek,larb-id = <0x1>;
		mediatek,smi-id = <0x1>;
		phandle = <0xd2>;
		reg = <0x0 0x17010000 0x0 0x1000>;
	};

	smi_larb2@15021000 {
		cell-index = <0x2>;
		clock-names = "mtcmos-isp", "gals-img2mm", "img-larb2";
		clocks = <0x36 0x5 0x60 0x18 0x61 0x0>;
		compatible = "mediatek,smi_larb2", "mediatek,smi_larb";
		mediatek,larb-id = <0x2>;
		mediatek,smi-id = <0x2>;
		phandle = <0xd0>;
		reg = <0x0 0x15021000 0x0 0x1000>;
	};

	smi_larb3@1a002000 {
		cell-index = <0x3>;
		clock-names = "mtcmos-cam", "gals-cam2mm", "cam-larb3";
		clocks = <0x36 0x9 0x60 0x19 0x62 0x0>;
		compatible = "mediatek,smi_larb3", "mediatek,smi_larb";
		mediatek,larb-id = <0x3>;
		mediatek,smi-id = <0x3>;
		phandle = <0xd4>;
		reg = <0x0 0x1a002000 0x0 0x1000>;
	};

	spi@1100a000 {
		clock-names = "parent-clk", "sel-clk", "spi-clk";
		clocks = <0x26 0xb 0x26 0x6b 0x25 0x1b>;
		compatible = "mediatek,mt6765-spi";
		interrupts = <0x0 0x76 0x8>;
		mediatek,pad-select = <0x0>;
		phandle = <0xb2>;
		reg = <0x0 0x1100a000 0x0 0x1000>;
	};

	spi@11010000 {
		clock-names = "parent-clk", "sel-clk", "spi-clk";
		clocks = <0x26 0xb 0x26 0x6b 0x25 0x34>;
		compatible = "mediatek,mt6765-spi";
		interrupts = <0x0 0x7a 0x8>;
		mediatek,pad-select = <0x0>;
		phandle = <0xb5>;
		reg = <0x0 0x11010000 0x0 0x1000>;
	};

	spi@11012000 {
		clock-names = "parent-clk", "sel-clk", "spi-clk";
		clocks = <0x26 0xb 0x26 0x6b 0x25 0x37>;
		compatible = "mediatek,mt6765-spi";
		interrupts = <0x0 0x80 0x8>;
		mediatek,pad-select = <0x0>;
		phandle = <0xb6>;
		reg = <0x0 0x11012000 0x0 0x1000>;
	};

	spi@11013000 {
		clock-names = "parent-clk", "sel-clk", "spi-clk";
		clocks = <0x26 0xb 0x26 0x6b 0x25 0x38>;
		compatible = "mediatek,mt6765-spi";
		interrupts = <0x0 0x81 0x8>;
		mediatek,pad-select = <0x0>;
		phandle = <0xb7>;
		reg = <0x0 0x11013000 0x0 0x1000>;
	};

	spi@11014000 {
		clock-names = "parent-clk", "sel-clk", "spi-clk";
		clocks = <0x26 0xb 0x26 0x6b 0x25 0x41>;
		compatible = "mediatek,mt6765-spi";
		interrupts = <0x0 0x5f 0x8>;
		mediatek,pad-select = <0x0>;
		phandle = <0xb8>;
		reg = <0x0 0x11014000 0x0 0x1000>;
	};

	spi@11015000 {
		clock-names = "parent-clk", "sel-clk", "spi-clk";
		clocks = <0x26 0xb 0x26 0x6b 0x25 0x42>;
		compatible = "mediatek,mt6765-spi";
		interrupts = <0x0 0x60 0x8>;
		mediatek,pad-select = <0x0>;
		phandle = <0xb9>;
		reg = <0x0 0x11015000 0x0 0x1000>;
	};

	sramrom@10214000 {
		compatible = "mediatek,sramrom";
		reg = <0x0 0x10214000 0x0 0x1000>;
	};

	sspm@10440000 {
		compatible = "mediatek,mt6765-sspm";
		interrupt-names = "ipc", "mbox0", "mbox1", "mbox2", "mbox3", "mbox4";
		interrupts = <0x0 0xca 0x4 0x0 0xcd 0x4 0x0 0xce 0x4 0x0 0xcf 0x4 0x0 0xd0 0x4 0x0 0xd1 0x4>;
		reg = <0x0 0x10440000 0x0 0x10000 0x0 0x10450000 0x0 0x100 0x0 0x10451000 0x0 0x8 0x0 0x10460000 0x0 0x100 0x0 0x10461000 0x0 0x8 0x0 0x10470000 0x0 0x100 0x0 0x10471000 0x0 0x8 0x0 0x10480000 0x0 0x100 0x0 0x10481000 0x0 0x8 0x0 0x10490000 0x0 0x100 0x0 0x10491000 0x0 0x8>;
		reg-names = "cfgreg", "mbox0_base", "mbox0_ctrl", "mbox1_base", "mbox1_ctrl", "mbox2_base", "mbox2_ctrl", "mbox3_base", "mbox3_ctrl", "mbox4_base", "mbox4_ctrl";
	};

	swtp {
		compatible = "mediatek, swtp-eint";
		phandle = <0xce>;
	};

	sys_cirq@10204000 {
		compatible = "mediatek,sys_cirq";
		interrupts = <0x0 0x118 0x8>;
		mediatek,cirq_num = <0xd1>;
		mediatek,spi_start_offset = <0x48>;
		reg = <0x0 0x10204000 0x0 0x1000>;
	};

	therm_ctrl@1100b000 {
		clock-names = "therm-main";
		clocks = <0x25 0xa>;
		compatible = "mediatek,therm_ctrl";
		interrupts = <0x0 0x4e 0x8>;
		nvmem = <0x3b>;
		nvmem-cell-names = "cpu_freq_segment_cell", "thermal_efuse_cell";
		nvmem-cells = <0x49 0x4a>;
		nvmem-names = "mtk_efuse";
		reg = <0x0 0x1100b000 0x0 0x1000>;
	};

	thermal-sensor1 {
		compatible = "mediatek,mtboard-thermistor1";
		interconnects = <0x2b 0x0>;
		io-channel-names = "thermistor-ch0";
		io-channels = <0x2b 0x0>;
		phandle = <0xb3>;
	};

	thermal-sensor2 {
		compatible = "mediatek,mtboard-thermistor2";
		interconnects = <0x2b 0x1>;
		io-channel-names = "thermistor-ch1";
		io-channels = <0x2b 0x1>;
		phandle = <0xb4>;
	};

	timer {
		clock-frequency = <0xc65d40>;
		compatible = "arm,armv8-timer";
		interrupt-parent = <0x16>;
		interrupts = <0x1 0xd 0x8 0x1 0xe 0x8 0x1 0xb 0x8 0x1 0xa 0x8>;
	};

	timer@10017000 {
		clocks = <0x35>;
		compatible = "mediatek,sys_timer", "mediatek,mt6761-timer", "mediatek,mt6765-timer";
		interrupts = <0x0 0xc2 0x4>;
		phandle = <0xa0>;
		reg = <0x0 0x10017000 0x0 0x1000>;
		reg-names = "sys_timer_base";
	};

	tkcore {
		compatible = "trustkernel,tkcore";
		interrupts = <0x0 0xf8 0x1>;
	};

	topckgen@10000000 {
		#clock-cells = <0x1>;
		compatible = "mediatek,mt6765-topckgen", "syscon";
		phandle = <0x26>;
		reg = <0x0 0x10000000 0x0 0x1000>;
	};

	topckgen_ao@1001b000 {
		compatible = "mediatek,topckgen_ao";
		reg = <0x0 0x1001b000 0x0 0x1000>;
	};

	topmisc@10011000 {
		compatible = "mediatek,topmisc";
		reg = <0x0 0x10011000 0x0 0x1000>;
	};

	toprgu@10007000 {
		#reset-cells = <0x1>;
		compatible = "mediatek,mt6765-wdt", "mediatek,mt6589-wdt", "mediatek,toprgu", "syscon", "simple-mfd";
		interrupts = <0x0 0x8b 0x0>;
		phandle = <0x47>;
		reg = <0x0 0x10007000 0x0 0x1000>;

		reboot-mode {
			compatible = "syscon-reboot-mode";
			mask = <0xf>;
			mode-bootloader = <0x3>;
			mode-charger = <0x1>;
			mode-ddr-reserve = <0x6>;
			mode-dm-verity-dev-corrupt = <0x4>;
			mode-kpoc = <0x5>;
			mode-meta = <0x7>;
			mode-recovery = <0x2>;
			mode-rpmbpk = <0x8>;
			offset = <0x24>;
		};
	};

	touch {
		compatible = "mediatek,touch";
		phandle = <0x99>;
	};

	trng@1020f000 {
		compatible = "mediatek,trng";
		interrupts = <0x0 0xa1 0x8>;
		reg = <0x0 0x1020f000 0x0 0x1000>;
	};

	type_c_port0 {
		charger = <0x69>;
		mt-tcpc,name = "type_c_port0";
		mt-tcpc,notifier_supply_num = <0x2>;
		mt-tcpc,role_def = <0x5>;
		mt-tcpc,rp_level = <0x1>;
		mt-tcpc,vconn_supply = <0x1>;
		mt6370pd,intr_gpio = <0x1f 0x18 0x0>;
		mt6370pd,intr_gpio_num = <0x18>;
		phandle = <0xf2>;

		displayport {
			1st_connection = "dfp_d";
			2nd_connection = "dfp_d";
			signal,dp_v13;
			typec,receptacle;

			dfp_d {
				pin_assignment,mode_c;
				pin_assignment,mode_d;
				pin_assignment,mode_e;
			};

			ufp_d {
			};
		};

		dpm_caps {
			attemp_discover_cable;
			attemp_discover_id;
			attemp_enter_dp_mode;
			dr_check = <0x0>;
			local_dr_data;
			local_dr_power;
			local_no_suspend;
			local_usb_comm;
			local_vconn_supply;
			pr_check = <0x0>;
		};

		pd-data {
			bat,nr = <0x1>;
			pd,charging_policy = <0x31>;
			pd,country_nr = <0x0>;
			pd,id-vdo-data = <0xd14029cf 0x0 0x50810000 0x41800000 0x0 0x21800000>;
			pd,id-vdo-size = <0x6>;
			pd,mfrs = "RichtekTCPC";
			pd,pid = <0x5081>;
			pd,sink-pdo-data = <0x190c8>;
			pd,sink-pdo-size = <0x1>;
			pd,source-cap-ext = <0x508129cf 0x0 0x0 0x0 0x0 0x7000000>;
			pd,source-pdo-data = <0x19096>;
			pd,source-pdo-size = <0x1>;
			pd,vid = <0x29cf>;

			bat-info0 {
				bat,design_cap = <0xbb8>;
				bat,mfrs = "bat1";
				bat,pid = <0x5081>;
				bat,vid = <0x29cf>;
			};
		};
	};

	usb-phy@11210000 {
		#address-cells = <0x2>;
		#size-cells = <0x2>;
		compatible = "mediatek,generic-tphy-v1";
		phandle = <0xba>;
		ranges;
		reg = <0x0 0x11cc0000 0x0 0x800>;
		status = "okay";

		usb-phy@11210000 {
			#phy-cells = <0x1>;
			clock-names = "ref";
			clocks = <0x24>;
			nvmem-cell-masks = <0x1f>;
			nvmem-cell-names = "intr_cal";
			nvmem-cells = <0x4f>;
			phandle = <0x4e>;
			reg = <0x0 0x11cc0800 0x0 0x100>;
			status = "okay";
		};
	};

	usb0@11200000 {
		clock-names = "usb0", "usb0_clk_top_sel", "usb0_clk_univpll3_d4";
		clocks = <0x25 0x8 0x26 0x76 0x26 0x20>;
		compatible = "mediatek,mt6765-usb20";
		dr_mode = "otg";
		interrupt-names = "mc";
		interrupts = <0x0 0x49 0x8>;
		mode = <0x2>;
		multipoint = <0x1>;
		num_eps = <0x10>;
		pericfg = <0x4d>;
		phandle = <0x67>;
		phys = <0x4e 0x3>;
		reg = <0x0 0x11200000 0x0 0x10000 0x0 0x11cc0000 0x0 0x10000>;
		usb-role-switch;
	};

	usb1p_sif@11210000 {
		compatible = "mediatek,usb1p_sif";
		reg = <0x0 0x11210000 0x0 0x10000>;
	};

	utos {
		compatible = "microtrust,utos";
		interrupts = <0x0 0xf9 0x1 0x0 0xfa 0x1>;
	};

	utos_tester {
		compatible = "microtrust,tester-v1";
	};

	vcodecsys@17000000 {
		#clock-cells = <0x1>;
		compatible = "mediatek,mt6765-vcodecsys", "syscon";
		phandle = <0x63>;
		reg = <0x0 0x17000000 0x0 0x10000>;
	};

	vdec@17040000 {
		compatible = "mediatek,vdec";
		interrupts = <0x0 0xe9 0x8>;
		reg = <0x0 0x17040000 0x0 0x10000>;
	};

	venc@17020000 {
		compatible = "mediatek,venc";
		interrupts = <0x0 0xe6 0x8>;
		reg = <0x0 0x17020000 0x0 0x10000>;
	};

	venc_gcon@17000000 {
		clock-names = "MT_SCP_SYS_DIS", "MT_SCP_SYS_VCODEC", "MT_CG_MM_SMI_COMM0", "MT_CG_MM_SMI_COMM1", "MT_CG_MM_SMI_COMMON", "MT_CG_VDEC", "MT_CG_VENC";
		clocks = <0x36 0x3 0x36 0xa 0x60 0x15 0x60 0x16 0x60 0x13 0x63 0x3 0x63 0x1>;
		compatible = "mediatek,venc_gcon", "syscon";
		phandle = <0xd1>;
		reg = <0x0 0x17000000 0x0 0x10000>;
	};

	venc_jpg@17030000 {
		clock-names = "MT_CG_VENC_JPGENC";
		clocks = <0x63 0x2>;
		compatible = "mediatek,venc_jpg";
		interrupts = <0x0 0xe8 0x8>;
		reg = <0x0 0x17030000 0x0 0x10000>;
	};

	wifi@18000000 {
		compatible = "mediatek,wifi";
		interrupts = <0x0 0x10c 0x8>;
		memory-region = <0x4c>;
		reg = <0x0 0x18000000 0x0 0x100000>;
	};
};
